## CMakeLists.txt
```
cmake_minimum_required(VERSION 3.20.0)
find_package(Zephyr REQUIRED HINTS $ENV{ZEPHYR_BASE})

project(block)

zephyr_include_directories(
    ../BC__Butterknife/include
    ../SKINNY-AEAD
    ../forkskinny-opt32
    ../deoxysi128/deoxysi128/ref
    ../deoxysi128/deoxysi128
    ../deoxysi256/deoxysi256/ref
    ../deoxysi
)

target_sources(app PRIVATE
    src/main.c
    src/rijndael256.c
    ../deoxysi128/deoxysi128/deoxysbc256_opt.c
    ../BC__Butterknife/source/butterknife256.c
    ../BC__Butterknife/source/butterknife256_tks.c
    ../SKINNY-AEAD/internal-skinny128.c
    ../forkskinny-opt32/internal-forkskinny.c
    ../forkskinny-opt32/skinny.c
    ../deoxysi128/deoxysi128/ref/tweakableBC.c
    ../deoxysi128/deoxysi128/ref/deoxysi.c
    ../deoxysi256/deoxysi256/ref/tweakableBC.c
    ../deoxysi256/deoxysi256/ref/deoxysi.c
    ../deoxysi/deoxys.c
)

# forkskinny-opt32/skinny.c and SKINNY-AEAD both define skinny_128_256_encrypt
# with different signatures. Prefix the forkskinny variant used by deoxysi.
set_source_files_properties(
    ../forkskinny-opt32/skinny.c
    ../deoxysi/deoxys.c
    PROPERTIES COMPILE_DEFINITIONS
    "skinny_128_256_encrypt=fs_skinny_128_256_encrypt"
)

# deoxysi128/ref and deoxysi256/ref export identical symbol names.
# Prefix deoxysi128/ref symbols so both variants can coexist in one image.
set_source_files_properties(
    ../deoxysi128/deoxysi128/ref/tweakableBC.c
    ../deoxysi128/deoxysi128/ref/deoxysi.c
    PROPERTIES COMPILE_DEFINITIONS
    "choose_lfsr=deoxysi128_ref_choose_lfsr;G=deoxysi128_ref_G;H=deoxysi128_ref_H;deoxysKeySetupEnc=deoxysi128_ref_deoxysKeySetupEnc;deoxysKeySetupDec=deoxysi128_ref_deoxysKeySetupDec;aesTweakEncrypt=aesTweakEncrypt_deoxysi128_ref;aesTweakDecrypt=aesTweakDecrypt_deoxysi128_ref;deoxys_aead_encrypt=deoxys128_ref_aead_encrypt;deoxys_aead_decrypt=deoxys128_ref_aead_decrypt"
)
```

## prj.conf
```kconfig
CONFIG_TIMING_FUNCTIONS=y

# mbedTLS software AES
CONFIG_NRF_SECURITY=y
CONFIG_MBEDTLS_LEGACY_CRYPTO_C=y
CONFIG_MBEDTLS_AES_C=y
CONFIG_PSA_WANT_ALG_ECB_NO_PADDING=y
CONFIG_PSA_WANT_KEY_TYPE_AES=y
CONFIG_BUILD_WITH_TFM=n
CONFIG_MBEDTLS_ENABLE_HEAP=y
CONFIG_MBEDTLS_HEAP_SIZE=4096

# UART console
CONFIG_UART_CONSOLE=y
CONFIG_CONSOLE=y

# Increase stack size for benchmarking
CONFIG_MAIN_STACK_SIZE=8192
```

## src/main.c
```c
#include <zephyr/kernel.h>
#include <zephyr/sys/printk.h>
#include <zephyr/timing/timing.h>

#include <mbedtls/aes.h>
#include "rijndael256.h"
#include <inttypes.h>
#include <stdbool.h>
#include <stdint.h>
#include <string.h>

#include "butterknife.h"
#include "internal-skinny128.h"
#include "internal-forkskinny.h"
#include "deoxysbc256_opt.h"

void aesTweakEncrypt_deoxysi128_ref(uint32_t tweakey_size,
                                    const uint8_t pt[16],
                                    const uint8_t key[],
                                    uint8_t ct[16]);

// (deoxysi/)
void deoxys_I_aead_encrypt_128(const uint8_t *message, size_t m_len,
                               const uint8_t *key, const uint8_t *nonce,
                               uint8_t *ciphertext, size_t *c_len);
int deoxys_I_aead_decrypt_128(uint8_t *message, size_t *m_len,
                              const uint8_t *key, const uint8_t *nonce,
                              const uint8_t *ciphertext, size_t c_len);

// (deoxysi128/deoxysi128/ref)
void deoxys128_ref_aead_encrypt(const uint8_t *ass_data, size_t ass_data_len,
                                const uint8_t *message, size_t m_len,
                                const uint8_t *key, const uint8_t *nonce,
                                uint8_t *ciphertext, size_t *c_len);
int deoxys128_ref_aead_decrypt(const uint8_t *ass_data, size_t ass_data_len,
                               uint8_t *message, size_t *m_len,
                               const uint8_t *key, const uint8_t *nonce,
                               const uint8_t *ciphertext, size_t c_len);

// (deoxysi256/deoxysi256/ref)
void deoxys_aead_encrypt(const uint8_t *ass_data, size_t ass_data_len,
                         const uint8_t *message, size_t m_len,
                         const uint8_t *key, const uint8_t *nonce,
                         uint8_t *ciphertext, size_t *c_len);
int deoxys_aead_decrypt(const uint8_t *ass_data, size_t ass_data_len,
                        uint8_t *message, size_t *m_len,
                        const uint8_t *key, const uint8_t *nonce,
                        const uint8_t *ciphertext, size_t c_len);

#define WARMUP_ITERS  10
#define BENCH_ITERS   100

static volatile uint8_t sink;

static const uint8_t key_16[16] = {
    0x00,0x01,0x02,0x03,0x04,0x05,0x06,0x07,
    0x08,0x09,0x0a,0x0b,0x0c,0x0d,0x0e,0x0f
};
static const uint8_t key_32[32] = {
    0x00,0x01,0x02,0x03,0x04,0x05,0x06,0x07,
    0x08,0x09,0x0a,0x0b,0x0c,0x0d,0x0e,0x0f,
    0x10,0x11,0x12,0x13,0x14,0x15,0x16,0x17,
    0x18,0x19,0x1a,0x1b,0x1c,0x1d,0x1e,0x1f
};
static const uint8_t plaintext[16] = {
    0x32,0x43,0xf6,0xa8,0x88,0x5a,0x30,0x8d,
    0x31,0x31,0x98,0xa2,0xe0,0x37,0x07,0x34
};
static const uint8_t plaintext_32[32] = {
    0x32,0x43,0xf6,0xa8,0x88,0x5a,0x30,0x8d,
    0x31,0x31,0x98,0xa2,0xe0,0x37,0x07,0x34,
    0x32,0x43,0xf6,0xa8,0x88,0x5a,0x30,0x8d,
    0x31,0x31,0x98,0xa2,0xe0,0x37,0x07,0x34
};
static const uint8_t nonce_8[8] = {
    0x00,0x01,0x02,0x03,0x04,0x05,0x06,0x07
};

static void print_hex(const char *label, const uint8_t *data, size_t len)
{
    printk("  %-30s : ", label);
    for (size_t i = 0; i < len; i++) printk("%02x", data[i]);
    printk("\n");
}

#define BENCH_BEGIN(name_)                                  \
    do {                                                    \
        const char *_name = (name_);                        \
        timing_t _start, _end;                              \
        uint64_t _total_c = 0, _total_ns = 0;

#define BENCH_WARMUP(call_)                                 \
        for (int _i = 0; _i < WARMUP_ITERS; _i++) { call_; }

#define BENCH_MEASURE(call_)                                \
        for (int _i = 0; _i < BENCH_ITERS; _i++) {         \
            _start = timing_counter_get();                  \
            call_;                                          \
            _end = timing_counter_get();                    \
            uint64_t _c = timing_cycles_get(&_start, &_end);\
            _total_c  += _c;                                \
            _total_ns += timing_cycles_to_ns(_c);           \
        }

#define BENCH_END()                                         \
        printk("  %-30s : %10" PRIu64 " cycles | %10" PRIu64 " ns\n", \
               _name,                                       \
               _total_c  / BENCH_ITERS,                     \
               _total_ns / BENCH_ITERS);                    \
    } while (0)

static void verify_deoxys_aead(void)
{
    uint8_t ct256[32];   /* 16-byte CT + 16-byte tag */
    uint8_t ct128[32];
    uint8_t ct128ref[32];
    uint8_t recovered[16];
    size_t  len256 = 0, len128 = 0, len128ref = 0;
    size_t  recovered_len = 0;
    bool ok256 = false, ok128 = false, ok128ref = false;
    bool ct_match_128 = false;

    deoxys_aead_encrypt(NULL, 0, plaintext, 16,
                        key_32, nonce_8, ct256, &len256);

    deoxys_I_aead_encrypt_128(plaintext, 16,
                              key_16, nonce_8, ct128, &len128);

    deoxys128_ref_aead_encrypt(NULL, 0, plaintext, 16,
                               key_16, nonce_8, ct128ref, &len128ref);

    ok256 = (len256 == 32);
    if (ok256) {
        recovered_len = 0;
        ok256 = (deoxys_aead_decrypt(NULL, 0, recovered, &recovered_len,
                                     key_32, nonce_8, ct256, len256) == 0) &&
                (recovered_len == 16) &&
                (memcmp(recovered, plaintext, 16) == 0);
    }

    ok128 = (len128 == 32);
    if (ok128) {
        recovered_len = 0;
        ok128 = (deoxys_I_aead_decrypt_128(recovered, &recovered_len,
                                           key_16, nonce_8, ct128, len128) == 0) &&
                (recovered_len == 16) &&
                (memcmp(recovered, plaintext, 16) == 0);
    }

    ok128ref = (len128ref == 32);
    if (ok128ref) {
        recovered_len = 0;
        ok128ref = (deoxys128_ref_aead_decrypt(NULL, 0, recovered, &recovered_len,
                                               key_16, nonce_8, ct128ref, len128ref) == 0) &&
                   (recovered_len == 16) &&
                   (memcmp(recovered, plaintext, 16) == 0);
    }

    ct_match_128 = (len128 == len128ref) &&
                   (memcmp(ct128, ct128ref, len128) == 0);

    printk("\n=== Deoxys-I AEAD CT Comparison ===\n");
    print_hex("Deoxys-I-128 CT  (deoxysi128)", ct128ref,      16);
    print_hex("Deoxys-I-128 tag (deoxysi128)", ct128ref + 16, 16);
    print_hex("Deoxys-I-256 CT  (deoxysi256)", ct256,         16);
    print_hex("Deoxys-I-256 tag (deoxysi256)", ct256 + 16,    16);
    print_hex("Deoxys-I-128 CT  (deoxysi)",    ct128,         16);
    print_hex("Deoxys-I-128 tag (deoxysi)",    ct128 + 16,    16);
    printk("  %-30s : %s\n", "Decrypt check deoxysi256/ref", ok256 ? "PASS" : "FAIL");
    printk("  %-30s : %s\n", "Decrypt check deoxysi/deoxysi", ok128 ? "PASS" : "FAIL");
    printk("  %-30s : %s\n", "Decrypt check deoxysi128/ref", ok128ref ? "PASS" : "FAIL");
    printk("  %-30s : %s\n", "deoxysi vs deoxysi128/ref", ct_match_128 ? "MATCH" : "MISMATCH");
    printk("\n");

    /* Deoxys-BC-256 block cipher: opt vs ref */
    {
        uint8_t ct_ref[16], ct_opt_full[16], ct_opt_pre[16];
        deoxysbc256_ctx_t bc_ctx;
        bool match_full, match_pre;

        aesTweakEncrypt_deoxysi128_ref(256, plaintext, key_32, ct_ref);

        deoxysbc256_encrypt_full(key_32, plaintext, ct_opt_full);

        deoxysbc256_precompute_tk1(&bc_ctx, key_32);
        deoxysbc256_encrypt(&bc_ctx, key_32 + 16, plaintext, ct_opt_pre);

        match_full = (memcmp(ct_ref, ct_opt_full, 16) == 0);
        match_pre  = (memcmp(ct_ref, ct_opt_pre,  16) == 0);

        printk("=== Deoxys-BC-256 Block Cipher Verification ===\n");
        print_hex("ref  CT (aesTweakEncrypt)", ct_ref,      16);
        print_hex("opt  CT (encrypt_full)",    ct_opt_full, 16);
        print_hex("opt  CT (precomputed TK1)", ct_opt_pre,  16);
        printk("  %-30s : %s\n", "encrypt_full vs ref",    match_full ? "MATCH" : "MISMATCH");
        printk("  %-30s : %s\n", "precomputed  vs ref",    match_pre  ? "MATCH" : "MISMATCH");
        printk("\n");
    }
}

static void bench_skinny128_256(void)
{
    uint8_t output[16];
    skinny_128_256_key_schedule_t ks;
    skinny_128_256_init(&ks, key_32);

    BENCH_BEGIN("SKINNY-128-256")
    BENCH_WARMUP(skinny_128_256_encrypt(&ks, output, plaintext))
    BENCH_MEASURE(skinny_128_256_encrypt(&ks, output, plaintext))
    sink ^= output[0];
    BENCH_END();
}

static void bench_forkskinny128_256_1leg(void)
{
    uint8_t out_right[16];

    BENCH_BEGIN("ForkSkinny-128-256 1-leg")
    BENCH_WARMUP(forkskinny_128_256_encrypt(key_32, NULL, out_right, plaintext))
    BENCH_MEASURE(forkskinny_128_256_encrypt(key_32, NULL, out_right, plaintext))
    sink ^= out_right[0];
    BENCH_END();
}

static void bench_forkskinny128_256_2leg(void)
{
    uint8_t out_left[16], out_right[16];

    BENCH_BEGIN("ForkSkinny-128-256 2-leg")
    BENCH_WARMUP(forkskinny_128_256_encrypt(key_32, out_left, out_right, plaintext))
    BENCH_MEASURE(forkskinny_128_256_encrypt(key_32, out_left, out_right, plaintext))
    sink ^= out_left[0] ^ out_right[0];
    BENCH_END();
}

static void bench_deoxysbc(void)
{
    uint8_t output[16];
    uint8_t tk[32];
    memcpy(tk, key_32, 32);

    BENCH_BEGIN("Deoxys-BC")
    BENCH_WARMUP(aesTweakEncrypt_deoxysi128_ref(256, plaintext, tk, output))
    BENCH_MEASURE(aesTweakEncrypt_deoxysi128_ref(256, plaintext, tk, output))
    sink ^= output[0];
    BENCH_END();
}

static void bench_deoxysbc_opt_full(void)
{
    uint8_t output[16];

    BENCH_BEGIN("Deoxys-BC opt (full)")
    BENCH_WARMUP(deoxysbc256_encrypt_full(key_32, plaintext, output))
    BENCH_MEASURE(deoxysbc256_encrypt_full(key_32, plaintext, output))
    sink ^= output[0];
    BENCH_END();
}

static void bench_deoxysbc_opt_pre(void)
{
    uint8_t output[16];
    deoxysbc256_ctx_t ctx;
    deoxysbc256_precompute_tk1(&ctx, key_32);

    BENCH_BEGIN("Deoxys-BC opt (pre TK1)")
    BENCH_WARMUP(deoxysbc256_encrypt(&ctx, key_32 + 16, plaintext, output))
    BENCH_MEASURE(deoxysbc256_encrypt(&ctx, key_32 + 16, plaintext, output))
    sink ^= output[0];
    BENCH_END();
}

static void bench_butterknife256(uint8_t num_branches, const char *label)
{
    uint8_t output[16];
    uint32_t rtk[4 * 16];
    butterknife_256_precompute_rtk(key_32, rtk, num_branches);

    BENCH_BEGIN(label)
    BENCH_WARMUP(butterknife_256_encrypt_w_rtk(rtk, output, plaintext, num_branches))
    BENCH_MEASURE(butterknife_256_encrypt_w_rtk(rtk, output, plaintext, num_branches))
    sink ^= output[0];
    BENCH_END();
}

static void bench_aes128(void)
{
    uint8_t output[16];
    mbedtls_aes_context ctx;
    mbedtls_aes_init(&ctx);
    mbedtls_aes_setkey_enc(&ctx, key_16, 128);

    BENCH_BEGIN("AES-128")
    BENCH_WARMUP(mbedtls_aes_crypt_ecb(&ctx, MBEDTLS_AES_ENCRYPT, plaintext, output))
    BENCH_MEASURE(mbedtls_aes_crypt_ecb(&ctx, MBEDTLS_AES_ENCRYPT, plaintext, output))
    sink ^= output[0];
    BENCH_END();

    mbedtls_aes_free(&ctx);
}

static void bench_aes256(void)
{
    uint8_t output[16];
    mbedtls_aes_context ctx;
    mbedtls_aes_init(&ctx);
    mbedtls_aes_setkey_enc(&ctx, key_32, 256);

    BENCH_BEGIN("AES-256")
    BENCH_WARMUP(mbedtls_aes_crypt_ecb(&ctx, MBEDTLS_AES_ENCRYPT, plaintext, output))
    BENCH_MEASURE(mbedtls_aes_crypt_ecb(&ctx, MBEDTLS_AES_ENCRYPT, plaintext, output))
    sink ^= output[0];
    BENCH_END();

    mbedtls_aes_free(&ctx);
}

static void bench_rijndael256(void)
{
    uint8_t output[32];
    rijndael256_ctx_t ctx;
    rijndael256_set_key(&ctx, key_32);

    BENCH_BEGIN("Rijndael-256")
    BENCH_WARMUP(rijndael256_encrypt(&ctx, plaintext_32, output))
    BENCH_MEASURE(rijndael256_encrypt(&ctx, plaintext_32, output))
    sink ^= output[0];
    BENCH_END();
}

int main(void)
{
    timing_init();
    timing_start();

    verify_deoxys_aead();

    printk("=== Block Primitive Benchmark ===\n");
    printk("Single block (16 bytes), key schedule pre-computed\n");
    printk("iters=%d, warmup=%d\n\n", BENCH_ITERS, WARMUP_ITERS);
    printk("  %-30s   %10s     %10s\n", "Primitive", "avg cycles", "avg ns");
    printk("  %-30s   %10s     %10s\n",
           "------------------------------", "----------", "----------");

    bench_skinny128_256();
    bench_forkskinny128_256_1leg();
    bench_forkskinny128_256_2leg();
    bench_deoxysbc();
    bench_deoxysbc_opt_full();
    bench_deoxysbc_opt_pre();
    bench_butterknife256(1, "Butterknife-256 1-leg");
    bench_butterknife256(7, "Butterknife-256 7-leg");
    bench_butterknife256(8, "Butterknife-256 8-leg");
    bench_aes128();
    bench_aes256();
    bench_rijndael256();
    timing_stop();

    printk("\nDone (sink=%u).\n", sink);
    return 0;
}
```

## src/rijndael256.c
```c
#include "rijndael256.h"
#include <string.h>

#define R256_NB  8
#define R256_NK  8
#define R256_NR  14

static const uint8_t sbox[256] = {
    0x63,0x7c,0x77,0x7b,0xf2,0x6b,0x6f,0xc5,0x30,0x01,0x67,0x2b,0xfe,0xd7,0xab,0x76,
    0xca,0x82,0xc9,0x7d,0xfa,0x59,0x47,0xf0,0xad,0xd4,0xa2,0xaf,0x9c,0xa4,0x72,0xc0,
    0xb7,0xfd,0x93,0x26,0x36,0x3f,0xf7,0xcc,0x34,0xa5,0xe5,0xf1,0x71,0xd8,0x31,0x15,
    0x04,0xc7,0x23,0xc3,0x18,0x96,0x05,0x9a,0x07,0x12,0x80,0xe2,0xeb,0x27,0xb2,0x75,
    0x09,0x83,0x2c,0x1a,0x1b,0x6e,0x5a,0xa0,0x52,0x3b,0xd6,0xb3,0x29,0xe3,0x2f,0x84,
    0x53,0xd1,0x00,0xed,0x20,0xfc,0xb1,0x5b,0x6a,0xcb,0xbe,0x39,0x4a,0x4c,0x58,0xcf,
    0xd0,0xef,0xaa,0xfb,0x43,0x4d,0x33,0x85,0x45,0xf9,0x02,0x7f,0x50,0x3c,0x9f,0xa8,
    0x51,0xa3,0x40,0x8f,0x92,0x9d,0x38,0xf5,0xbc,0xb6,0xda,0x21,0x10,0xff,0xf3,0xd2,
    0xcd,0x0c,0x13,0xec,0x5f,0x97,0x44,0x17,0xc4,0xa7,0x7e,0x3d,0x64,0x5d,0x19,0x73,
    0x60,0x81,0x4f,0xdc,0x22,0x2a,0x90,0x88,0x46,0xee,0xb8,0x14,0xde,0x5e,0x0b,0xdb,
    0xe0,0x32,0x3a,0x0a,0x49,0x06,0x24,0x5c,0xc2,0xd3,0xac,0x62,0x91,0x95,0xe4,0x79,
    0xe7,0xc8,0x37,0x6d,0x8d,0xd5,0x4e,0xa9,0x6c,0x56,0xf4,0xea,0x65,0x7a,0xae,0x08,
    0xba,0x78,0x25,0x2e,0x1c,0xa6,0xb4,0xc6,0xe8,0xdd,0x74,0x1f,0x4b,0xbd,0x8b,0x8a,
    0x70,0x3e,0xb5,0x66,0x48,0x03,0xf6,0x0e,0x61,0x35,0x57,0xb9,0x86,0xc1,0x1d,0x9e,
    0xe1,0xf8,0x98,0x11,0x69,0xd9,0x8e,0x94,0x9b,0x1e,0x87,0xe9,0xce,0x55,0x28,0xdf,
    0x8c,0xa1,0x89,0x0d,0xbf,0xe6,0x42,0x68,0x41,0x99,0x2d,0x0f,0xb0,0x54,0xbb,0x16
};

static const uint8_t rcon[14] = {
    0x01,0x02,0x04,0x08,0x10,0x20,0x40,0x80,0x1b,0x36,0x6c,0xd8,0xab,0x4d
};

static inline uint8_t xtime(uint8_t a)
{
    return (uint8_t)((a << 1) ^ ((a & 0x80) ? 0x1b : 0x00));
}

static uint32_t sub_word(uint32_t w)
{
    return ((uint32_t)sbox[w >> 24]         << 24) |
           ((uint32_t)sbox[(w >> 16) & 0xff] << 16) |
           ((uint32_t)sbox[(w >>  8) & 0xff] <<  8) |
           ((uint32_t)sbox[w & 0xff]);
}

static uint32_t rot_word(uint32_t w)
{
    return (w << 8) | (w >> 24);
}

void rijndael256_set_key(rijndael256_ctx_t *ctx, const uint8_t key[32])
{
    uint32_t *w = ctx->rk;

    for (int i = 0; i < R256_NK; i++) {
        w[i] = ((uint32_t)key[4*i]     << 24) |
               ((uint32_t)key[4*i + 1] << 16) |
               ((uint32_t)key[4*i + 2] <<  8) |
               ((uint32_t)key[4*i + 3]);
    }

    for (int i = R256_NK; i < (R256_NR + 1) * R256_NB; i++) {
        uint32_t temp = w[i - 1];
        if (i % R256_NK == 0) {
            temp = sub_word(rot_word(temp)) ^ ((uint32_t)rcon[i / R256_NK - 1] << 24);
        } else if (i % R256_NK == 4) {
            temp = sub_word(temp);
        }
        w[i] = w[i - R256_NK] ^ temp;
    }
}

static void add_round_key(uint8_t s[4][R256_NB], const uint32_t *rk)
{
    for (int c = 0; c < R256_NB; c++) {
        s[0][c] ^= (uint8_t)(rk[c] >> 24);
        s[1][c] ^= (uint8_t)(rk[c] >> 16);
        s[2][c] ^= (uint8_t)(rk[c] >>  8);
        s[3][c] ^= (uint8_t)(rk[c]);
    }
}

static void sub_bytes(uint8_t s[4][R256_NB])
{
    for (int r = 0; r < 4; r++)
        for (int c = 0; c < R256_NB; c++)
            s[r][c] = sbox[s[r][c]];
}

/* ShiftRows for Nb=8: row offsets [0, 1, 3, 4] per Rijndael spec */
static void shift_rows(uint8_t s[4][R256_NB])
{
    static const int shift[4] = {0, 1, 3, 4};
    uint8_t tmp[R256_NB];

    for (int r = 1; r < 4; r++) {
        int sh = shift[r];
        for (int c = 0; c < R256_NB; c++)
            tmp[c] = s[r][(c + sh) % R256_NB];
        for (int c = 0; c < R256_NB; c++)
            s[r][c] = tmp[c];
    }
}

static void mix_columns(uint8_t s[4][R256_NB])
{
    for (int c = 0; c < R256_NB; c++) {
        uint8_t a0 = s[0][c], a1 = s[1][c], a2 = s[2][c], a3 = s[3][c];
        s[0][c] = xtime(a0) ^ (xtime(a1) ^ a1) ^ a2           ^ a3;
        s[1][c] = a0        ^ xtime(a1)         ^ (xtime(a2) ^ a2) ^ a3;
        s[2][c] = a0        ^ a1                ^ xtime(a2)    ^ (xtime(a3) ^ a3);
        s[3][c] = (xtime(a0) ^ a0) ^ a1         ^ a2           ^ xtime(a3);
    }
}

void rijndael256_encrypt(const rijndael256_ctx_t *ctx,
                         const uint8_t in[32], uint8_t out[32])
{
    uint8_t s[4][R256_NB];

    for (int c = 0; c < R256_NB; c++)
        for (int r = 0; r < 4; r++)
            s[r][c] = in[4*c + r];

    add_round_key(s, ctx->rk);

    for (int round = 1; round < R256_NR; round++) {
        sub_bytes(s);
        shift_rows(s);
        mix_columns(s);
        add_round_key(s, ctx->rk + round * R256_NB);
    }

    sub_bytes(s);
    shift_rows(s);
    add_round_key(s, ctx->rk + R256_NR * R256_NB);

    /* Store state */
    for (int c = 0; c < R256_NB; c++)
        for (int r = 0; r < 4; r++)
            out[4*c + r] = s[r][c];
}
```

## src/rijndael256.h
```c
#ifndef RIJNDAEL256_H
#define RIJNDAEL256_H

#include <stdint.h>

typedef struct {
    uint32_t rk[120]; /* (Nr+1)*Nb round key words */
} rijndael256_ctx_t;

void rijndael256_set_key(rijndael256_ctx_t *ctx, const uint8_t key[32]);
void rijndael256_encrypt(const rijndael256_ctx_t *ctx,
                         const uint8_t in[32], uint8_t out[32]);

#endif
```
