## CMakeLists.txt
```
cmake_minimum_required(VERSION 3.20.0)
find_package(Zephyr REQUIRED HINTS $ENV{ZEPHYR_BASE})

project(supersonic)

zephyr_include_directories(
    ../BC__Butterknife/include
    ../forkskinny-opt32
    ../deoxysi128/deoxysi128/ref
    ../deoxysi128/deoxysi128
    src
)

target_sources(app PRIVATE
    src/main.c
    src/supersonic-star_butterknife_skinny.c
    src/supersonic-star_butterknife.c
    src/supersonic-star_butterknife_opt.c
    ../deoxysi128/deoxysi128/deoxysbc256_opt.c
    src/supersonic-star_forkskinny.c
    ../BC__Butterknife/source/butterknife256_tks.c
    ../BC__Butterknife/source/butterknife256.c
    ../forkskinny-opt32/internal-forkskinny.c
    ../forkskinny-opt32/skinny.c
    ../deoxysi128/deoxysi128/ref/tweakableBC.c
)
```

## prj.conf
```kconfig
CONFIG_TIMING_FUNCTIONS=y
CONFIG_MAIN_STACK_SIZE=4096

# UART console
CONFIG_UART_CONSOLE=y
CONFIG_CONSOLE=y
```

## src/main.c
```c
#include <zephyr/kernel.h>
#include <zephyr/sys/printk.h>
#include <zephyr/timing/timing.h>

#include <inttypes.h>
#include <stdint.h>
#include <string.h>

#include "include/sonics_ref.h"
#include "include/supersonic_fs_star.h"
#include "include/supersonic_bk_star.h"
#include "include/butterknife.h"

#define WARMUP_ITERS 10
#define BENCH_ITERS  100

typedef void (*supersonic_fn_t)(const uint8_t key[16],
                                uint8_t out_left[16],
                                uint8_t out_right[16],
                                const uint8_t *message,
                                const uint32_t mlen);

static uint8_t msg_buf[4096];
static const uint8_t bench_key[16] = {
    0x00, 0x01, 0x02, 0x03,
    0x04, 0x05, 0x06, 0x07,
    0x08, 0x09, 0x0a, 0x0b,
    0x0c, 0x0d, 0x0e, 0x0f
};

static volatile uint8_t sink;

static void fill_pattern(uint8_t *buf, uint32_t len)
{
    for (uint32_t i = 0; i < len; ++i) {
        buf[i] = (uint8_t)(i & 0xffU);
    }
}

static void bench_supersonic_star_variant(supersonic_fn_t fn, uint32_t mlen,
                                          uint64_t *out_cycles, uint64_t *out_ns)
{
    timing_t start;
    timing_t end;
    uint64_t total_cycles = 0;
    uint64_t total_ns = 0;
    uint8_t out_left[16];
    uint8_t out_right[16];

    fill_pattern(msg_buf, mlen);

    for (int i = 0; i < WARMUP_ITERS; ++i) {
        fn(bench_key, out_left, out_right, msg_buf, mlen);
    }

    for (int i = 0; i < BENCH_ITERS; ++i) {
        start = timing_counter_get();
        fn(bench_key, out_left, out_right, msg_buf, mlen);
        end = timing_counter_get();

        uint64_t cycles = timing_cycles_get(&start, &end);
        total_cycles += cycles;
        total_ns += timing_cycles_to_ns(cycles);
    }

    sink ^= out_left[0] ^ out_right[0];

    *out_cycles = total_cycles;
    *out_ns     = total_ns;
}

#define TOTAL_ITERS (WARMUP_ITERS + BENCH_ITERS)

/* c1: 1-leg primitive call count (accumulated over TOTAL_ITERS).
 * c2: 2-leg primitive call count (accumulated over TOTAL_ITERS). */
static void print_counters(const char *name1, uint32_t c1,
                           const char *name2, uint32_t c2)
{
    uint32_t l1 = c1 / TOTAL_ITERS;
    uint32_t l2 = c2 / TOTAL_ITERS;
    if (l2 > 0)
        printk("    [calls/op] %s=%" PRIu32 "  %s=%" PRIu32 "\n",
               name1, l1, name2, l2);
    else
        printk("    [calls/op] %s=%" PRIu32 "\n",
               name1, l1);
}

static void print_variant(const char *name, uint32_t mlen,
                          uint64_t total_cycles, uint64_t total_ns,
                          uint32_t oneleg, uint32_t twoleg)
{
    uint32_t legs_per_op = (oneleg + 2u * twoleg) / TOTAL_ITERS;

    printk("  %-26s %6u B : %12" PRIu64 " cycles | %12" PRIu64 " ns  [%u legs/op]\n",
           name, mlen,
           total_cycles / BENCH_ITERS,
           total_ns     / BENCH_ITERS,
           legs_per_op);
}

static void bench_size(uint32_t mlen)
{
    uint32_t oneleg, twoleg;
    uint64_t cyc, ns;

    printk("\n[Message size: %u bytes]\n", mlen);

    supersonic_fs_star_reset_counters();
    bench_supersonic_star_variant(supersonic_256_star, mlen, &cyc, &ns);
    supersonic_fs256_star_get_counters(&oneleg, &twoleg);
    print_variant("supersonic_256_forkskinny", mlen, cyc, ns, oneleg, twoleg);
    print_counters("skinny", oneleg, "forkskinny_256", twoleg);

    supersonic_fs_star_reset_counters();
    bench_supersonic_star_variant(supersonic_384_star, mlen, &cyc, &ns);
    supersonic_fs384_star_get_counters(&oneleg, &twoleg);
    print_variant("supersonic_384_forkskinny", mlen, cyc, ns, oneleg, twoleg);
    print_counters("forkskinny_384_enc", oneleg, "forkskinny_384_fork", twoleg);

    supersonic_bk_deoxys_reset_counters();
    bench_supersonic_star_variant(supersonic_256_butterknife_deoxys, mlen, &cyc, &ns);
    supersonic_bk_deoxys_get_counters(&oneleg, &twoleg);
    print_variant("supersonic_256_bk_deoxys", mlen, cyc, ns, oneleg, twoleg);
    print_counters("deoxysBC", oneleg, "butterknife", twoleg);

    supersonic_bk_deoxys_opt_reset_counters();
    bench_supersonic_star_variant(supersonic_256_butterknife_deoxys_opt, mlen, &cyc, &ns);
    supersonic_bk_deoxys_opt_get_counters(&oneleg, &twoleg);
    print_variant("supersonic_256_bk_deoxys_opt", mlen, cyc, ns, oneleg, twoleg);
    print_counters("deoxysBC_opt", oneleg, "butterknife", twoleg);

    supersonic_bk_skinny_reset_counters();
    bench_supersonic_star_variant(supersonic_256_butterknife_skinny, mlen, &cyc, &ns);
    supersonic_bk_skinny_get_counters(&oneleg, &twoleg);
    print_variant("supersonic_256_bk_skinny", mlen, cyc, ns, oneleg, twoleg);
    print_counters("skinny", oneleg, "butterknife", twoleg);
}

/* =========================================================================
 * Verify helpers
 * ========================================================================= */

static void print_hex(const char *label, const uint8_t *buf, uint8_t len)
{
    printk("  %-22s: ", label);
    for (uint8_t i = 0; i < len; i++)
        printk("%02x ", buf[i]);
    printk("\n");
}

/* Verify + averaged timing for 16-byte-output variants. */
static void bench_verify_16(const char *name, supersonic_fn_t fn, uint32_t mlen)
{
    uint8_t ref_L[16], ref_R[16];
    uint8_t chk_L[16], chk_R[16];
    timing_t t0, t1;
    uint64_t total_cyc, total_ns;
    int ok;

    fill_pattern(msg_buf, mlen);
    fn(bench_key, ref_L, ref_R, msg_buf, mlen);

    printk("\n=== Verify: %-30s [%u B] ===\n", name, mlen);
    print_hex("tag_L", ref_L, 16);
    print_hex("tag_R", ref_R, 16);

    /* same message — must MATCH */
    for (int i = 0; i < WARMUP_ITERS; i++)
        fn(bench_key, chk_L, chk_R, msg_buf, mlen);
    total_cyc = total_ns = 0;
    for (int i = 0; i < BENCH_ITERS; i++) {
        t0 = timing_counter_get();
        fn(bench_key, chk_L, chk_R, msg_buf, mlen);
        t1 = timing_counter_get();
        uint64_t c = timing_cycles_get(&t0, &t1);
        total_cyc += c;
        total_ns  += timing_cycles_to_ns(c);
    }
    ok = (memcmp(chk_L, ref_L, 16) == 0 && memcmp(chk_R, ref_R, 16) == 0);
    printk("  verify(same msg):    [%s] %-20s  %12" PRIu64 " cycles | %12" PRIu64 " ns\n",
           ok ? "PASS" : "FAIL",
           ok ? "MATCH" : "MISMATCH (wrong!)",
           total_cyc / BENCH_ITERS, total_ns / BENCH_ITERS);

    /* tampered message — must MISMATCH */
    msg_buf[mlen / 2] ^= 0x01;
    for (int i = 0; i < WARMUP_ITERS; i++)
        fn(bench_key, chk_L, chk_R, msg_buf, mlen);
    total_cyc = total_ns = 0;
    for (int i = 0; i < BENCH_ITERS; i++) {
        t0 = timing_counter_get();
        fn(bench_key, chk_L, chk_R, msg_buf, mlen);
        t1 = timing_counter_get();
        uint64_t c = timing_cycles_get(&t0, &t1);
        total_cyc += c;
        total_ns  += timing_cycles_to_ns(c);
    }
    ok = (memcmp(chk_L, ref_L, 16) != 0 || memcmp(chk_R, ref_R, 16) != 0);
    printk("  verify(tampered):    [%s] %-20s  %12" PRIu64 " cycles | %12" PRIu64 " ns\n",
           ok ? "PASS" : "FAIL",
           ok ? "MISMATCH (correct)" : "MATCH (wrong!)",
           total_cyc / BENCH_ITERS, total_ns / BENCH_ITERS);
    msg_buf[mlen / 2] ^= 0x01;  /* restore */

    sink ^= chk_L[0] ^ chk_R[0];
}

/* Verify + averaged timing for supersonic_192_star (8-byte outputs). */
static void bench_verify_192(uint32_t mlen)
{
    uint8_t ref_L[8], ref_R[8];
    uint8_t chk_L[8], chk_R[8];
    timing_t t0, t1;
    uint64_t total_cyc, total_ns;
    int ok;

    fill_pattern(msg_buf, mlen);
    supersonic_192_star(bench_key, ref_L, ref_R, msg_buf, mlen);

    printk("\n=== Verify: %-30s [%u B] ===\n", "supersonic_192_star", mlen);
    print_hex("tag_L", ref_L, 8);
    print_hex("tag_R", ref_R, 8);

    /* same message — must MATCH */
    for (int i = 0; i < WARMUP_ITERS; i++)
        supersonic_192_star(bench_key, chk_L, chk_R, msg_buf, mlen);
    total_cyc = total_ns = 0;
    for (int i = 0; i < BENCH_ITERS; i++) {
        t0 = timing_counter_get();
        supersonic_192_star(bench_key, chk_L, chk_R, msg_buf, mlen);
        t1 = timing_counter_get();
        uint64_t c = timing_cycles_get(&t0, &t1);
        total_cyc += c;
        total_ns  += timing_cycles_to_ns(c);
    }
    ok = (memcmp(chk_L, ref_L, 8) == 0 && memcmp(chk_R, ref_R, 8) == 0);
    printk("  verify(same msg):    [%s] %-20s  %12" PRIu64 " cycles | %12" PRIu64 " ns\n",
           ok ? "PASS" : "FAIL",
           ok ? "MATCH" : "MISMATCH (wrong!)",
           total_cyc / BENCH_ITERS, total_ns / BENCH_ITERS);

    /* tampered message — must MISMATCH */
    msg_buf[mlen / 2] ^= 0x01;
    for (int i = 0; i < WARMUP_ITERS; i++)
        supersonic_192_star(bench_key, chk_L, chk_R, msg_buf, mlen);
    total_cyc = total_ns = 0;
    for (int i = 0; i < BENCH_ITERS; i++) {
        t0 = timing_counter_get();
        supersonic_192_star(bench_key, chk_L, chk_R, msg_buf, mlen);
        t1 = timing_counter_get();
        uint64_t c = timing_cycles_get(&t0, &t1);
        total_cyc += c;
        total_ns  += timing_cycles_to_ns(c);
    }
    ok = (memcmp(chk_L, ref_L, 8) != 0 || memcmp(chk_R, ref_R, 8) != 0);
    printk("  verify(tampered):    [%s] %-20s  %12" PRIu64 " cycles | %12" PRIu64 " ns\n",
           ok ? "PASS" : "FAIL",
           ok ? "MISMATCH (correct)" : "MATCH (wrong!)",
           total_cyc / BENCH_ITERS, total_ns / BENCH_ITERS);
    msg_buf[mlen / 2] ^= 0x01;  /* restore */

    sink ^= chk_L[0] ^ chk_R[0];
}

static void verify_size(uint32_t mlen)
{
    printk("\n--- Verify [%u bytes] ---", mlen);

    bench_verify_16("supersonic_256_forkskinny",    supersonic_256_star,                   mlen);
    bench_verify_16("supersonic_384_forkskinny",    supersonic_384_star,                   mlen);
    bench_verify_192(mlen);
    bench_verify_16("supersonic_256_bk_deoxys",     supersonic_256_butterknife_deoxys,     mlen);
    bench_verify_16("supersonic_256_bk_deoxys_opt", supersonic_256_butterknife_deoxys_opt, mlen);
    bench_verify_16("supersonic_256_bk_skinny",     supersonic_256_butterknife_skinny,     mlen);
}

int main(void)
{
    timing_init();
    timing_start();

    printk("\n=== Supersonic Star Benchmark (Deoxys / Butterknife / Skinny) ===\n");
    printk("iters=%d, warmup=%d\n", BENCH_ITERS, WARMUP_ITERS);
    printk("format: <variant> <size> : <avg cycles> | <avg ns>  [legs/op]\n");

    bench_size(8);
    bench_size(100);
    bench_size(4096);

    printk("\n\n=== Supersonic Star Verification ===\n");
    printk("format: tag hex | verify result | avg cycles/ns (%d iters, %d warmup)\n",
           BENCH_ITERS, WARMUP_ITERS);

    verify_size(8);
    verify_size(100);
    verify_size(4096);

    printk("\nBenchmark done (sink=%u).\n", sink);
    return 0;
}
```

## src/supersonic-star_butterknife.c
```c
#include <stdint.h>
#include <string.h>
#include <stdlib.h>

#include "include/butterknife.h"
#include "include/sonics_ref.h"
#include "tweakableBC.h"

/* Call counters */
static uint32_t cnt_1leg;
static uint32_t cnt_2leg;

void supersonic_bk_deoxys_reset_counters(void)
{
    cnt_1leg = cnt_2leg = 0;
}

void supersonic_bk_deoxys_get_counters(uint32_t *oneleg, uint32_t *twoleg)
{
    *oneleg = cnt_1leg;
    *twoleg = cnt_2leg;
}

static void arrXOR(uint8_t *out, const uint8_t *right, uint16_t len)
{
    for (uint8_t i = 0; i < len; ++i) {
        out[i] ^= right[i];
    }
}

/* Double Function in GF(2^128) */
static void arrDOUBLE_128(uint8_t out[16])
{
    uint8_t tmp;

    tmp = (out[15] >> 7) & 1;
    for (uint8_t i = 0; i < 15; ++i) {
        out[i] = (out[i] << 1) | ((out[i + 1] >> 7) & 1);
    }
    out[15] = out[15] << 1;
    out[0] ^= 0x87 * tmp;
}

/* ------------------------------------------------------------------------- */
/* Deoxys-I-128 one-leg helper: 2 TK words, 14 rounds       */
/* ------------------------------------------------------------------------- */

static void deoxysBC_256_encrypt_1leg(const uint8_t tk[32],
                                      uint8_t out[16],
                                      const uint8_t in[16])
{
    aesTweakEncrypt(256, in, tk, out);
    cnt_1leg++;
}

static void supersonic_256_round_core(Sonics_256_struct_t *Sonic,
                                      SonicChains *Chains,
                                      uint8_t buffer[SONICS_256_N_SIZE],
                                      uint16_t Nr)
{
    uint8_t tk[32];

    arrXOR(Chains->kt, Sonic->P + SONICS_256_N_SIZE, SONICS_256_K_SIZE);
    arrXOR(Sonic->P, Sonic->mask, SONICS_256_N_SIZE);
    arrXOR(Sonic->P + SONICS_256_N_SIZE, Sonic->K_prime, SONICS_256_K_SIZE);

    Sonic->P[SONICS_256_P_SIZE - 1] = (uint8_t)((Nr + 1) & 0xff);
    Sonic->P[SONICS_256_P_SIZE]     = (uint8_t)(((Nr + 1) & 0x0f00) >> 4);

    memcpy(tk,      Sonic->P + SONICS_256_N_SIZE,                     16);
    memcpy(tk + 16, Sonic->P + SONICS_256_N_SIZE + SONICS_256_K_SIZE, 16);

    deoxysBC_256_encrypt_1leg(tk, buffer, Sonic->P);

    arrXOR(Chains->m, buffer, SONICS_256_N_SIZE);
    arrDOUBLE_128(Chains->m);
    arrXOR(buffer, Sonic->P + SONICS_256_N_SIZE + SONICS_256_K_SIZE, SONICS_256_T_SIZE);
    arrXOR(Chains->kt + SONICS_256_K_SIZE, buffer, SONICS_256_T_SIZE);
}

static void supersonic_256_butterknife_core(
    const uint8_t key[16],
    uint8_t out_left[16],
    uint8_t out_right[16],
    const uint8_t *message,
    const uint32_t mlen)
{
    uint8_t res;
    uint16_t i, numP;
    uint8_t Kmask[SONICS_256_K_SIZE + SONICS_256_N_SIZE];
    uint8_t buffer[32];   /* final Butterknife call returns 2 legs = 32 bytes */
    static uint32_t rtk[4 * (BUTTERKNIFE_ROUNDS + 1)];
    SonicChains Chains;
    Sonics_256_struct_t Sonic;

    res  = mlen % (SONICS_256_P_SIZE - 1);
    numP = (uint16_t)(mlen / (SONICS_256_P_SIZE - 1)) - 1 + (res > 0) * 1;

    Sonic.bk_rtk  = rtk;
    Sonic.K_prime = Kmask;
    Sonic.mask    = Kmask + SONICS_256_K_SIZE;

    memset(Sonic.P, 0, SONICS_256_P_SIZE + 1);
    memset(Chains.m, 0, SONICS_256_N_SIZE);
    memset(Chains.kt, 0, SONICS_256_K_SIZE + SONICS_256_T_SIZE + 1);
    memset(buffer, 0, sizeof(buffer));

    /*
     * 2-leg precompute stays Butterknife:
     * FC(K, 0^t, 0^m) -> K' || mask
     */
    memcpy(Sonic.P, key, SONICS_256_K_SIZE);
    butterknife_256_precompute_rtk(Sonic.P, Sonic.bk_rtk, 2);
    butterknife_256_encrypt_w_rtk(Sonic.bk_rtk, Kmask, Sonic.P + SONICS_256_K_SIZE, 2);
    cnt_2leg++;

    for (i = 0; i < numP; ++i) {
        /*
         * Sonic.P order:
         * M_3i   = input
         * M_3i+1 = key-part
         * M_3i+2 = tweak-part
         */
        memcpy(Sonic.P, message + (SONICS_256_P_SIZE - 1) * i, (SONICS_256_P_SIZE - 1));

        supersonic_256_round_core(&Sonic, &Chains, buffer, i);
    }

    /* Padding */
    memset(Sonic.P, 0, SONICS_256_P_SIZE + 1);
    Sonic.P[res] = SONICS_END_OF_MESSAGE;
    memcpy(Sonic.P,
           message + numP * (SONICS_256_P_SIZE - 1),
           (SONICS_256_P_SIZE - 1) * (res == 0) + res);

    supersonic_256_round_core(&Sonic, &Chains, buffer, numP);

    /* Final 2-leg call stays Butterknife */
    Chains.kt[SONICS_256_K_SIZE + SONICS_256_T_SIZE] = 0b01 + (0b10 * (res > 0));
    arrXOR(Chains.kt, Sonic.K_prime, SONICS_256_K_SIZE);
    arrXOR(Chains.m,  Sonic.mask,    SONICS_256_N_SIZE);

    butterknife_256_precompute_rtk(Chains.kt, Sonic.bk_rtk, 2);
    butterknife_256_encrypt_w_rtk(Sonic.bk_rtk, buffer, Chains.m, 2);
    cnt_2leg++;

    memcpy(out_left,  buffer,     SONICS_256_N_SIZE);
    memcpy(out_right, buffer + 16, SONICS_256_N_SIZE);
}

void supersonic_256_butterknife_deoxys(const uint8_t key[16],
                                       uint8_t out_left[16],
                                       uint8_t out_right[16],
                                       const uint8_t *message,
                                       const uint32_t mlen)
{
    supersonic_256_butterknife_core(key, out_left, out_right, message, mlen);
}
```

## src/supersonic-star_butterknife_opt.c
```c
#include <stdint.h>
#include <string.h>
#include <stdlib.h>

#include "include/butterknife.h"
#include "include/sonics_ref.h"
#include "deoxysbc256_opt.h"

/* Call counters */
static uint32_t cnt_1leg;
static uint32_t cnt_2leg;

void supersonic_bk_deoxys_opt_reset_counters(void)
{
    cnt_1leg = cnt_2leg = 0;
}

void supersonic_bk_deoxys_opt_get_counters(uint32_t *oneleg, uint32_t *twoleg)
{
    *oneleg = cnt_1leg;
    *twoleg = cnt_2leg;
}

static void arrXOR(uint8_t *out, const uint8_t *right, uint16_t len)
{
    for (uint8_t i = 0; i < len; ++i) {
        out[i] ^= right[i];
    }
}

/* Double Function in GF(2^128) */
static void arrDOUBLE_128(uint8_t out[16])
{
    uint8_t tmp;

    tmp = (out[15] >> 7) & 1;
    for (uint8_t i = 0; i < 15; ++i) {
        out[i] = (out[i] << 1) | ((out[i + 1] >> 7) & 1);
    }
    out[15] = out[15] << 1;
    out[0] ^= 0x87 * tmp;
}

/* ------------------------------------------------------------------------- */
/* Deoxys-I-128 one-leg helper: Deoxys-BC-256, 2 TK words, 14 rounds       */
/* ------------------------------------------------------------------------- */

static void deoxysBC_256_encrypt_1leg(const uint8_t tk[32],
                                      uint8_t out[16],
                                      const uint8_t in[16])
{
    deoxysbc256_encrypt_full(tk, in, out);
    cnt_1leg++;
}

/* ------------------------------------------------------------------------- */
/* Shared per-round logic                                                    */
/* ------------------------------------------------------------------------- */

static void supersonic_256_round_core(Sonics_256_struct_t *Sonic,
                                      SonicChains *Chains,
                                      uint8_t buffer[SONICS_256_N_SIZE],
                                      uint16_t Nr)
{
    uint8_t tk[32];

    arrXOR(Chains->kt, Sonic->P + SONICS_256_N_SIZE, SONICS_256_K_SIZE);
    arrXOR(Sonic->P, Sonic->mask, SONICS_256_N_SIZE);
    arrXOR(Sonic->P + SONICS_256_N_SIZE, Sonic->K_prime, SONICS_256_K_SIZE);

    Sonic->P[SONICS_256_P_SIZE - 1] = (uint8_t)((Nr + 1) & 0xff);
    Sonic->P[SONICS_256_P_SIZE]     = (uint8_t)(((Nr + 1) & 0x0f00) >> 4);

    memcpy(tk,      Sonic->P + SONICS_256_N_SIZE,                     16);
    memcpy(tk + 16, Sonic->P + SONICS_256_N_SIZE + SONICS_256_K_SIZE, 16);

    deoxysBC_256_encrypt_1leg(tk, buffer, Sonic->P);

    arrXOR(Chains->m, buffer, SONICS_256_N_SIZE);
    arrDOUBLE_128(Chains->m);
    arrXOR(buffer, Sonic->P + SONICS_256_N_SIZE + SONICS_256_K_SIZE, SONICS_256_T_SIZE);
    arrXOR(Chains->kt + SONICS_256_K_SIZE, buffer, SONICS_256_T_SIZE);
}

/* ------------------------------------------------------------------------- */
/* Shared driver                                                             */
/* ------------------------------------------------------------------------- */

static void supersonic_256_butterknife_core(
    const uint8_t key[16],
    uint8_t out_left[16],
    uint8_t out_right[16],
    const uint8_t *message,
    const uint32_t mlen)
{
    uint8_t res;
    uint16_t i, numP;
    uint8_t Kmask[SONICS_256_K_SIZE + SONICS_256_N_SIZE];
    uint8_t buffer[32];   /* final Butterknife call returns 2 legs = 32 bytes */
    static uint32_t rtk[4 * (BUTTERKNIFE_ROUNDS + 1)];
    SonicChains Chains;
    Sonics_256_struct_t Sonic;

    res  = mlen % (SONICS_256_P_SIZE - 1);
    numP = (uint16_t)(mlen / (SONICS_256_P_SIZE - 1)) - 1 + (res > 0) * 1;

    Sonic.bk_rtk  = rtk;
    Sonic.K_prime = Kmask;
    Sonic.mask    = Kmask + SONICS_256_K_SIZE;

    memset(Sonic.P, 0, SONICS_256_P_SIZE + 1);
    memset(Chains.m, 0, SONICS_256_N_SIZE);
    memset(Chains.kt, 0, SONICS_256_K_SIZE + SONICS_256_T_SIZE + 1);
    memset(buffer, 0, sizeof(buffer));

    /*
     * 2-leg precompute stays Butterknife:
     * FC(K, 0^t, 0^m) -> K' || mask
     */
    memcpy(Sonic.P, key, SONICS_256_K_SIZE);
    butterknife_256_precompute_rtk(Sonic.P, Sonic.bk_rtk, 2);
    butterknife_256_encrypt_w_rtk(Sonic.bk_rtk, Kmask, Sonic.P + SONICS_256_K_SIZE, 2);
    cnt_2leg++;

    for (i = 0; i < numP; ++i) {
        /*
         * Sonic.P order:
         * M_3i   = input
         * M_3i+1 = key-part
         * M_3i+2 = tweak-part
         */
        memcpy(Sonic.P, message + (SONICS_256_P_SIZE - 1) * i, (SONICS_256_P_SIZE - 1));

        supersonic_256_round_core(&Sonic, &Chains, buffer, i);
    }

    /* Padding */
    memset(Sonic.P, 0, SONICS_256_P_SIZE + 1);
    Sonic.P[res] = SONICS_END_OF_MESSAGE;
    memcpy(Sonic.P,
           message + numP * (SONICS_256_P_SIZE - 1),
           (SONICS_256_P_SIZE - 1) * (res == 0) + res);

    supersonic_256_round_core(&Sonic, &Chains, buffer, numP);

    /* Final 2-leg call stays Butterknife */
    Chains.kt[SONICS_256_K_SIZE + SONICS_256_T_SIZE] = 0b01 + (0b10 * (res > 0));
    arrXOR(Chains.kt, Sonic.K_prime, SONICS_256_K_SIZE);
    arrXOR(Chains.m,  Sonic.mask,    SONICS_256_N_SIZE);

    butterknife_256_precompute_rtk(Chains.kt, Sonic.bk_rtk, 2);
    butterknife_256_encrypt_w_rtk(Sonic.bk_rtk, buffer, Chains.m, 2);
    cnt_2leg++;

    memcpy(out_left,  buffer,     SONICS_256_N_SIZE);
    memcpy(out_right, buffer + 16, SONICS_256_N_SIZE);
}

void supersonic_256_butterknife_deoxys_opt(const uint8_t key[16],
                                           uint8_t out_left[16],
                                           uint8_t out_right[16],
                                           const uint8_t *message,
                                           const uint32_t mlen)
{
    supersonic_256_butterknife_core(key, out_left, out_right, message, mlen);
}
```

## src/supersonic-star_butterknife_skinny.c
```c
#include <stdint.h>
#include <string.h>
#include <stdlib.h>

#include "include/butterknife.h"
#include "include/sonics_ref.h"
#include "skinny.h"

#define SUPERSONIC_STAR_BK256_ROUNDS 48u

/* Call counters */
static uint32_t cnt_1leg;
static uint32_t cnt_2leg;

void supersonic_bk_skinny_reset_counters(void)
{
    cnt_1leg = cnt_2leg = 0;
}

void supersonic_bk_skinny_get_counters(uint32_t *oneleg, uint32_t *twoleg)
{
    *oneleg = cnt_1leg;
    *twoleg = cnt_2leg;
}

static void arrXOR(uint8_t *out, const uint8_t *right, uint16_t len)
{
    for (uint8_t i = 0; i < len; ++i) {
        out[i] ^= right[i];
    }
}

/* Double Function in GF(2^128) */
static void arrDOUBLE_128(uint8_t out[16])
{
    uint8_t tmp;

    tmp = (out[15] >> 7) & 1;
    for (uint8_t i = 0; i < 15; ++i) {
        out[i] = (out[i] << 1) | ((out[i + 1] >> 7) & 1);
    }
    out[15] = out[15] << 1;
    out[0] ^= 0x87 * tmp;
}

/* ------------------------------------------------------------------------- */
/* one-leg helpers                                       */
/* ------------------------------------------------------------------------- */

/*
 * EXACT helper:
 * same low-level pattern as deoxys.c:
 *   TK1 = key part
 *   TK2 = tweak part
 *   full-round SKINNY-128-256 with tweakey schedules
 */
static void deoxysBC_256_encrypt_exact(const uint8_t tk[32],
                                       uint8_t out[16],
                                       const uint8_t in[16])
{
    static skinny_128_256_tweakey_schedule_t tks1, tks2;

    skinny_128_256_init_tk1(&tks1, tk,      SKINNY_128_256_ROUNDS);
    skinny_128_256_init_tk2(&tks2, tk + 16, SKINNY_128_256_ROUNDS);
    skinny_128_256_encrypt_with_tks(&tks1, &tks2, out, in);
}

/*
 * STAR helper:
 * same but reduced rounds for speed testing.
 */
static void deoxysBC_256_encrypt_star(const uint8_t tk[32],
                                      uint8_t out[16],
                                      const uint8_t in[16])
{
    static skinny_128_256_tweakey_schedule_t tks1, tks2;
    skinny_128_256_state_t state;

    skinny_128_256_init_tk1(&tks1, tk,      SUPERSONIC_STAR_BK256_ROUNDS);
    skinny_128_256_init_tk2(&tks2, tk + 16, SUPERSONIC_STAR_BK256_ROUNDS);

    state.S[0] = le_load_word32(in);
    state.S[1] = le_load_word32(in + 4);
    state.S[2] = le_load_word32(in + 8);
    state.S[3] = le_load_word32(in + 12);

    skinny_128_256_rounds(&state, &tks1, &tks2, 0, SUPERSONIC_STAR_BK256_ROUNDS);
    cnt_1leg++;

    le_store_word32(out,      state.S[0]);
    le_store_word32(out + 4,  state.S[1]);
    le_store_word32(out + 8,  state.S[2]);
    le_store_word32(out + 12, state.S[3]);
}

static void supersonic_256_round_exact(Sonics_256_struct_t *Sonic,
                                       SonicChains *Chains,
                                       uint8_t buffer[SONICS_256_N_SIZE],
                                       uint16_t Nr)
{
    uint8_t tk[32];

    /* Round function */
    arrXOR(Chains->kt, Sonic->P + SONICS_256_N_SIZE, SONICS_256_K_SIZE);             /* k-chain */
    arrXOR(Sonic->P, Sonic->mask, SONICS_256_N_SIZE);                                 /* input-block */
    arrXOR(Sonic->P + SONICS_256_N_SIZE, Sonic->K_prime, SONICS_256_K_SIZE);          /* key-block */

    /* Set counter into 12 bits but keep last 4 empty */
    Sonic->P[SONICS_256_P_SIZE - 1] = (uint8_t)((Nr + 1) & 0xff);
    Sonic->P[SONICS_256_P_SIZE]     = (uint8_t)(((Nr + 1) & 0x0f00) >> 4);

    /*
     * Deoxys-BC-256 tweakey = KEY || TWEAK
     */
    memcpy(tk,      Sonic->P + SONICS_256_N_SIZE,                     16);
    memcpy(tk + 16, Sonic->P + SONICS_256_N_SIZE + SONICS_256_K_SIZE, 16);

    deoxysBC_256_encrypt_exact(tk, buffer, Sonic->P);

    arrXOR(Chains->m, buffer, SONICS_256_N_SIZE);                                    /* m-chain */
    arrDOUBLE_128(Chains->m);
    arrXOR(buffer, Sonic->P + SONICS_256_N_SIZE + SONICS_256_K_SIZE, SONICS_256_T_SIZE); /* t-chain */
    arrXOR(Chains->kt + SONICS_256_K_SIZE, buffer, SONICS_256_T_SIZE);
}

static void supersonic_256_round_star(Sonics_256_struct_t *Sonic,
                                      SonicChains *Chains,
                                      uint8_t buffer[SONICS_256_N_SIZE],
                                      uint16_t Nr)
{
    uint8_t tk[32];

    /* Round function */
    arrXOR(Chains->kt, Sonic->P + SONICS_256_N_SIZE, SONICS_256_K_SIZE);             /* k-chain */
    arrXOR(Sonic->P, Sonic->mask, SONICS_256_N_SIZE);                                 /* input-block */
    arrXOR(Sonic->P + SONICS_256_N_SIZE, Sonic->K_prime, SONICS_256_K_SIZE);          /* key-block */

    /* Set counter into 12 bits but keep last 4 empty */
    Sonic->P[SONICS_256_P_SIZE - 1] = (uint8_t)((Nr + 1) & 0xff);
    Sonic->P[SONICS_256_P_SIZE]     = (uint8_t)(((Nr + 1) & 0x0f00) >> 4);

    /*
     * Deoxys-BC-256 tweakey = KEY || TWEAK
     */
    memcpy(tk,      Sonic->P + SONICS_256_N_SIZE,                     16);
    memcpy(tk + 16, Sonic->P + SONICS_256_N_SIZE + SONICS_256_K_SIZE, 16);

    deoxysBC_256_encrypt_star(tk, buffer, Sonic->P);

    arrXOR(Chains->m, buffer, SONICS_256_N_SIZE);                                    /* m-chain */
    arrDOUBLE_128(Chains->m);
    arrXOR(buffer, Sonic->P + SONICS_256_N_SIZE + SONICS_256_K_SIZE, SONICS_256_T_SIZE); /* t-chain */
    arrXOR(Chains->kt + SONICS_256_K_SIZE, buffer, SONICS_256_T_SIZE);
}

static void supersonic_256_butterknife_core(
    const uint8_t key[16],
    uint8_t out_left[16],
    uint8_t out_right[16],
    const uint8_t *message,
    const uint32_t mlen,
    int use_star)
{
    uint8_t res;
    uint16_t i, numP;
    uint8_t Kmask[SONICS_256_K_SIZE + SONICS_256_N_SIZE];
    uint8_t buffer[32];   /* final Butterknife call returns 2 legs = 32 bytes */
    static uint32_t rtk[4 * (BUTTERKNIFE_ROUNDS + 1)];
    SonicChains Chains;
    Sonics_256_struct_t Sonic;

    res  = mlen % (SONICS_256_P_SIZE - 1);
    numP = (uint16_t)(mlen / (SONICS_256_P_SIZE - 1)) - 1 + (res > 0) * 1;

    Sonic.bk_rtk  = rtk;
    Sonic.K_prime = Kmask;
    Sonic.mask    = Kmask + SONICS_256_K_SIZE;

    memset(Sonic.P, 0, SONICS_256_P_SIZE + 1);
    memset(Chains.m, 0, SONICS_256_N_SIZE);
    memset(Chains.kt, 0, SONICS_256_K_SIZE + SONICS_256_T_SIZE + 1);
    memset(buffer, 0, sizeof(buffer));

    /*
     * 2-leg precompute stays Butterknife:
     * FC(K, 0^t, 0^m) -> K' || mask
     */
    memcpy(Sonic.P, key, SONICS_256_K_SIZE);
    butterknife_256_precompute_rtk(Sonic.P, Sonic.bk_rtk, 2);
    butterknife_256_encrypt_w_rtk(Sonic.bk_rtk, Kmask, Sonic.P + SONICS_256_K_SIZE, 2);
    cnt_2leg++;

    for (i = 0; i < numP; ++i) {
        /*
         * Sonic.P order:
         * M_3i   = input
         * M_3i+1 = key-part
         * M_3i+2 = tweak-part
         */
        memcpy(Sonic.P, message + (SONICS_256_P_SIZE - 1) * i, (SONICS_256_P_SIZE - 1));

        if (use_star) {
            supersonic_256_round_star(&Sonic, &Chains, buffer, i);
        } else {
            supersonic_256_round_exact(&Sonic, &Chains, buffer, i);
        }
    }

    /* Padding */
    memset(Sonic.P, 0, SONICS_256_P_SIZE + 1);
    Sonic.P[res] = SONICS_END_OF_MESSAGE;
    memcpy(Sonic.P,
           message + numP * (SONICS_256_P_SIZE - 1),
           (SONICS_256_P_SIZE - 1) * (res == 0) + res);

    if (use_star) {
        supersonic_256_round_star(&Sonic, &Chains, buffer, numP);
    } else {
        supersonic_256_round_exact(&Sonic, &Chains, buffer, numP);
    }

    /* Final 2-leg call stays Butterknife */
    Chains.kt[SONICS_256_K_SIZE + SONICS_256_T_SIZE] = 0b01 + (0b10 * (res > 0));
    arrXOR(Chains.kt, Sonic.K_prime, SONICS_256_K_SIZE);
    arrXOR(Chains.m,  Sonic.mask,    SONICS_256_N_SIZE);

    butterknife_256_precompute_rtk(Chains.kt, Sonic.bk_rtk, 2);
    butterknife_256_encrypt_w_rtk(Sonic.bk_rtk, buffer, Chains.m, 2);
    cnt_2leg++;

    memcpy(out_left,  buffer,     SONICS_256_N_SIZE);
    memcpy(out_right, buffer + 16, SONICS_256_N_SIZE);
}

void supersonic_256_butterknife_skinny(const uint8_t key[16],
                                       uint8_t out_left[16],
                                       uint8_t out_right[16],
                                       const uint8_t *message,
                                       const uint32_t mlen)
{
    supersonic_256_butterknife_core(key, out_left, out_right, message, mlen, 1);
}
```

## src/supersonic-star_forkskinny.c
```c
#include <stdint.h>
#include <stdint.h>
#include <string.h>
#include <stdbool.h>
#include "butterknife.h"
#include "include/sonics_ref.h"
#include "internal-forkskinny.h"
#include "skinny.h"

#define SUPERSONIC_STAR_256_ROUNDS 48u
#define SUPERSONIC_STAR_192_ROUNDS 40u

/* Call counters (reset via supersonic_fs_star_reset_counters) */
static uint32_t cnt_256_1leg;
static uint32_t cnt_256_2leg;
static uint32_t cnt_384_1leg;
static uint32_t cnt_384_2leg;

void supersonic_fs_star_reset_counters(void)
{
    cnt_256_1leg = cnt_256_2leg = 0;
    cnt_384_1leg = cnt_384_2leg = 0;
}

void supersonic_fs256_star_get_counters(uint32_t *oneleg, uint32_t *twoleg)
{
    *oneleg = cnt_256_1leg;
    *twoleg = cnt_256_2leg;
}

void supersonic_fs384_star_get_counters(uint32_t *oneleg, uint32_t *twoleg)
{
    *oneleg = cnt_384_1leg;
    *twoleg = cnt_384_2leg;
}

static void arrXOR(uint8_t *out, const uint8_t *right, uint16_t len)
{
    for (uint8_t i = 0; i < len; ++i) {
        out[i] ^= right[i];
    }
}

/* Double Function in GF(2^128) */
static void arrDOUBLE_128(uint8_t out[16])
{
    uint8_t tmp;

    tmp = (out[15] >> 7) & 1;
    for (uint8_t i = 0; i < 15; ++i) {
        out[i] = (out[i] << 1) | ((out[i + 1] >> 7) & 1);
    }
    out[15] = out[15] << 1;
    out[0] ^= 0x87 * tmp;
}

/* Double Function in GF(2^64) */
static void arrDOUBLE_64(uint8_t out[8])
{
    uint8_t tmp;

    tmp = (out[7] >> 7) & 1;
    for (uint8_t i = 0; i < 7; ++i) {
        out[i] = (out[i] << 1) | ((out[i + 1] >> 7) & 1);
    }
    out[7] = out[7] << 1;
    out[0] ^= 0x1b * tmp;
}

static void skinny_128_256_oneleg_star(uint8_t out[16],
                                       const uint8_t input[16],
                                       const uint8_t key_part[16],
                                       const uint8_t tweak_part[16])
{
    static skinny_128_256_tweakey_schedule_t tks1, tks2;
    skinny_128_256_state_t state;
    uint8_t tk[32];

    memcpy(tk, key_part, 16);
    memcpy(tk + 16, tweak_part, 16);

    skinny_128_256_init_tks(&tks1, &tks2, tk, SUPERSONIC_STAR_256_ROUNDS);

    state.S[0] = le_load_word32(input);
    state.S[1] = le_load_word32(input + 4);
    state.S[2] = le_load_word32(input + 8);
    state.S[3] = le_load_word32(input + 12);

    skinny_128_256_rounds(&state, &tks1, &tks2, 0, SUPERSONIC_STAR_256_ROUNDS);
    cnt_256_1leg++;

    le_store_word32(out,      state.S[0]);
    le_store_word32(out + 4,  state.S[1]);
    le_store_word32(out + 8,  state.S[2]);
    le_store_word32(out + 12, state.S[3]);
}

static void skinny_64_192_oneleg_star(uint8_t out[8],
                                      const uint8_t input[8],
                                      const uint8_t key_part[16],
                                      const uint8_t tweak_part[8])
{
    static skinny_64_192_tweakey_schedule_t tks1, tks2;
    skinny_64_192_state_t state;

    skinny_64_192_init_keypart(&tks1, key_part, SUPERSONIC_STAR_192_ROUNDS);
    skinny_64_192_init_tweakpart(&tks2, tweak_part, SUPERSONIC_STAR_192_ROUNDS);

    state.S[0] = le_load_word16(input);
    state.S[1] = le_load_word16(input + 2);
    state.S[2] = le_load_word16(input + 4);
    state.S[3] = le_load_word16(input + 6);

    skinny_64_192_rounds_wtks2(&state, &tks1, &tks2, 0, SUPERSONIC_STAR_192_ROUNDS);

    le_store_word16(out,     state.S[0]);
    le_store_word16(out + 2, state.S[1]);
    le_store_word16(out + 4, state.S[2]);
    le_store_word16(out + 6, state.S[3]);
}

static void supersonic_384_round_fork(Sonics_384_struct_t *Sonic,
                                      SonicChains *Chains,
                                      uint8_t buffer[SONICS_384_K_SIZE + SONICS_384_T_SIZE + 1],
                                      uint16_t Nr)
{
    arrXOR(Chains->kt, Sonic->P + SONICS_384_N_SIZE, SONICS_384_K_SIZE);
    arrXOR(Sonic->P, Sonic->mask, SONICS_384_N_SIZE);
    arrXOR(Sonic->P + SONICS_384_N_SIZE, Sonic->K_prime, SONICS_384_K_SIZE);

    Sonic->P[SONICS_384_P_SIZE - 1] = (uint8_t)((Nr + 1) & 0xff);
    Sonic->P[SONICS_384_P_SIZE]     = (uint8_t)(((Nr + 1) & 0x0f00) >> 4);

    forkskinny_128_384_init_tks_part(
        Sonic->fs_tks1,
        Sonic->P + SONICS_384_N_SIZE,
        FORKSKINNY_128_384_ROUNDS_BEFORE + FORKSKINNY_128_384_ROUNDS_AFTER, 0
    );
    forkskinny_128_384_init_tks_part(
        Sonic->fs_tks2,
        Sonic->P + SONICS_384_N_SIZE + SONICS_384_K_SIZE,
        FORKSKINNY_128_384_ROUNDS_BEFORE + FORKSKINNY_128_384_ROUNDS_AFTER, 1
    );
    forkskinny_128_384_init_tks_part(
        Sonic->fs_tks3,
        Sonic->P + SONICS_384_N_SIZE + SONICS_384_K_SIZE * 2,
        FORKSKINNY_128_384_ROUNDS_BEFORE + FORKSKINNY_128_384_ROUNDS_AFTER, 2
    );
    forkskinny_128_384_encrypt_with_tks(Sonic->fs_tks1, Sonic->fs_tks2, Sonic->fs_tks3, 0, buffer, Sonic->P);
    cnt_384_1leg++;

    arrXOR(Chains->m, buffer, SONICS_384_N_SIZE);
    arrDOUBLE_128(Chains->m);
    arrXOR(buffer, Sonic->P + SONICS_384_N_SIZE + SONICS_384_K_SIZE, SONICS_384_T_SIZE);
    arrXOR(Chains->kt + SONICS_384_K_SIZE, buffer, SONICS_384_T_SIZE);
}

static void supersonic_256_round_star(Sonics_256_struct_t *Sonic,
                                      SonicChains *Chains,
                                      uint8_t buffer[SONICS_256_N_SIZE],
                                      uint16_t Nr)
{
    arrXOR(Chains->kt, Sonic->P + SONICS_256_N_SIZE, SONICS_256_K_SIZE);
    arrXOR(Sonic->P, Sonic->mask, SONICS_256_N_SIZE);
    arrXOR(Sonic->P + SONICS_256_N_SIZE, Sonic->K_prime, SONICS_256_K_SIZE);

    Sonic->P[SONICS_256_P_SIZE - 1] = (uint8_t)((Nr + 1) & 0xff);
    Sonic->P[SONICS_256_P_SIZE]     = (uint8_t)(((Nr + 1) & 0x0f00) >> 4);

    skinny_128_256_oneleg_star(
        buffer,
        Sonic->P,
        Sonic->P + SONICS_256_N_SIZE,
        Sonic->P + SONICS_256_N_SIZE + SONICS_256_K_SIZE
    );

    arrXOR(Chains->m, buffer, SONICS_256_N_SIZE);
    arrDOUBLE_128(Chains->m);
    arrXOR(buffer, Sonic->P + SONICS_256_N_SIZE + SONICS_256_K_SIZE, SONICS_256_T_SIZE);
    arrXOR(Chains->kt + SONICS_256_K_SIZE, buffer, SONICS_256_T_SIZE);
}

static void supersonic_192_round_star(Sonics_192_struct_t *Sonic,
                                      SonicChains *Chains,
                                      uint8_t buffer[SONICS_192_N_SIZE],
                                      uint16_t Nr)
{
    arrXOR(Chains->kt, Sonic->P + SONICS_192_N_SIZE, SONICS_192_K_SIZE);
    arrXOR(Sonic->P, Sonic->mask, SONICS_192_N_SIZE);
    arrXOR(Sonic->P + SONICS_192_N_SIZE, Sonic->K_prime, SONICS_192_K_SIZE);

    Sonic->P[SONICS_192_P_SIZE - 1] = (uint8_t)((Nr + 1) & 0xff);
    Sonic->P[SONICS_192_P_SIZE]     = (uint8_t)(((Nr + 1) & 0x0f00) >> 4);

    skinny_64_192_oneleg_star(
        buffer,
        Sonic->P,
        Sonic->P + SONICS_192_N_SIZE,
        Sonic->P + SONICS_192_N_SIZE + SONICS_192_K_SIZE
    );

    arrXOR(Chains->m, buffer, SONICS_192_N_SIZE);
    arrDOUBLE_64(Chains->m);
    arrXOR(buffer, Sonic->P + SONICS_192_N_SIZE + SONICS_192_K_SIZE, SONICS_192_T_SIZE);
    arrXOR(Chains->kt + SONICS_192_K_SIZE, buffer, SONICS_192_T_SIZE);
}

void supersonic_384_star(const uint8_t key[16],
                         uint8_t out_left[16], uint8_t out_right[16],
                         const uint8_t *message, const uint32_t mlen)
{
    uint8_t res;
    uint16_t i, numP;
    uint8_t K_prime[SONICS_384_K_SIZE], mask[SONICS_384_N_SIZE];
    uint8_t buffer[SONICS_384_K_SIZE + SONICS_384_T_SIZE + 1];
    static forkskinny_128_384_tweakey_schedule_t tks1, tks2, tks3;
    SonicChains Chains;
    Sonics_384_struct_t Sonic;

    res  = mlen % (SONICS_384_P_SIZE - 1);
    numP = (uint16_t)(mlen / (SONICS_384_P_SIZE - 1)) - 1 + (res > 0) * 1;

    Sonic.fs_tks1 = &tks1;
    Sonic.fs_tks2 = &tks2;
    Sonic.fs_tks3 = &tks3;
    Sonic.K_prime = K_prime;
    Sonic.mask = mask;
    memset(Sonic.P, 0, SONICS_384_P_SIZE + 1);
    memset(Chains.m, 0, SONICS_384_N_SIZE);
    memset(Chains.kt, 0, SONICS_384_K_SIZE + SONICS_384_T_SIZE + 1);
    memset(buffer, 0, sizeof(buffer));

    forkskinny_128_384_init_tks_part(
        Sonic.fs_tks1, key,
        FORKSKINNY_128_384_ROUNDS_BEFORE + 2 * FORKSKINNY_128_384_ROUNDS_AFTER, 0
    );
    forkskinny_128_384_init_tks_part(
        Sonic.fs_tks2, Sonic.P,
        FORKSKINNY_128_384_ROUNDS_BEFORE + 2 * FORKSKINNY_128_384_ROUNDS_AFTER, 1
    );
    forkskinny_128_384_init_tks_part(
        Sonic.fs_tks3, Sonic.P,
        FORKSKINNY_128_384_ROUNDS_BEFORE + 2 * FORKSKINNY_128_384_ROUNDS_AFTER, 2
    );
    forkskinny_128_384_encrypt_with_tks(
        Sonic.fs_tks1, Sonic.fs_tks2, Sonic.fs_tks3,
        Sonic.K_prime, Sonic.mask, Sonic.P
    );
    cnt_384_2leg++;

    for (i = 0; i < numP; ++i) {
        memcpy(Sonic.P, message + (SONICS_384_P_SIZE - 1) * i, (SONICS_384_P_SIZE - 1));
        supersonic_384_round_fork(&Sonic, &Chains, buffer, i);
    }

    memset(Sonic.P, 0, SONICS_384_P_SIZE + 1);
    Sonic.P[res] = SONICS_END_OF_MESSAGE;
    memcpy(Sonic.P, message + numP * (SONICS_384_P_SIZE - 1), (SONICS_384_P_SIZE - 1) * (res == 0) + res);
    supersonic_384_round_fork(&Sonic, &Chains, buffer, numP);

    Chains.kt[SONICS_384_K_SIZE + SONICS_384_T_SIZE] = 0b01 + (0b10 * (res > 0));
    arrXOR(Chains.kt, Sonic.K_prime, SONICS_384_K_SIZE);
    arrXOR(Chains.m,  Sonic.mask, SONICS_384_N_SIZE);

    forkskinny_128_384_init_tks_part(
        Sonic.fs_tks1, Chains.kt,
        FORKSKINNY_128_384_ROUNDS_BEFORE + 2 * FORKSKINNY_128_384_ROUNDS_AFTER, 0
    );
    forkskinny_128_384_init_tks_part(
        Sonic.fs_tks2, Chains.kt + SONICS_384_K_SIZE,
        FORKSKINNY_128_384_ROUNDS_BEFORE + 2 * FORKSKINNY_128_384_ROUNDS_AFTER, 1
    );
    forkskinny_128_384_init_tks_part(
        Sonic.fs_tks3, Chains.kt + SONICS_384_K_SIZE * 2,
        FORKSKINNY_128_384_ROUNDS_BEFORE + 2 * FORKSKINNY_128_384_ROUNDS_AFTER, 2
    );
    forkskinny_128_384_encrypt_with_tks(
        Sonic.fs_tks1, Sonic.fs_tks2, Sonic.fs_tks3,
        out_left, out_right, Chains.m
    );
    cnt_384_2leg++;
}

void supersonic_256_star(const uint8_t key[16],
                         uint8_t out_left[16], uint8_t out_right[16],
                         const uint8_t *message, const uint32_t mlen)
{
    uint8_t res;
    uint16_t i, numP;
    uint8_t K_prime[SONICS_256_K_SIZE], mask[SONICS_256_N_SIZE], buffer[SONICS_256_N_SIZE];
    static forkskinny_128_256_tweakey_schedule_t tks1, tks2;
    SonicChains Chains;
    Sonics_256_struct_t Sonic;

    res  = mlen % (SONICS_256_P_SIZE - 1);
    numP = (uint16_t)(mlen / (SONICS_256_P_SIZE - 1)) - 1 + (res > 0) * 1;

    Sonic.fs_tks1 = &tks1;
    Sonic.fs_tks2 = &tks2;
    Sonic.K_prime = K_prime;
    Sonic.mask = mask;
    memset(Sonic.P, 0, SONICS_256_P_SIZE + 1);
    memset(Chains.m, 0, SONICS_256_N_SIZE);
    memset(Chains.kt, 0, SONICS_256_K_SIZE + SONICS_256_T_SIZE + 1);
    memset(buffer, 0, sizeof(buffer));

    /* FC(K, 0^t, 0^m) -> K' and mask */
    forkskinny_128_256_init_tks_part(
        Sonic.fs_tks1, key,
        FORKSKINNY_128_256_ROUNDS_BEFORE + 2 * FORKSKINNY_128_256_ROUNDS_AFTER, 0
    );
    forkskinny_128_256_init_tks_part(
        Sonic.fs_tks2, Sonic.P,
        FORKSKINNY_128_256_ROUNDS_BEFORE + 2 * FORKSKINNY_128_256_ROUNDS_AFTER, 1
    );
    forkskinny_128_256_encrypt_with_tks(
        Sonic.fs_tks1, Sonic.fs_tks2,
        Sonic.K_prime, Sonic.mask, Sonic.P
    );
    cnt_256_2leg++;

    for (i = 0; i < numP; ++i) {
        memcpy(Sonic.P, message + (SONICS_256_P_SIZE - 1) * i, (SONICS_256_P_SIZE - 1));
        supersonic_256_round_star(&Sonic, &Chains, buffer, i);
    }

    memset(Sonic.P, 0, SONICS_256_P_SIZE + 1);
    Sonic.P[res] = SONICS_END_OF_MESSAGE;
    memcpy(Sonic.P, message + numP * (SONICS_256_P_SIZE - 1), (SONICS_256_P_SIZE - 1) * (res == 0) + res);
    supersonic_256_round_star(&Sonic, &Chains, buffer, numP);

    Chains.kt[SONICS_256_K_SIZE + SONICS_256_T_SIZE] = 0b01 + (0b10 * (res > 0));
    arrXOR(Chains.kt, Sonic.K_prime, SONICS_256_K_SIZE);
    arrXOR(Chains.m,  Sonic.mask, SONICS_256_N_SIZE);

    forkskinny_128_256_init_tks_part(
        Sonic.fs_tks1, Chains.kt,
        FORKSKINNY_128_256_ROUNDS_BEFORE + 2 * FORKSKINNY_128_256_ROUNDS_AFTER, 0
    );
    forkskinny_128_256_init_tks_part(
        Sonic.fs_tks2, Chains.kt + SONICS_256_K_SIZE,
        FORKSKINNY_128_256_ROUNDS_BEFORE + 2 * FORKSKINNY_128_256_ROUNDS_AFTER, 1
    );
    forkskinny_128_256_encrypt_with_tks(
        Sonic.fs_tks1, Sonic.fs_tks2,
        out_left, out_right, Chains.m
    );
    cnt_256_2leg++;
}

void supersonic_192_star(const uint8_t key[16],
                         uint8_t out_left[8], uint8_t out_right[8],
                         const uint8_t *message, const uint32_t mlen)
{
    uint8_t res;
    uint16_t i, numP;
    uint8_t K_prime[SONICS_192_K_SIZE], mask[SONICS_192_N_SIZE], buffer[SONICS_192_N_SIZE];
    static forkskinny_64_192_tweakey_schedule_t tks1, tks2;
    SonicChains Chains;
    Sonics_192_struct_t Sonic;

    res  = mlen % (SONICS_192_P_SIZE - 1);
    numP = (uint16_t)(mlen / (SONICS_192_P_SIZE - 1)) - 1 + (res > 0) * 1;

    Sonic.fs_tks1 = &tks1;
    Sonic.fs_tks2 = &tks2;
    Sonic.K_prime = K_prime;
    Sonic.mask = mask;
    memset(Sonic.P, 0, SONICS_192_P_SIZE + 1);
    memset(Chains.m, 0, SONICS_192_N_SIZE);
    memset(Chains.kt, 0, SONICS_192_K_SIZE + SONICS_192_T_SIZE + 1);
    memset(buffer, 0, sizeof(buffer));

    /* FC(K, 0^t, 0^m) -> K' and mask */
    forkskinny_64_192_init_tks_keypart(
        Sonic.fs_tks1, key,
        FORKSKINNY_64_192_ROUNDS_BEFORE + 2 * FORKSKINNY_64_192_ROUNDS_AFTER
    );
    forkskinny_64_192_init_tks_tweakpart(
        Sonic.fs_tks2, Sonic.P,
        FORKSKINNY_64_192_ROUNDS_BEFORE + 2 * FORKSKINNY_64_192_ROUNDS_AFTER
    );
    forkskinny_64_192_encrypt_with_tks(
        Sonic.fs_tks1, Sonic.fs_tks2,
        Sonic.K_prime, Sonic.K_prime + SONICS_192_K_SIZE / 2, Sonic.P
    );
    Sonic.P[SONICS_192_N_SIZE - 1] = 1;
    forkskinny_64_192_encrypt_with_tks(
        Sonic.fs_tks1, Sonic.fs_tks2,
        0, Sonic.mask, Sonic.P
    );

    for (i = 0; i < numP; ++i) {
        memcpy(Sonic.P, message + (SONICS_192_P_SIZE - 1) * i, (SONICS_192_P_SIZE - 1));
        supersonic_192_round_star(&Sonic, &Chains, buffer, i);
    }

    memset(Sonic.P, 0, SONICS_192_P_SIZE + 1);
    Sonic.P[res] = SONICS_END_OF_MESSAGE;
    memcpy(Sonic.P, message + numP * (SONICS_192_P_SIZE - 1), (SONICS_192_P_SIZE - 1) * (res == 0) + res);
    supersonic_192_round_star(&Sonic, &Chains, buffer, numP);

    Chains.kt[SONICS_192_K_SIZE + SONICS_192_T_SIZE] = 0b01 + (0b10 * (res > 0));
    arrXOR(Chains.kt, Sonic.K_prime, SONICS_192_K_SIZE);
    arrXOR(Chains.m,  Sonic.mask, SONICS_192_N_SIZE);

    forkskinny_64_192_init_tks_keypart(
        Sonic.fs_tks1, Chains.kt,
        FORKSKINNY_64_192_ROUNDS_BEFORE + 2 * FORKSKINNY_64_192_ROUNDS_AFTER
    );
    forkskinny_64_192_init_tks_tweakpart(
        Sonic.fs_tks2, Chains.kt + SONICS_192_K_SIZE,
        FORKSKINNY_64_192_ROUNDS_BEFORE + 2 * FORKSKINNY_64_192_ROUNDS_AFTER
    );
    forkskinny_64_192_encrypt_with_tks(
        Sonic.fs_tks1, Sonic.fs_tks2,
        out_left, out_right, Chains.m
    );
}
```
