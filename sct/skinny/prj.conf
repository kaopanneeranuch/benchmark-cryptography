## CMakeLists.txt
```
cmake_minimum_required(VERSION 3.20.0)
find_package(Zephyr REQUIRED HINTS $ENV{ZEPHYR_BASE})

project(skinny)

target_include_directories(app PRIVATE ../../ ../../SKINNY-AEAD)

target_sources(app PRIVATE
	src/main.c
	src/bench.c
	src/skinny_sct.c
	../../SKINNY-AEAD/internal-skinny128.c
)
```

## prj.conf
```kconfig
# Timing
CONFIG_TIMING_FUNCTIONS=y

# UART console
CONFIG_UART_CONSOLE=y
CONFIG_CONSOLE=y
```

## src/main.c
```c
#include <zephyr/kernel.h>
#include <zephyr/sys/printk.h>
#include <zephyr/timing/timing.h>
#include "bench.h"

void main(void)
{
    timing_init();
    timing_start();

    printk("\n=== Skinny-SCT AEAD Benchmark ===\n\n");

    bench_sct_all();

    timing_stop();
}
```

## src/bench.c
```c
#include <zephyr/kernel.h>
#include <zephyr/sys/printk.h>
#include <zephyr/timing/timing.h>
#include <string.h>
#include <stdint.h>
#include "skinny_sct.h"
#include "bench.h"
#include "internal-skinny128.h"

#define WARMUP_ITERS   10
#define BENCH_ITERS   100
#define MESSAGE_LEN   100
#define AD_LEN         0

static uint8_t pt_buf[MESSAGE_LEN];
static uint8_t ct_buf[MESSAGE_LEN];
static uint8_t dec_buf[MESSAGE_LEN];
static uint8_t tag_buf[SCT_TAG_LEN];
#if AD_LEN > 0
static uint8_t ad_buf[AD_LEN];
#else
static uint8_t *ad_buf = NULL;
#endif
static sct_key_t ks;

static const uint8_t bench_key[SCT_KEY_LEN] = {
    0x00,0x01,0x02,0x03,0x04,0x05,0x06,0x07,
    0x08,0x09,0x0a,0x0b,0x0c,0x0d,0x0e,0x0f
};

static const uint8_t bench_nonce[SCT_NONCE_LEN] = {
    0xa0,0xa1,0xa2,0xa3,0xa4,0xa5,0xa6,0xa7,
    0xa8,0xa9,0xaa,0xab,0xac,0xad,0xae,0xaf
};

static void fill_pattern(uint8_t *buf, size_t len)
{
    for (size_t i = 0; i < len; i++) {
        buf[i] = (uint8_t)(i & 0xff);
    }
}

static void print_hex(const char *label, const uint8_t *buf, size_t len)
{
    printk("%s", label);
    for (size_t i = 0; i < len; i++) {
        printk("%02x", buf[i]);
    }
    printk("\n");
}

void verify_correctness(void)
{
    printk("--- SKINNY SCT Correctness (msg=%d ad=%d) ---\n",
           MESSAGE_LEN, AD_LEN);

    fill_pattern(pt_buf, MESSAGE_LEN);
#if AD_LEN > 0
    fill_pattern(ad_buf, AD_LEN);
#endif

    memcpy(ks.key, bench_key, SCT_KEY_LEN);

    skinny_sct_encrypt_auth(&ks, bench_nonce,
                            ad_buf, AD_LEN,
                            pt_buf, MESSAGE_LEN,
                            ct_buf, tag_buf);

    print_hex("PT[0..15]:  ", pt_buf, 16);
    print_hex("CT[0..15]:  ", ct_buf, 16);
    print_hex("TAG:        ", tag_buf, SCT_TAG_LEN);

    int rc = skinny_sct_decrypt_verify(&ks, bench_nonce,
                                       ad_buf, AD_LEN,
                                       ct_buf, MESSAGE_LEN,
                                       tag_buf, dec_buf);

    print_hex("DEC[0..15]: ", dec_buf, 16);
    printk("Decrypt+Verify: %s\n", (rc == 0) ? "OK" : "FAIL");

    if (memcmp(pt_buf, dec_buf, MESSAGE_LEN) == 0) {
        printk("Plaintext match: OK\n");
    } else {
        printk("Plaintext match: FAIL\n");
    }

    printk("--- End correctness ---\n\n");
}

static void bench_hash(void)
{
    timing_t start, end;
    uint64_t total_c = 0, total_ns = 0;

    fill_pattern(pt_buf, MESSAGE_LEN);
    memcpy(ks.key, bench_key, SCT_KEY_LEN);

    for (int i = 0; i < WARMUP_ITERS; i++) {
        skinny_sct_hash(&ks, bench_nonce,
                        ad_buf, AD_LEN,
                        pt_buf, MESSAGE_LEN,
                        tag_buf);
    }

    skinny_counters_reset();
    skinny_sct_hash(&ks, bench_nonce, ad_buf, AD_LEN, pt_buf, MESSAGE_LEN, tag_buf);
    uint32_t enc_per_op = g_skinny128_256_enc_calls;

    for (int i = 0; i < WARMUP_ITERS; i++) {
        skinny_sct_hash(&ks, bench_nonce,
                        ad_buf, AD_LEN,
                        pt_buf, MESSAGE_LEN,
                        tag_buf);
    }

    for (int i = 0; i < BENCH_ITERS; i++) {
        start = timing_counter_get();
        skinny_sct_hash(&ks, bench_nonce,
                        ad_buf, AD_LEN,
                        pt_buf, MESSAGE_LEN,
                        tag_buf);
        end = timing_counter_get();

        uint64_t c = timing_cycles_get(&start, &end);
        total_c  += c;
        total_ns += timing_cycles_to_ns(c);
    }

    printk("  %-14s: %10llu cycles  |  %10llu ns\n", "hash (tag)",
           (unsigned long long)(total_c / BENCH_ITERS),
           (unsigned long long)(total_ns / BENCH_ITERS));
    printk("    [prim/op] SKINNY-128-256: enc=%lu\n", (unsigned long)enc_per_op);
}

static void bench_encrypt(void)
{
    timing_t start, end;
    uint64_t total_c = 0, total_ns = 0;
    uint8_t iv[SCT_IV_LEN];

    fill_pattern(pt_buf, MESSAGE_LEN);
    memcpy(ks.key, bench_key, SCT_KEY_LEN);

    skinny_sct_hash(&ks, bench_nonce,
                    ad_buf, AD_LEN,
                    pt_buf, MESSAGE_LEN,
                    tag_buf);

    memcpy(iv, tag_buf, SCT_IV_LEN);

    skinny_counters_reset();
    skinny_sct_ctrt(&ks, bench_nonce, iv, pt_buf, MESSAGE_LEN, ct_buf);
    uint32_t enc_per_op = g_skinny128_256_enc_calls;

    for (int i = 0; i < WARMUP_ITERS; i++) {
        skinny_sct_ctrt(&ks, bench_nonce, iv,
                        pt_buf, MESSAGE_LEN, ct_buf);
    }

    for (int i = 0; i < BENCH_ITERS; i++) {
        start = timing_counter_get();
        skinny_sct_ctrt(&ks, bench_nonce, iv,
                        pt_buf, MESSAGE_LEN, ct_buf);
        end = timing_counter_get();

        uint64_t c = timing_cycles_get(&start, &end);
        total_c  += c;
        total_ns += timing_cycles_to_ns(c);
    }

    printk("  %-14s: %10llu cycles  |  %10llu ns\n", "ctrt enc",
           (unsigned long long)(total_c / BENCH_ITERS),
           (unsigned long long)(total_ns / BENCH_ITERS));
    printk("    [prim/op] SKINNY-128-256: enc=%lu\n", (unsigned long)enc_per_op);
}

static void bench_decrypt(void)
{
    timing_t start, end;
    uint64_t total_c = 0, total_ns = 0;
    uint8_t iv[SCT_IV_LEN];

    fill_pattern(pt_buf, MESSAGE_LEN);
    memcpy(ks.key, bench_key, SCT_KEY_LEN);

    skinny_sct_encrypt_auth(&ks, bench_nonce,
                            ad_buf, AD_LEN,
                            pt_buf, MESSAGE_LEN,
                            ct_buf, tag_buf);

    memcpy(iv, tag_buf, SCT_IV_LEN);

    skinny_counters_reset();
    skinny_sct_ctrt(&ks, bench_nonce, iv, ct_buf, MESSAGE_LEN, dec_buf);
    uint32_t enc_per_op = g_skinny128_256_enc_calls;

    for (int i = 0; i < WARMUP_ITERS; i++) {
        skinny_sct_ctrt(&ks, bench_nonce, iv,
                        ct_buf, MESSAGE_LEN, dec_buf);
    }

    for (int i = 0; i < BENCH_ITERS; i++) {
        start = timing_counter_get();
        skinny_sct_ctrt(&ks, bench_nonce, iv,
                        ct_buf, MESSAGE_LEN, dec_buf);
        end = timing_counter_get();

        uint64_t c = timing_cycles_get(&start, &end);
        total_c  += c;
        total_ns += timing_cycles_to_ns(c);
    }

    printk("  %-14s: %10llu cycles  |  %10llu ns\n", "ctrt dec",
           (unsigned long long)(total_c / BENCH_ITERS),
           (unsigned long long)(total_ns / BENCH_ITERS));
    printk("    [prim/op] SKINNY-128-256: enc=%lu\n", (unsigned long)enc_per_op);
}

static void bench_verify(void)
{
    timing_t start, end;
    uint64_t total_c = 0, total_ns = 0;

    fill_pattern(pt_buf, MESSAGE_LEN);
    memcpy(ks.key, bench_key, SCT_KEY_LEN);

    skinny_sct_hash(&ks, bench_nonce,
                    ad_buf, AD_LEN,
                    pt_buf, MESSAGE_LEN,
                    tag_buf);

    skinny_counters_reset();
    skinny_sct_verify(&ks, bench_nonce, ad_buf, AD_LEN, pt_buf, MESSAGE_LEN, tag_buf);
    uint32_t enc_per_op = g_skinny128_256_enc_calls;

    for (int i = 0; i < WARMUP_ITERS; i++) {
        skinny_sct_verify(&ks, bench_nonce,
                          ad_buf, AD_LEN,
                          pt_buf, MESSAGE_LEN,
                          tag_buf);
    }

    for (int i = 0; i < BENCH_ITERS; i++) {
        start = timing_counter_get();
        skinny_sct_verify(&ks, bench_nonce,
                          ad_buf, AD_LEN,
                          pt_buf, MESSAGE_LEN,
                          tag_buf);
        end = timing_counter_get();

        uint64_t c = timing_cycles_get(&start, &end);
        total_c  += c;
        total_ns += timing_cycles_to_ns(c);
    }

    printk("  %-14s: %10llu cycles  |  %10llu ns\n", "verify",
           (unsigned long long)(total_c / BENCH_ITERS),
           (unsigned long long)(total_ns / BENCH_ITERS));
    printk("    [prim/op] SKINNY-128-256: enc=%lu\n", (unsigned long)enc_per_op);
}

void bench_sct_all(void)
{
    printk("[SKINNY SCT] Benchmark  msg=%d ad=%d iters=%d\n",
           MESSAGE_LEN, AD_LEN, BENCH_ITERS);
    printk("  sizes:  key=%d  nonce=%d  tag=%d  pt=%d  ct=%d  ad=%d  (bytes)\n",
           SCT_KEY_LEN, SCT_NONCE_LEN, SCT_TAG_LEN,
           MESSAGE_LEN, MESSAGE_LEN, AD_LEN);
    printk("  %-14s  %10s  %12s\n", "operation", "cycles", "ns");

    verify_correctness();

    bench_hash();
    bench_encrypt();
    bench_decrypt();
    bench_verify();

    printk("--- Benchmark complete ---\n\n");
}
```

## src/bench.h
```c
#ifndef BENCH_H
#define BENCH_H

void verify_correctness(void);
void bench_sct_all(void);

#endif
```

## src/skinny_sct.c
```c
#include "skinny_sct.h"
#include "internal-skinny128.h"
#include <stdint.h>
#include <string.h>

#define SCT_BLOCK_LEN 16
#define SCT_IV_LEN 15

static void sct_build_tk(uint8_t tk[32], const uint8_t key[16], const uint8_t tweak[16])
{
    memcpy(tk, tweak, 16);
    memcpy(tk + 16, key, 16);
}

void skinny_encrypt(const uint8_t *key,
                    const uint8_t tweak[16],
                    const uint8_t in[16],
                    uint8_t out[16])
{
    uint8_t tk[32];
    sct_build_tk(tk, key, tweak);
    skinny_128_256_encrypt_tk_full(tk, out, in);
}

static void sct_set_counter_tweak(uint8_t tweak[16], uint8_t prefix, uint64_t ctr)
{
    memset(tweak, 0, 16);
    tweak[0] = prefix;

    // put the 64-bit counter in the low bytes of tweak[1..15]
    for (int i = 15; i >= 8; --i)
    {
        tweak[i] = (uint8_t)ctr;
        ctr >>= 8;
    }
}

static void sct_inc_iv(uint8_t iv[SCT_IV_LEN])
{
    for (int i = SCT_IV_LEN - 1; i >= 0; --i)
    {
        iv[i]++;
        if (iv[i] != 0)
            break;
    }
}

/*
 * CTRT:
 *   C_i = M_i xor E_K^{(1, IV)}(N)
 *   IV  = Inc(IV)
 *
 * Same function for encrypt and decrypt.
 */
void skinny_sct_ctrt(const sct_key_t *ks,
                     const uint8_t nonce[SCT_NONCE_LEN],
                     const uint8_t iv_in[SCT_IV_LEN],
                     const uint8_t *in, size_t len,
                     uint8_t *out)
{
    uint8_t tweak[16];
    uint8_t stream[16];
    uint8_t iv[SCT_IV_LEN];
    size_t off, take;

    memcpy(iv, iv_in, SCT_IV_LEN);

    for (off = 0; off < len; off += SCT_BLOCK_LEN)
    {
        take = len - off;
        if (take > SCT_BLOCK_LEN)
            take = SCT_BLOCK_LEN;

        tweak[0] = 1;
        memcpy(tweak + 1, iv, SCT_IV_LEN);

        skinny_encrypt(ks->key, tweak, nonce, stream);

        for (size_t j = 0; j < take; j++)
            out[off + j] = in[off + j] ^ stream[j];

        sct_inc_iv(iv);
    }
}

/*
 * EPWC:
 *   auth := E^(2,0)(N) xor E^(2,1)(N)
 *   xor in AD blocks with prefixes 2/3
 *   xor in M  blocks with prefixes 4/5
 *   tag := E^(4,0)(auth)
 */
void skinny_sct_hash(const sct_key_t *ks,
                     const uint8_t nonce[SCT_NONCE_LEN],
                     const uint8_t *ad, size_t adlen,
                     const uint8_t *msg, size_t mlen,
                     uint8_t tag[SCT_TAG_LEN])
{
    uint8_t tweak[16];
    uint8_t auth[16];
    uint8_t tmp[16];
    uint8_t block[16];
    size_t off, take;

    /* auth = E^(2,0)(N) xor E^(2,1)(N) */
    sct_set_counter_tweak(tweak, 2, 0);
    skinny_encrypt(ks->key, tweak, nonce, auth);

    sct_set_counter_tweak(tweak, 2, 1);
    skinny_encrypt(ks->key, tweak, nonce, tmp);

    for (int i = 0; i < 16; i++)
        auth[i] ^= tmp[i];

    off = 0;
    while (off + SCT_BLOCK_LEN < adlen)
    {
        sct_set_counter_tweak(tweak, 2, (uint64_t)(off / SCT_BLOCK_LEN) + 2);
        skinny_encrypt(ks->key, tweak, ad + off, tmp);

        for (int i = 0; i < 16; i++)
            auth[i] ^= tmp[i];

        off += SCT_BLOCK_LEN;
    }

    if (adlen > 0)
    {
        take = adlen - off;

        if (take == SCT_BLOCK_LEN)
        {
            sct_set_counter_tweak(tweak, 2, (uint64_t)(off / SCT_BLOCK_LEN) + 2);
            skinny_encrypt(ks->key, tweak, ad + off, tmp);
        }
        else
        {
            memset(block, 0, 16);
            memcpy(block, ad + off, take);
            block[take] = 0x80;

            sct_set_counter_tweak(tweak, 3, (uint64_t)(off / SCT_BLOCK_LEN) + 2);
            skinny_encrypt(ks->key, tweak, block, tmp);
        }

        for (int i = 0; i < 16; i++)
            auth[i] ^= tmp[i];
    }

    off = 0;
    while (off + SCT_BLOCK_LEN < mlen)
    {
        sct_set_counter_tweak(tweak, 4, (uint64_t)(off / SCT_BLOCK_LEN) + 1);
        skinny_encrypt(ks->key, tweak, msg + off, tmp);

        for (int i = 0; i < 16; i++)
            auth[i] ^= tmp[i];

        off += SCT_BLOCK_LEN;
    }

    if (mlen > 0)
    {
        take = mlen - off;

        if (take == SCT_BLOCK_LEN)
        {
            sct_set_counter_tweak(tweak, 4, (uint64_t)(off / SCT_BLOCK_LEN) + 1);
            skinny_encrypt(ks->key, tweak, msg + off, tmp);
        }
        else
        {
            memset(block, 0, 16);
            memcpy(block, msg + off, take);
            block[take] = 0x80;

            sct_set_counter_tweak(tweak, 5, (uint64_t)(off / SCT_BLOCK_LEN) + 1);
            skinny_encrypt(ks->key, tweak, block, tmp);
        }

        for (int i = 0; i < 16; i++)
            auth[i] ^= tmp[i];
    }

    /* tag = E^(4,0)(auth) */
    sct_set_counter_tweak(tweak, 4, 0);
    skinny_encrypt(ks->key, tweak, auth, tag);
}

int skinny_sct_verify(const sct_key_t *ks,
                      const uint8_t nonce[SCT_NONCE_LEN],
                      const uint8_t *ad, size_t adlen,
                      const uint8_t *msg, size_t mlen,
                      const uint8_t tag[SCT_TAG_LEN])
{
    uint8_t computed[SCT_TAG_LEN];
    unsigned diff = 0;

    skinny_sct_hash(ks, nonce, ad, adlen, msg, mlen, computed);

    for (int i = 0; i < SCT_TAG_LEN; i++)
        diff |= (unsigned)(computed[i] ^ tag[i]);

    return diff ? -1 : 0;
}

void skinny_sct_encrypt_auth(const sct_key_t *ks,
                             const uint8_t nonce[SCT_NONCE_LEN],
                             const uint8_t *ad, size_t adlen,
                             const uint8_t *msg, size_t mlen,
                             uint8_t *ct,
                             uint8_t tag[SCT_TAG_LEN])
{
    uint8_t iv[SCT_IV_LEN];

    skinny_sct_hash(ks, nonce, ad, adlen, msg, mlen, tag);

    /* Conv(tag): truncate 16-byte tag to 15-byte IV */
    memcpy(iv, tag, SCT_IV_LEN);

    skinny_sct_ctrt(ks, nonce, iv, msg, mlen, ct);
}

int skinny_sct_decrypt_verify(const sct_key_t *ks,
                              const uint8_t nonce[SCT_NONCE_LEN],
                              const uint8_t *ad, size_t adlen,
                              const uint8_t *ct, size_t clen,
                              const uint8_t tag[SCT_TAG_LEN],
                              uint8_t *msg)
{
    uint8_t iv[SCT_IV_LEN];
    uint8_t computed[SCT_TAG_LEN];
    unsigned diff = 0;

    memcpy(iv, tag, SCT_IV_LEN);
    skinny_sct_ctrt(ks, nonce, iv, ct, clen, msg);

    skinny_sct_hash(ks, nonce, ad, adlen, msg, clen, computed);

    for (int i = 0; i < SCT_TAG_LEN; i++)
        diff |= (unsigned)(computed[i] ^ tag[i]);

    if (diff)
    {
        memset(msg, 0, clen);
        return -1;
    }

    return 0;
}
```

## src/skinny_sct.h
```c
#ifndef SKINNY_SCT_H
#define SKINNY_SCT_H

#include <stddef.h>
#include <stdint.h>

#ifndef SCT_KEY_LEN
#define SCT_KEY_LEN   16
#endif

#define SCT_BLOCK_LEN 16
#define SCT_NONCE_LEN 16
#define SCT_TAG_LEN   16
#define SCT_IV_LEN    15

typedef struct {
    uint8_t key[SCT_KEY_LEN];
} sct_key_t;

void skinny_encrypt(const uint8_t *key,
                    const uint8_t tweak[16],
                    const uint8_t in[16],
                    uint8_t out[16]);


void skinny_sct_ctrt(const sct_key_t *ks,
                     const uint8_t nonce[SCT_NONCE_LEN],
                     const uint8_t iv_in[SCT_IV_LEN],
                     const uint8_t *in, size_t len,
                     uint8_t *out);

void skinny_sct_hash(const sct_key_t *ks,
                     const uint8_t nonce[SCT_NONCE_LEN],
                     const uint8_t *ad, size_t adlen,
                     const uint8_t *msg, size_t mlen,
                     uint8_t tag[SCT_TAG_LEN]);

int skinny_sct_verify(const sct_key_t *ks,
                      const uint8_t nonce[SCT_NONCE_LEN],
                      const uint8_t *ad, size_t adlen,
                      const uint8_t *msg, size_t mlen,
                      const uint8_t tag[SCT_TAG_LEN]);

void skinny_sct_encrypt_auth(const sct_key_t *ks,
                             const uint8_t nonce[SCT_NONCE_LEN],
                             const uint8_t *ad, size_t adlen,
                             const uint8_t *msg, size_t mlen,
                             uint8_t *ct,
                             uint8_t tag[SCT_TAG_LEN]);

int skinny_sct_decrypt_verify(const sct_key_t *ks,
                              const uint8_t nonce[SCT_NONCE_LEN],
                              const uint8_t *ad, size_t adlen,
                              const uint8_t *ct, size_t clen,
                              const uint8_t tag[SCT_TAG_LEN],
                              uint8_t *msg);

#endif
```
