## CMakeLists.txt
```
cmake_minimum_required(VERSION 3.20.0)
find_package(Zephyr REQUIRED HINTS $ENV{ZEPHYR_BASE})

project(forkskinny)

target_include_directories(app PRIVATE ../../ ../../forkskinny_tbc)

target_sources(app PRIVATE
	src/main.c
	src/bench.c
	src/forkskinny_sct.c
	../../forkskinny_tbc/forkskinny_tbc.c
	../../ForkAE/internal-forkskinny.c
	../../ForkAE/forkae.c
	../../ForkAE/aead-common.c
)
```

## prj.conf
```kconfig
# Timing
CONFIG_TIMING_FUNCTIONS=y

# RTT console
CONFIG_USE_SEGGER_RTT=y
CONFIG_RTT_CONSOLE=y
CONFIG_UART_CONSOLE=n
CONFIG_CONSOLE=y
```

## src/main.c
```c
#include <zephyr/kernel.h>
#include <zephyr/sys/printk.h>
#include <zephyr/timing/timing.h>

#include "bench.h"

int main(void)
{
    timing_init();
    timing_start();

    printk("\n========================================\n");
    printk("  ForkSkinny-SCT Benchmark (Deoxys-II style)\n");
    printk("========================================\n\n");

    verify_correctness();
    bench_block_encrypt();
    printk("\n");
    bench_sct_encrypt();

    printk("\n========================================\n");
    printk("  ForkSkinny-SCT Benchmark Complete\n");
    printk("========================================\n");

    timing_stop();
    return 0;
}
int main(void)
{
    timing_init();
    timing_start();

    printk("\n========================================\n");
    printk("  ForkSkinny-SCT Benchmark (Deoxys-II style)\n");
    printk("  Iterations: %d  |  Warm-up: %d\n", BENCH_ITERS, WARMUP_ITERS);
    printk("========================================\n\n");

    verify_correctness();
    bench_block_encrypt();
    printk("\n");
    bench_sct_encrypt();

    printk("\n========================================\n");
    printk("  ForkSkinny-SCT Benchmark Complete\n");
    printk("========================================\n");

    timing_stop();
    return 0;
}
```

## src/bench.c
```c
#include <zephyr/kernel.h>
#include <zephyr/sys/printk.h>
#include <zephyr/timing/timing.h>
#include <string.h>
#include <stdint.h>
#include "forkskinny_tbc.h"
#include "forkskinny_sct.h"
#include "bench.h"

/* ── configuration ──────────────────────────────────────── */
#define WARMUP_ITERS   10
#define BENCH_ITERS   100
#define NUM_SIZES       6
#define TAG_LEN        16
static const size_t data_sizes[NUM_SIZES] = {16, 64, 128, 256, 512, 1024};

/* work buffers */
static uint8_t pt_buf[1024];
static uint8_t ct_buf[1024];
static uint8_t dec_buf[1024];
static uint8_t tag_buf[TAG_LEN];

static const uint8_t bench_key[16] = {
    0x00,0x01,0x02,0x03,0x04,0x05,0x06,0x07,
    0x08,0x09,0x0a,0x0b,0x0c,0x0d,0x0e,0x0f
};
static const uint8_t bench_nonce[12] = {
    0xa0,0xa1,0xa2,0xa3,0xa4,0xa5,0xa6,0xa7,
    0xa8,0xa9,0xaa,0xab
};

/* helpers */
static void print_hex(const char *label, const uint8_t *buf, size_t len)
{
    printk("%s", label);
    for (size_t i = 0; i < len; i++) printk("%02x", buf[i]);
    printk("\n");
}

static void fill_pattern(uint8_t *buf, size_t len)
{
    for (size_t i = 0; i < len; i++) buf[i] = (uint8_t)(i & 0xff);
}

/* correctness check */
void verify_correctness(void)
{
    const uint8_t plaintext[] = "Hello World!";
    const size_t len = strlen((const char *)plaintext);
    uint8_t ct[64] = {0}, dec[64] = {0}, tag[16];

    printk("--- Correctness Check ---\n");
    forkskinny_sct_encrypt(bench_key, bench_nonce, plaintext, len, ct, tag);
    printk("PT:  %s\n", plaintext);
    print_hex("CT:  ", ct, len);
    print_hex("TAG: ", tag, 16);

    int rc = forkskinny_sct_decrypt(bench_key, bench_nonce, ct, len, tag, dec);
    dec[len] = '\0';
    printk("DEC: %s\n", dec);
    printk("TAG verify: %s\n", rc == 0 ? "OK" : "FAIL");
    printk("--- OK ---\n\n");
}

/* benchmark routines */
void bench_block_encrypt(void)
{
    uint8_t tweak[16] = {0}, in[16] = {0}, out[16];
    timing_t start, end;
    uint64_t total_cycles = 0, total_ns = 0;

    for (int i = 0; i < WARMUP_ITERS; i++)
        forkskinny_tbc(bench_key, tweak, in, out);

    for (int i = 0; i < BENCH_ITERS; i++) {
        start = timing_counter_get();
        forkskinny_tbc(bench_key, tweak, in, out);
        end = timing_counter_get();
        total_cycles += timing_cycles_get(&start, &end);
        total_ns     += timing_cycles_to_ns(timing_cycles_get(&start, &end));
    }

    printk("[FORKSKINNY] TBC Encrypt (1 block):  %llu cycles  |  %llu ns\n",
           (unsigned long long)(total_cycles / BENCH_ITERS),
           (unsigned long long)(total_ns / BENCH_ITERS));
}

void bench_sct_encrypt(void)
{
    timing_t start, end;

    printk("[FORKSKINNY-SCT] Encrypt  (%d iterations)\n", BENCH_ITERS);
    printk("  %6s  %12s  %12s  %12s\n", "bytes", "cycles", "ns", "cycles/byte");

    for (int s = 0; s < NUM_SIZES; s++) {
        size_t len = data_sizes[s];
        fill_pattern(pt_buf, len);
        uint64_t total_cycles = 0, total_ns = 0;

        for (int i = 0; i < WARMUP_ITERS; i++)
            forkskinny_sct_encrypt(bench_key, bench_nonce,
                                   pt_buf, len, ct_buf, tag_buf);

        for (int i = 0; i < BENCH_ITERS; i++) {
            start = timing_counter_get();
            forkskinny_sct_encrypt(bench_key, bench_nonce,
                                   pt_buf, len, ct_buf, tag_buf);
            end = timing_counter_get();
            total_cycles += timing_cycles_get(&start, &end);
            total_ns     += timing_cycles_to_ns(timing_cycles_get(&start, &end));
        }

        uint64_t avg_c = total_cycles / BENCH_ITERS;
        uint64_t avg_n = total_ns / BENCH_ITERS;
        uint64_t cpb   = avg_c / (uint64_t)len;
        printk("  %6zu  %12llu  %12llu  %12llu\n", len,
               (unsigned long long)avg_c,
               (unsigned long long)avg_n,
               (unsigned long long)cpb);
    }
}
```

## src/bench.h
```c
#ifndef FORKSKINNY_BENCH_H
#define FORKSKINNY_BENCH_H

void verify_correctness(void);
void bench_block_encrypt(void);
void bench_sct_encrypt(void);

#endif /* FORKSKINNY_BENCH_H */
```

## src/forkskinny_sct.c
```c
#include "forkskinny_sct.h"
#include "forkskinny_tbc.h"
#include <string.h>

static void build_sct_tweak(uint8_t tweak[16], uint8_t domain,
                            uint32_t counter, const uint8_t aux[12])
{
    tweak[0] = (uint8_t)((domain << 4) | ((counter >> 24) & 0x0F));
    tweak[1] = (uint8_t)((counter >> 16) & 0xFF);
    tweak[2] = (uint8_t)((counter >>  8) & 0xFF);
    tweak[3] = (uint8_t)( counter        & 0xFF);
    memcpy(tweak + 4, aux, 12);
}

static void xor_block(uint8_t dst[16], const uint8_t src[16])
{
    for (int i = 0; i < 16; i++) dst[i] ^= src[i];
}

void forkskinny_sct_encrypt(const uint8_t key[16],
                           const uint8_t nonce[12],
                           const uint8_t *msg, size_t mlen,
                           uint8_t *ct, uint8_t tag[16])
{
    uint8_t tweak[16], tmp[16], checksum[16], zero[16] = {0};
    memset(checksum, 0, 16);

    size_t full_blocks = mlen / 16;
    size_t last_len    = mlen % 16;

    /* Pass 1: Hash message -> checksum */
    for (size_t i = 0; i < full_blocks; i++) {
        build_sct_tweak(tweak, 0x0, (uint32_t)i, nonce);
        forkskinny_tbc(key, tweak, msg + i * 16, tmp);
        xor_block(checksum, tmp);
    }
    if (last_len > 0) {
        uint8_t padded[16];
        memset(padded, 0, 16);
        memcpy(padded, msg + full_blocks * 16, last_len);
        padded[last_len] = 0x80;
        build_sct_tweak(tweak, 0x2, (uint32_t)full_blocks, nonce);
        forkskinny_tbc(key, tweak, padded, tmp);
        xor_block(checksum, tmp);
    }

    /* Tag = E_K^{1,0,N}(checksum) */
    build_sct_tweak(tweak, 0x1, 0, nonce);
    forkskinny_tbc(key, tweak, checksum, tag);

    /* Pass 2: CTR encrypt using tag in tweak */
    uint8_t tag12[12];
    memcpy(tag12, tag, 12);

    for (size_t i = 0; i < full_blocks; i++) {
        build_sct_tweak(tweak, 0x4, (uint32_t)(i + 1), tag12);
        forkskinny_tbc(key, tweak, zero, tmp);
        for (size_t j = 0; j < 16; j++)
            ct[i * 16 + j] = msg[i * 16 + j] ^ tmp[j];
    }
    if (last_len > 0) {
        build_sct_tweak(tweak, 0x5, (uint32_t)(full_blocks + 1), tag12);
        forkskinny_tbc(key, tweak, zero, tmp);
        for (size_t j = 0; j < last_len; j++)
            ct[full_blocks * 16 + j] = msg[full_blocks * 16 + j] ^ tmp[j];
    }
}

int forkskinny_sct_decrypt(const uint8_t key[16],
                          const uint8_t nonce[12],
                          const uint8_t *ct, size_t clen,
                          const uint8_t tag[16],
                          uint8_t *msg)
{
    uint8_t tweak[16], tmp[16], zero[16] = {0};
    size_t full_blocks = clen / 16;
    size_t last_len    = clen % 16;

    /* Phase 1: Decrypt (CTR with supplied tag) */
    uint8_t tag12[12];
    memcpy(tag12, tag, 12);

    for (size_t i = 0; i < full_blocks; i++) {
        build_sct_tweak(tweak, 0x4, (uint32_t)(i + 1), tag12);
        forkskinny_tbc(key, tweak, zero, tmp);
        for (size_t j = 0; j < 16; j++)
            msg[i * 16 + j] = ct[i * 16 + j] ^ tmp[j];
    }
    if (last_len > 0) {
        build_sct_tweak(tweak, 0x5, (uint32_t)(full_blocks + 1), tag12);
        forkskinny_tbc(key, tweak, zero, tmp);
        for (size_t j = 0; j < last_len; j++)
            msg[full_blocks * 16 + j] = ct[full_blocks * 16 + j] ^ tmp[j];
    }

    /* Phase 2: Recompute tag from plaintext */
    uint8_t checksum[16];
    memset(checksum, 0, 16);

    for (size_t i = 0; i < full_blocks; i++) {
        build_sct_tweak(tweak, 0x0, (uint32_t)i, nonce);
        forkskinny_tbc(key, tweak, msg + i * 16, tmp);
        xor_block(checksum, tmp);
    }
    if (last_len > 0) {
        uint8_t padded[16];
        memset(padded, 0, 16);
        memcpy(padded, msg + full_blocks * 16, last_len);
        padded[last_len] = 0x80;
        build_sct_tweak(tweak, 0x2, (uint32_t)full_blocks, nonce);
        forkskinny_tbc(key, tweak, padded, tmp);
        xor_block(checksum, tmp);
    }

    uint8_t computed_tag[16];
    build_sct_tweak(tweak, 0x1, 0, nonce);
    forkskinny_tbc(key, tweak, checksum, computed_tag);

    /* Verify tag */
    int diff = 0;
    for (int i = 0; i < 16; i++) diff |= computed_tag[i] ^ tag[i];
    return diff == 0 ? 0 : -1;
}
```

## src/forkskinny_sct.h
```c
#ifndef FORKSKINNY_SCT_H
#define FORKSKINNY_SCT_H

#include <stddef.h>
#include <stdint.h>

void forkskinny_sct_encrypt(const uint8_t key[16],
                           const uint8_t nonce[12],
                           const uint8_t *msg, size_t mlen,
                           uint8_t *ct, uint8_t tag[16]);

int forkskinny_sct_decrypt(const uint8_t key[16],
                          const uint8_t nonce[12],
                          const uint8_t *ct, size_t clen,
                          const uint8_t tag[16],
                          uint8_t *msg);

#endif /* FORKSKINNY_SCT_H */
```
