## CMakeLists.txt
```
cmake_minimum_required(VERSION 3.20.0)
find_package(Zephyr REQUIRED HINTS $ENV{ZEPHYR_BASE})

project(forkskinny)

target_include_directories(app PRIVATE
    ../../forkskinny-opt32
    ../../BC__Butterknife/include
    ../../supersonic/src/include
    ../../GCTR-3/forkskinny
    src
)

target_sources(app PRIVATE
    src/main.c
    src/bench.c
    src/forkskinny_sonicae.c
    ../../supersonic/src/supersonic_forkskinny.c
    ../../GCTR-3/forkskinny/gctr-3-prime.c
    ../../forkskinny-opt32/internal-forkskinny.c
)
```

## prj.conf
```kconfig
# Timing
CONFIG_TIMING_FUNCTIONS=y

# RTT console
CONFIG_USE_SEGGER_RTT=y
CONFIG_RTT_CONSOLE=y
CONFIG_UART_CONSOLE=n
CONFIG_CONSOLE=y
CONFIG_SEGGER_RTT_BUFFER_SIZE_UP=4096

# Increase stack size for benchmarking
CONFIG_MAIN_STACK_SIZE=8192
```

## src/main.c
```c
#include <zephyr/kernel.h>
#include <zephyr/sys/printk.h>
#include <zephyr/timing/timing.h>
#include "bench.h"

int main(void)
{
    timing_init();
    timing_start();

    printk("\n=== ForkSkinny-Sonicae AEAD Benchmark ===\n\n");

    bench_sonicae_all();

    timing_stop();
    return 0;
}
```

## src/bench.c
```c
#include <zephyr/kernel.h>
#include <zephyr/sys/printk.h>
#include <zephyr/timing/timing.h>

#include <string.h>
#include <stdint.h>

#include "forkskinny_sonicae.h"
#include "bench.h"
#include "internal-forkskinny.h"

#define WARMUP_ITERS   10
#define BENCH_ITERS   100
#define MESSAGE_LEN   100

static uint8_t pt_buf[MESSAGE_LEN];
static uint8_t ct_buf[MESSAGE_LEN];
static uint8_t dec_buf[MESSAGE_LEN];
static uint8_t tag_buf[SS_TAG_BYTES];
static sonicae_key_t ks;

static volatile uint8_t bench_sink8;
static volatile uint32_t bench_sink32;

static const uint8_t bench_key[SONICAE_KEY_LEN] = {
    0x00, 0x01, 0x02, 0x03, 0x04, 0x05, 0x06, 0x07,
    0x08, 0x09, 0x0a, 0x0b, 0x0c, 0x0d, 0x0e, 0x0f
};

static void fill_pattern(uint8_t *buf, size_t len)
{
    for (size_t i = 0; i < len; ++i) {
        buf[i] = (uint8_t)(i & 0xffu);
    }
}

static void print_hex(const char *label, const uint8_t *buf, size_t len)
{
    printk("%s", label);
    for (size_t i = 0; i < len; ++i) {
        printk("%02x", buf[i]);
    }
    printk("\n");
}

void verify_correctness(void)
{
    printk("--- ForkSkinny SonicAE Correctness Check (msg = %d bytes) ---\n",
           MESSAGE_LEN);

    fill_pattern(pt_buf, MESSAGE_LEN);
    memset(ct_buf, 0, sizeof(ct_buf));
    memset(dec_buf, 0, sizeof(dec_buf));
    memset(tag_buf, 0, sizeof(tag_buf));

    memcpy(ks.key, bench_key, SONICAE_KEY_LEN);

    forkskinny_sonicae_encrypt_auth(&ks,
                                    NULL, 0,
                                    pt_buf, MESSAGE_LEN,
                                    ct_buf, tag_buf);

    print_hex("PT[0..15]:  ", pt_buf, 16);
    print_hex("CT[0..15]:  ", ct_buf, 16);
    print_hex("TAG:        ", tag_buf, SS_TAG_BYTES);

    {
        int rc = forkskinny_sonicae_decrypt_verify(&ks,
                                                   NULL, 0,
                                                   ct_buf, MESSAGE_LEN,
                                                   tag_buf, dec_buf);

        print_hex("DEC[0..15]: ", dec_buf, 16);
        printk("Decrypt+Verify: %s\n", (rc == 0) ? "OK" : "FAIL");
    }

    if (memcmp(pt_buf, dec_buf, MESSAGE_LEN) == 0) {
        printk("Plaintext match: OK\n");
    } else {
        printk("Plaintext match: FAIL\n");
    }

    printk("--- End correctness ---\n\n");
}

static void bench_auth(void)
{
    timing_t start, end;
    uint64_t total_c = 0;
    uint64_t total_ns = 0;

    fill_pattern(pt_buf, MESSAGE_LEN);
    memcpy(ks.key, bench_key, SONICAE_KEY_LEN);

    forkskinny_counters_reset();
    forkskinny_sonicae_auth(&ks, NULL, 0, pt_buf, MESSAGE_LEN, tag_buf);
    uint32_t enc_per_op = g_fs128_256_enc_calls;
    uint32_t dec_per_op = g_fs128_256_dec_calls;

    for (int i = 0; i < WARMUP_ITERS; ++i) {
        forkskinny_sonicae_auth(&ks, NULL, 0,
                                pt_buf, MESSAGE_LEN, tag_buf);
        bench_sink8 ^= tag_buf[0];
    }

    for (int i = 0; i < BENCH_ITERS; ++i) {
        start = timing_counter_get();
        forkskinny_sonicae_auth(&ks, NULL, 0,
                                pt_buf, MESSAGE_LEN, tag_buf);
        end = timing_counter_get();

        bench_sink8 ^= tag_buf[0];

        {
            uint64_t c = timing_cycles_get(&start, &end);
            total_c += c;
            total_ns += timing_cycles_to_ns(c);
        }
    }

    printk("  %-14s: %10llu cycles | %10llu ns\n",
           "auth (tag)",
           (unsigned long long)(total_c / BENCH_ITERS),
           (unsigned long long)(total_ns / BENCH_ITERS));
    printk("    [prim/op] FS-128-256: enc=%lu dec=%lu\n",
           (unsigned long)enc_per_op, (unsigned long)dec_per_op);
}

static void bench_encrypt(void)
{
    timing_t start, end;
    uint64_t total_c = 0;
    uint64_t total_ns = 0;

    fill_pattern(pt_buf, MESSAGE_LEN);
    memcpy(ks.key, bench_key, SONICAE_KEY_LEN);

    forkskinny_sonicae_auth(&ks, NULL, 0, pt_buf, MESSAGE_LEN, tag_buf);

    forkskinny_counters_reset();
    forkskinny_sonicae_encrypt(&ks, tag_buf, pt_buf, MESSAGE_LEN, ct_buf);
    uint32_t enc_per_op = g_fs128_256_enc_calls;
    uint32_t dec_per_op = g_fs128_256_dec_calls;

    for (int i = 0; i < WARMUP_ITERS; ++i) {
        forkskinny_sonicae_encrypt(&ks, tag_buf, pt_buf, MESSAGE_LEN, ct_buf);
        bench_sink8 ^= ct_buf[0];
    }

    for (int i = 0; i < BENCH_ITERS; ++i) {
        start = timing_counter_get();
        forkskinny_sonicae_encrypt(&ks, tag_buf, pt_buf, MESSAGE_LEN, ct_buf);
        end = timing_counter_get();

        bench_sink8 ^= ct_buf[0];

        {
            uint64_t c = timing_cycles_get(&start, &end);
            total_c += c;
            total_ns += timing_cycles_to_ns(c);
        }
    }

    printk("  %-14s: %10llu cycles | %10llu ns\n",
           "encrypt",
           (unsigned long long)(total_c / BENCH_ITERS),
           (unsigned long long)(total_ns / BENCH_ITERS));
    printk("    [prim/op] FS-128-256: enc=%lu dec=%lu\n",
           (unsigned long)enc_per_op, (unsigned long)dec_per_op);
}

static void bench_decrypt(void)
{
    timing_t start, end;
    uint64_t total_c = 0;
    uint64_t total_ns = 0;

    fill_pattern(pt_buf, MESSAGE_LEN);
    memcpy(ks.key, bench_key, SONICAE_KEY_LEN);
    forkskinny_sonicae_encrypt_auth(&ks, NULL, 0,
                                    pt_buf, MESSAGE_LEN, ct_buf, tag_buf);

    forkskinny_counters_reset();
    forkskinny_sonicae_decrypt(&ks, tag_buf, ct_buf, MESSAGE_LEN, dec_buf);
    uint32_t enc_per_op = g_fs128_256_enc_calls;
    uint32_t dec_per_op = g_fs128_256_dec_calls;

    for (int i = 0; i < WARMUP_ITERS; ++i) {
        forkskinny_sonicae_decrypt(&ks, tag_buf, ct_buf, MESSAGE_LEN, dec_buf);
        bench_sink8 ^= dec_buf[0];
    }

    for (int i = 0; i < BENCH_ITERS; ++i) {
        start = timing_counter_get();
        forkskinny_sonicae_decrypt(&ks, tag_buf, ct_buf, MESSAGE_LEN, dec_buf);
        end = timing_counter_get();

        bench_sink8 ^= dec_buf[0];

        {
            uint64_t c = timing_cycles_get(&start, &end);
            total_c += c;
            total_ns += timing_cycles_to_ns(c);
        }
    }

    printk("  %-14s: %10llu cycles | %10llu ns\n",
           "decrypt",
           (unsigned long long)(total_c / BENCH_ITERS),
           (unsigned long long)(total_ns / BENCH_ITERS));
    printk("    [prim/op] FS-128-256: enc=%lu dec=%lu\n",
           (unsigned long)enc_per_op, (unsigned long)dec_per_op);
}

static void bench_auth_check(void)
{
    timing_t start, end;
    uint64_t total_c = 0;
    uint64_t total_ns = 0;
    int rc = 0;

    fill_pattern(pt_buf, MESSAGE_LEN);
    memcpy(ks.key, bench_key, SONICAE_KEY_LEN);
    forkskinny_sonicae_encrypt_auth(&ks, NULL, 0,
                                    pt_buf, MESSAGE_LEN, ct_buf, tag_buf);
    forkskinny_sonicae_decrypt(&ks, tag_buf, ct_buf, MESSAGE_LEN, dec_buf);

    forkskinny_counters_reset();
    (void)forkskinny_sonicae_verify(&ks, NULL, 0, dec_buf, MESSAGE_LEN, tag_buf);
    uint32_t enc_per_op = g_fs128_256_enc_calls;
    uint32_t dec_per_op = g_fs128_256_dec_calls;

    for (int i = 0; i < WARMUP_ITERS; ++i) {
        rc ^= forkskinny_sonicae_verify(&ks, NULL, 0,
                                        dec_buf, MESSAGE_LEN, tag_buf);
    }

    for (int i = 0; i < BENCH_ITERS; ++i) {
        start = timing_counter_get();
        rc ^= forkskinny_sonicae_verify(&ks, NULL, 0,
                                        dec_buf, MESSAGE_LEN, tag_buf);
        end = timing_counter_get();

        {
            uint64_t c = timing_cycles_get(&start, &end);
            total_c += c;
            total_ns += timing_cycles_to_ns(c);
        }
    }

    bench_sink32 ^= (uint32_t)rc;

    printk("  %-14s: %10llu cycles | %10llu ns\n",
           "auth-check",
           (unsigned long long)(total_c / BENCH_ITERS),
           (unsigned long long)(total_ns / BENCH_ITERS));
    printk("    [prim/op] FS-128-256: enc=%lu dec=%lu\n",
           (unsigned long)enc_per_op, (unsigned long)dec_per_op);

    k_msleep(1);
}

void bench_sonicae_all(void)
{
    printk("[FORKSKINNY SONICAE] Benchmark  msg=%d bytes  iters=%d\n",
           MESSAGE_LEN, BENCH_ITERS);
    printk("  sizes:  key=%d  nonce=none  tag=%d  pt=%d  ct=%d  ad=none  (bytes)\n",
           SONICAE_KEY_LEN, SS_TAG_BYTES, MESSAGE_LEN, MESSAGE_LEN);
    printk("  %-14s  %10s  %12s\n", "operation", "cycles", "ns");

    verify_correctness();

    bench_auth();
    bench_encrypt();
    bench_decrypt();
    bench_auth_check();

    printk("--- Benchmark complete ---\n\n");
}
```

## src/bench.h
```c
#ifndef BENCH_H
#define BENCH_H

void verify_correctness(void);
void bench_sonicae_all(void);

#endif
```

## src/forkskinny_sonicae.c
```c
#include "forkskinny_sonicae.h"
#include "forkskinny_supersonic.h"
#include "gctr-3-prime.h"

#include <string.h>
#include <stdint.h>
#include <stddef.h>

void forkskinny_sonicae_auth(const sonicae_key_t *ks,
                             const uint8_t *ad, size_t adlen,
                             const uint8_t *pt, size_t ptlen,
                             uint8_t tag[SS_TAG_BYTES])
{
    (void)ad;
    (void)adlen;

    forkskinny_supersonic_tag(ks->key, pt, ptlen, tag);
}

void forkskinny_sonicae_encrypt(const sonicae_key_t *ks,
                                const uint8_t tag[SS_TAG_BYTES],
                                const uint8_t *pt, size_t ptlen,
                                uint8_t *ct)
{
    gctr_3_prime(ks->key, tag, pt, ptlen, ct);
}

void forkskinny_sonicae_decrypt(const sonicae_key_t *ks,
                                const uint8_t tag[SS_TAG_BYTES],
                                const uint8_t *ct, size_t ctlen,
                                uint8_t *pt)
{
    gctr_3_prime(ks->key, tag, ct, ctlen, pt);
}

int forkskinny_sonicae_verify(const sonicae_key_t *ks,
                              const uint8_t *ad, size_t adlen,
                              const uint8_t *pt, size_t ptlen,
                              const uint8_t tag[SS_TAG_BYTES])
{
    uint8_t tag_r[SS_TAG_BYTES];
    uint8_t diff = 0u;

    forkskinny_sonicae_auth(ks, ad, adlen, pt, ptlen, tag_r);

    for (size_t i = 0; i < SS_TAG_BYTES; ++i) {
        diff |= (uint8_t)(tag_r[i] ^ tag[i]);
    }

    return (diff == 0u) ? 0 : -1;
}

void forkskinny_sonicae_encrypt_auth(const sonicae_key_t *ks,
                                     const uint8_t *ad, size_t adlen,
                                     const uint8_t *pt, size_t ptlen,
                                     uint8_t *ct,
                                     uint8_t tag[SS_TAG_BYTES])
{
    forkskinny_sonicae_auth(ks, ad, adlen, pt, ptlen, tag);
    forkskinny_sonicae_encrypt(ks, tag, pt, ptlen, ct);
}

int forkskinny_sonicae_decrypt_verify(const sonicae_key_t *ks,
                                      const uint8_t *ad, size_t adlen,
                                      const uint8_t *ct, size_t ctlen,
                                      const uint8_t tag[SS_TAG_BYTES],
                                      uint8_t *pt)
{
    forkskinny_sonicae_decrypt(ks, tag, ct, ctlen, pt);

    if (forkskinny_sonicae_verify(ks, ad, adlen, pt, ctlen, tag) != 0) {
        memset(pt, 0, ctlen);
        return -1;
    }

    return 0;
}
```

## src/forkskinny_sonicae.h
```c
#ifndef FORKSKINNY_SONICAE_H
#define FORKSKINNY_SONICAE_H

#include <stddef.h>
#include <stdint.h>

#define SONICAE_KEY_LEN  16u
#define SS_N_BYTES       16u
#define SS_TAG_BYTES     32u

typedef struct {
    uint8_t key[SONICAE_KEY_LEN];
} sonicae_key_t;

void forkskinny_sonicae_auth(const sonicae_key_t *ks,
                             const uint8_t *ad, size_t adlen,
                             const uint8_t *pt, size_t ptlen,
                             uint8_t tag[SS_TAG_BYTES]);

void forkskinny_sonicae_encrypt(const sonicae_key_t *ks,
                                const uint8_t tag[SS_TAG_BYTES],
                                const uint8_t *pt, size_t ptlen,
                                uint8_t *ct);

void forkskinny_sonicae_decrypt(const sonicae_key_t *ks,
                                const uint8_t tag[SS_TAG_BYTES],
                                const uint8_t *ct, size_t ctlen,
                                uint8_t *pt);

int forkskinny_sonicae_verify(const sonicae_key_t *ks,
                              const uint8_t *ad, size_t adlen,
                              const uint8_t *pt, size_t ptlen,
                              const uint8_t tag[SS_TAG_BYTES]);

void forkskinny_sonicae_encrypt_auth(const sonicae_key_t *ks,
                                     const uint8_t *ad, size_t adlen,
                                     const uint8_t *pt, size_t ptlen,
                                     uint8_t *ct,
                                     uint8_t tag[SS_TAG_BYTES]);

int forkskinny_sonicae_decrypt_verify(const sonicae_key_t *ks,
                                      const uint8_t *ad, size_t adlen,
                                      const uint8_t *ct, size_t ctlen,
                                      const uint8_t tag[SS_TAG_BYTES],
                                      uint8_t *pt);

#endif
```

## src/forkskinny_supersonic.c
```c
#include "forkskinny_supersonic.h"
#include "internal-forkskinny.h"

#include <stddef.h>
#include <stdint.h>
#include <string.h>

#define SS_N                 16u
#define SS_K                 16u
#define SS_T                 15u
#define SS_TK2               16u
#define SS_TAG               32u
#define SS_P_SIZE            47u
#define SS_CHUNK             (SS_P_SIZE - 1u)   /* 46 bytes processed per chunk */
#define SS_END_OF_MSG        0x80u
#define SS_COUNTER_BITS      12u
#define SS_COUNTER_MAX       ((1u << SS_COUNTER_BITS) - 1u)

typedef struct {
    uint8_t m[SS_N];
    uint8_t kt[SS_K + SS_T + 1u];
} ss_chains_t;

typedef struct {
    uint8_t P[SS_P_SIZE + 1u];
    uint8_t K_prime[SS_K];
    uint8_t mask[SS_N];
} ss_state_t;

static void ss_xor(uint8_t *dst, const uint8_t *src, size_t len)
{
    size_t i;
    for (i = 0; i < len; ++i)
        dst[i] ^= src[i];
}

/* Double in GF(2^128) using the same byte order as the reference code. */
static void ss_double_128(uint8_t x[SS_N])
{
    uint8_t carry;
    size_t i;

    carry = (uint8_t)((x[SS_N - 1u] >> 7) & 0x01u);
    for (i = 0; i < SS_N - 1u; ++i)
        x[i] = (uint8_t)((x[i] << 1) | ((x[i + 1u] >> 7) & 0x01u));
    x[SS_N - 1u] = (uint8_t)(x[SS_N - 1u] << 1);
    x[0] ^= (uint8_t)(0x87u * carry);
}

/* Two-branch ForkSkinny call: tk = key_part || tweak_part16. */
static void fs256_both(uint8_t out_left[SS_N],
                       uint8_t out_right[SS_N],
                       const uint8_t input[SS_N],
                       const uint8_t key_part[SS_K],
                       const uint8_t tweak_part[SS_TK2])
{
    uint8_t tk[SS_TAG];

    memcpy(tk, key_part, SS_K);
    memcpy(tk + SS_K, tweak_part, SS_TK2);
    forkskinny_128_256_encrypt(tk, out_left, out_right, input);
}

/*
 * One-legged ForkSkinny call for the normal SuperSonic round.
 */
static void fs256_right_only(uint8_t out[SS_N],
                             const uint8_t input[SS_N],
                             const uint8_t key_part[SS_K],
                             const uint8_t tweak_part[SS_TK2])
{
    uint8_t tk[SS_TAG];

    memcpy(tk, key_part, SS_K);
    memcpy(tk + SS_K, tweak_part, SS_TK2);
    forkskinny_128_256_encrypt(tk, NULL, out, input);
}

static void ss_precompute(const uint8_t key[SS_K], ss_state_t *state)
{
    uint8_t zero_input[SS_N] = {0};
    uint8_t zero_tweak[SS_TK2] = {0};

    fs256_both(state->K_prime, state->mask, zero_input, key, zero_tweak);
}

static void ss_round(ss_state_t *state,
                     ss_chains_t *chains,
                     uint8_t buffer[SS_N],
                     uint16_t round_index)
{
    /* k-chain: xor M_{3i+1}. */
    ss_xor(chains->kt, state->P + SS_N, SS_K);

    /* Apply preprocessing masks. */
    ss_xor(state->P, state->mask, SS_N);
    ss_xor(state->P + SS_N, state->K_prime, SS_K);

    /* Counter occupies 12 bits, keeping the low nibble of P[47] free. */
    state->P[SS_P_SIZE - 1u] = (uint8_t)((round_index + 1u) & 0xffu);
    state->P[SS_P_SIZE]      = (uint8_t)(((round_index + 1u) & 0x0f00u) >> 4);

    /* Reduced round call: use the right branch only. */
    fs256_right_only(buffer, state->P, state->P + SS_N, state->P + SS_N + SS_K);

    /* m-chain update. */
    ss_xor(chains->m, buffer, SS_N);
    ss_double_128(chains->m);

    /* t-chain update over T = 15 bytes. */
    ss_xor(buffer, state->P + SS_N + SS_K, SS_T);
    ss_xor(chains->kt + SS_K, buffer, SS_T);
}

void supersonic_256_forkskinny(const uint8_t key[FORKSKINNY_SUPERSONIC_KEY_SIZE],
                               uint8_t out_left[FORKSKINNY_SUPERSONIC_BLOCK_SIZE],
                               uint8_t out_right[FORKSKINNY_SUPERSONIC_BLOCK_SIZE],
                               const uint8_t *message,
                               size_t message_len)
{
    ss_state_t state;
    ss_chains_t chains;
    uint8_t buffer[SS_N];
    size_t full_before_last;
    size_t final_len;
    uint8_t res_nonzero;
    size_t i;

    memset(&state, 0, sizeof(state));
    memset(&chains, 0, sizeof(chains));
    memset(buffer, 0, sizeof(buffer));

    ss_precompute(key, &state);

    if (message_len == 0u) {
        full_before_last = 0u;
        final_len = 0u;
        res_nonzero = 0u;
    } else {
        final_len = message_len % SS_CHUNK;
        full_before_last = message_len / SS_CHUNK;
        if (final_len == 0u) {
            --full_before_last;
            final_len = SS_CHUNK;
            res_nonzero = 0u;
        } else {
            res_nonzero = 1u;
        }
    }

    if ((full_before_last + 1u) > SS_COUNTER_MAX) {
        memset(out_left, 0, SS_N);
        memset(out_right, 0, SS_N);
        return;
    }

    for (i = 0u; i < full_before_last; ++i) {
        memcpy(state.P, message + (i * SS_CHUNK), SS_CHUNK);
        ss_round(&state, &chains, buffer, (uint16_t)i);
    }

    /* Final chunk, with Sonic-style padding when short. */
    memset(state.P, 0, sizeof(state.P));
    if (final_len != 0u)
        memcpy(state.P, message + (full_before_last * SS_CHUNK), final_len);
    if (final_len < SS_CHUNK)
        state.P[final_len] = SS_END_OF_MSG;
    ss_round(&state, &chains, buffer, (uint16_t)full_before_last);

    /* Finalization. */
    chains.kt[SS_K + SS_T] = (uint8_t)(0x01u + (0x02u * res_nonzero));
    ss_xor(chains.kt, state.K_prime, SS_K);
    ss_xor(chains.m, state.mask, SS_N);
    fs256_both(out_left, out_right, chains.m, chains.kt, chains.kt + SS_K);
}

void forkskinny_supersonic_tag(const uint8_t key[FORKSKINNY_SUPERSONIC_KEY_SIZE],
                               const uint8_t *message,
                               size_t message_len,
                               uint8_t tag[FORKSKINNY_SUPERSONIC_TAG_SIZE])
{
    supersonic_256_forkskinny(key, tag, tag + SS_N, message, message_len);
}
```

## src/forkskinny_supersonic.h
```c
#ifndef FORKSKINNY_SUPERSONIC_H
#define FORKSKINNY_SUPERSONIC_H

#include <stddef.h>
#include <stdint.h>

#define FORKSKINNY_SUPERSONIC_KEY_SIZE   16u
#define FORKSKINNY_SUPERSONIC_BLOCK_SIZE 16u
#define FORKSKINNY_SUPERSONIC_TAG_SIZE   32u

void supersonic_256_forkskinny(const uint8_t key[FORKSKINNY_SUPERSONIC_KEY_SIZE],
                               uint8_t out_left[FORKSKINNY_SUPERSONIC_BLOCK_SIZE],
                               uint8_t out_right[FORKSKINNY_SUPERSONIC_BLOCK_SIZE],
                               const uint8_t *message,
                               uint32_t message_len);

void forkskinny_supersonic_tag(const uint8_t key[FORKSKINNY_SUPERSONIC_KEY_SIZE],
                               const uint8_t *message,
                               uint32_t message_len,
                               uint8_t tag[FORKSKINNY_SUPERSONIC_TAG_SIZE]);

#endif
```
