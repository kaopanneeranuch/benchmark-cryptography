## CMakeLists.txt
```
cmake_minimum_required(VERSION 3.20.0)
find_package(Zephyr REQUIRED HINTS $ENV{ZEPHYR_BASE})

project(forkskinny)

target_include_directories(app PRIVATE ../../forkskinny-opt32 ../../ ../../GCTR-3/forkskinny)

target_sources(app PRIVATE
	src/main.c
	src/bench.c
	src/forkskinny_safe.c
	../../GCTR-3/forkskinny/fenc.c
	../../forkskinny-opt32/internal-forkskinny.c
)
```

## prj.conf
```kconfig
# Timing
CONFIG_TIMING_FUNCTIONS=y

# UART console
CONFIG_UART_CONSOLE=y
CONFIG_CONSOLE=y

# Increase stack size for benchmarking
CONFIG_MAIN_STACK_SIZE=8192
```

## src/main.c
```c
#include <zephyr/kernel.h>
#include <zephyr/sys/printk.h>
#include <zephyr/timing/timing.h>
#include "bench.h"

int main(void)
{
    timing_init();
    timing_start();

    printk("\n=== ForkSkinny-SAFE AEAD Benchmark ===\n\n");

    bench_safe_all();

    timing_stop();

    return 0;
}
```

## src/bench.c
```c
#include <zephyr/kernel.h>
#include <zephyr/sys/printk.h>
#include <zephyr/timing/timing.h>
#include <string.h>
#include <stdint.h>

#include "forkskinny_safe.h"
#include "bench.h"
#include "internal-forkskinny.h"

#define WARMUP_ITERS   10
#define BENCH_ITERS   100
#define MESSAGE_LEN   100
#define AD_LEN         0

static uint8_t pt_buf[MESSAGE_LEN];
static uint8_t ct_buf[MESSAGE_LEN];
static uint8_t dec_buf[MESSAGE_LEN];
static uint8_t tag_buf[SAFE_TAG_LEN];

#if AD_LEN > 0
static uint8_t ad_buf[AD_LEN];
#else
static uint8_t *ad_buf = NULL;
#endif

static safe_key_t ks;

static const uint8_t bench_key[SAFE_KEY_LEN] = {
    0x00,0x01,0x02,0x03,0x04,0x05,0x06,0x07,
    0x08,0x09,0x0a,0x0b,0x0c,0x0d,0x0e,0x0f
};

static void fill_pattern(uint8_t *buf, size_t len)
{
    if (!buf || len == 0) {
        return;
    }

    for (size_t i = 0; i < len; i++) {
        buf[i] = (uint8_t)(i & 0xFF);
    }
}

static void print_hex(const char *label, const uint8_t *buf, size_t len)
{
    printk("%s", label);
    for (size_t i = 0; i < len; i++) {
        printk("%02x", buf[i]);
    }
    printk("\n");
}

void verify_correctness(void)
{
    int rc;

    printk("--- ForkSkinny SAFE Correctness (msg=%d ad=%d) ---\n",
           MESSAGE_LEN, AD_LEN);

    fill_pattern(pt_buf, MESSAGE_LEN);
    fill_pattern(ad_buf, AD_LEN);

    memcpy(ks.key, bench_key, SAFE_KEY_LEN);

    rc = forkskinny_safe_encrypt_auth(&ks,
                                      ad_buf, AD_LEN,
                                      pt_buf, MESSAGE_LEN,
                                      ct_buf,
                                      tag_buf);

    printk("Encrypt+Auth:   %s\n", rc == 0 ? "OK" : "FAIL");
    if (rc != 0) {
        printk("--- End correctness ---\n\n");
        return;
    }

    print_hex("PT[0..15]: ", pt_buf, 16);
    print_hex("CT[0..15]: ", ct_buf, 16);
    print_hex("TAG:       ", tag_buf, SAFE_TAG_LEN);

    rc = forkskinny_safe_decrypt_verify(&ks,
                                        ad_buf, AD_LEN,
                                        ct_buf, MESSAGE_LEN,
                                        tag_buf,
                                        dec_buf);

    print_hex("DEC[0..15]:", dec_buf, 16);
    printk("Decrypt+Verify: %s\n", rc == 0 ? "OK" : "FAIL");

    if (rc == 0 && memcmp(pt_buf, dec_buf, MESSAGE_LEN) == 0) {
        printk("Plaintext match: OK\n");
    } else {
        printk("Plaintext match: FAIL\n");
    }

    printk("--- End correctness ---\n\n");
}


static void bench_hash(void)
{
    timing_t start, end;
    uint64_t total_c = 0, total_ns = 0;

    fill_pattern(pt_buf, MESSAGE_LEN);
    fill_pattern(ad_buf, AD_LEN);
    memcpy(ks.key, bench_key, SAFE_KEY_LEN);

    forkskinny_counters_reset();
    (void)forkskinny_safe_auth(&ks, ad_buf, AD_LEN, pt_buf, MESSAGE_LEN, tag_buf);
    uint32_t enc_per_op = g_fs128_256_enc_calls;
    uint32_t dec_per_op = g_fs128_256_dec_calls;

    for (int i = 0; i < WARMUP_ITERS; i++) {
        (void)forkskinny_safe_auth(&ks,
                                   ad_buf, AD_LEN,
                                   pt_buf, MESSAGE_LEN,
                                   tag_buf);
    }

    for (int i = 0; i < BENCH_ITERS; i++) {
        start = timing_counter_get();
        (void)forkskinny_safe_auth(&ks,
                                   ad_buf, AD_LEN,
                                   pt_buf, MESSAGE_LEN,
                                   tag_buf);
        end = timing_counter_get();

        uint64_t c = timing_cycles_get(&start, &end);
        total_c  += c;
        total_ns += timing_cycles_to_ns(c);

    }

    printk("  %-14s: %10llu cycles  |  %10llu ns\n", "hash (tag)",
           (unsigned long long)(total_c / BENCH_ITERS),
           (unsigned long long)(total_ns / BENCH_ITERS));
    printk("    [prim/op] FS-128-256: enc=%lu dec=%lu\n",
           (unsigned long)enc_per_op, (unsigned long)dec_per_op);
}

static void bench_encrypt(void)
{
    timing_t start, end;
    uint64_t total_c = 0, total_ns = 0;

    fill_pattern(pt_buf, MESSAGE_LEN);
    fill_pattern(ad_buf, AD_LEN);
    memcpy(ks.key, bench_key, SAFE_KEY_LEN);

    (void)forkskinny_safe_auth(&ks,
                               ad_buf, AD_LEN,
                               pt_buf, MESSAGE_LEN,
                               tag_buf);

    forkskinny_counters_reset();
    forkskinny_safe_encrypt(&ks, tag_buf, pt_buf, MESSAGE_LEN, ct_buf);
    uint32_t enc_per_op = g_fs128_256_enc_calls;
    uint32_t dec_per_op = g_fs128_256_dec_calls;

    for (int i = 0; i < WARMUP_ITERS; i++) {
        forkskinny_safe_encrypt(&ks,
                                tag_buf,
                                pt_buf, MESSAGE_LEN,
                                ct_buf);
    }

    for (int i = 0; i < BENCH_ITERS; i++) {
        start = timing_counter_get();
        forkskinny_safe_encrypt(&ks,
                                tag_buf,
                                pt_buf, MESSAGE_LEN,
                                ct_buf);
        end = timing_counter_get();

        uint64_t c = timing_cycles_get(&start, &end);
        total_c  += c;
        total_ns += timing_cycles_to_ns(c);
    }

    printk("  %-14s: %10llu cycles  |  %10llu ns\n", "encrypt",
           (unsigned long long)(total_c / BENCH_ITERS),
           (unsigned long long)(total_ns / BENCH_ITERS));
    printk("    [prim/op] FS-128-256: enc=%lu dec=%lu\n",
           (unsigned long)enc_per_op, (unsigned long)dec_per_op);
}

static void bench_decrypt(void)
{
    timing_t start, end;
    uint64_t total_c = 0, total_ns = 0;

    fill_pattern(pt_buf, MESSAGE_LEN);
    fill_pattern(ad_buf, AD_LEN);
    memcpy(ks.key, bench_key, SAFE_KEY_LEN);

    (void)forkskinny_safe_auth(&ks,
                               ad_buf, AD_LEN,
                               pt_buf, MESSAGE_LEN,
                               tag_buf);

    forkskinny_safe_encrypt(&ks,
                            tag_buf,
                            pt_buf, MESSAGE_LEN,
                            ct_buf);

    forkskinny_counters_reset();
    forkskinny_safe_decrypt(&ks, tag_buf, ct_buf, MESSAGE_LEN, dec_buf);
    uint32_t enc_per_op = g_fs128_256_enc_calls;
    uint32_t dec_per_op = g_fs128_256_dec_calls;

    for (int i = 0; i < WARMUP_ITERS; i++) {
        forkskinny_safe_decrypt(&ks,
                                tag_buf,
                                ct_buf, MESSAGE_LEN,
                                dec_buf);
    }

    for (int i = 0; i < BENCH_ITERS; i++) {
        start = timing_counter_get();
        forkskinny_safe_decrypt(&ks,
                                tag_buf,
                                ct_buf, MESSAGE_LEN,
                                dec_buf);
        end = timing_counter_get();

        uint64_t c = timing_cycles_get(&start, &end);
        total_c  += c;
        total_ns += timing_cycles_to_ns(c);
    }

    printk("  %-14s: %10llu cycles  |  %10llu ns\n", "decrypt",
           (unsigned long long)(total_c / BENCH_ITERS),
           (unsigned long long)(total_ns / BENCH_ITERS));
    printk("    [prim/op] FS-128-256: enc=%lu dec=%lu\n",
           (unsigned long)enc_per_op, (unsigned long)dec_per_op);
}

static void bench_verify(void)
{
    timing_t start, end;
    uint64_t total_c = 0, total_ns = 0;

    fill_pattern(pt_buf, MESSAGE_LEN);
    fill_pattern(ad_buf, AD_LEN);
    memcpy(ks.key, bench_key, SAFE_KEY_LEN);

    (void)forkskinny_safe_auth(&ks,
                               ad_buf, AD_LEN,
                               pt_buf, MESSAGE_LEN,
                               tag_buf);

    forkskinny_counters_reset();
    (void)forkskinny_safe_verify(&ks, ad_buf, AD_LEN, pt_buf, MESSAGE_LEN, tag_buf);
    uint32_t enc_per_op = g_fs128_256_enc_calls;
    uint32_t dec_per_op = g_fs128_256_dec_calls;

    for (int i = 0; i < WARMUP_ITERS; i++) {
        (void)forkskinny_safe_verify(&ks,
                                     ad_buf, AD_LEN,
                                     pt_buf, MESSAGE_LEN,
                                     tag_buf);
    }

    for (int i = 0; i < BENCH_ITERS; i++) {
        start = timing_counter_get();
        (void)forkskinny_safe_verify(&ks,
                                     ad_buf, AD_LEN,
                                     pt_buf, MESSAGE_LEN,
                                     tag_buf);
        end = timing_counter_get();

        uint64_t c = timing_cycles_get(&start, &end);
        total_c  += c;
        total_ns += timing_cycles_to_ns(c);
    }

    printk("  %-14s: %10llu cycles  |  %10llu ns\n", "verify",
           (unsigned long long)(total_c / BENCH_ITERS),
           (unsigned long long)(total_ns / BENCH_ITERS));
    printk("    [prim/op] FS-128-256: enc=%lu dec=%lu\n",
           (unsigned long)enc_per_op, (unsigned long)dec_per_op);
}


void bench_safe_all(void)
{
    printk("[FORKSKINNY SAFE] Benchmark  msg=%d ad=%d iters=%d\n",
           MESSAGE_LEN, AD_LEN, BENCH_ITERS);
    printk("  sizes:  key=%d  nonce=none  tag=%d  pt=%d  ct=%d  ad=%d  (bytes)\n",
           SAFE_KEY_LEN, SAFE_TAG_LEN, MESSAGE_LEN, MESSAGE_LEN, AD_LEN);
    printk("  %-14s  %10s  %12s\n", "operation", "cycles", "ns");

    verify_correctness();

    bench_hash();
    bench_encrypt();
    bench_decrypt();
    bench_verify();
    

    printk("--- Benchmark complete ---\n\n");
}
```

## src/bench.h
```c
#ifndef BENCH_H
#define BENCH_H

void verify_correctness(void);
void bench_safe_all(void);

#endif
```

## src/forkskinny_safe.c
```c
#include "forkskinny_safe.h"
#include "internal-forkskinny.h"
#include "fenc.h"

#include <stdint.h>
#include <stddef.h>
#include <string.h>
#include <stdlib.h>

#define N            16
#define TWO_N        32
#define KEY_LEN      16
#define SAFE_IV_LEN  32

static void ct_memzero(void *p, size_t n)
{
    volatile uint8_t *vp = (volatile uint8_t *)p;
    while (n--) {
        *vp++ = 0;
    }
}

static int ct_memcmp_eq(const uint8_t *a, const uint8_t *b, size_t n)
{
    uint8_t diff = 0;
    for (size_t i = 0; i < n; ++i) {
        diff |= (uint8_t)(a[i] ^ b[i]);
    }
    return diff == 0;
}

// GF(2^256) multiplication

static void xor32(uint8_t dst[32], const uint8_t src[32])
{
    for (int i = 0; i < 32; i++) {
        dst[i] ^= src[i];
    }
}

static void shl1_32(uint8_t x[32])
{
    for (int i = 0; i < 31; i++) {
        x[i] = (uint8_t)((x[i] << 1) | (x[i + 1] >> 7));
    }
    x[31] <<= 1;
}

static void gf_mul(uint8_t out[32], const uint8_t a[32], const uint8_t b[32])
{
    uint8_t z[32] = {0};
    uint8_t v[32];

    memcpy(v, a, 32);

    for (int byte = 0; byte < 32; byte++) {
        for (int bit = 7; bit >= 0; bit--) {
            if ((b[byte] >> bit) & 1U) {
                xor32(z, v);
            }

            {
                uint8_t msb = v[0] & 0x80U;
                shl1_32(v);

                if (msb) {
                    /* x^256 = x^10 + x^5 + x^2 + 1 */
                    v[30] ^= 0x04U;
                    v[31] ^= 0x25U;
                }
            }
        }
    }

    memcpy(out, z, 32);
}

// Pad10 + length encoding

static size_t pad10_len(size_t len)
{
    return len + 1 + ((N - ((len + 1) % N)) % N);
}

static size_t pad10(uint8_t *out, const uint8_t *in, size_t len)
{
    size_t padded_len = pad10_len(len);

    if (len > 0 && in != NULL) {
        memcpy(out, in, len);
    }

    out[len] = 0x80;
    if (padded_len > len + 1) {
        memset(out + len + 1, 0, padded_len - len - 1);
    }

    return padded_len;
}

static void encode_bitlen_be128(uint8_t out[N], size_t len_bytes)
{
    uint64_t hi = ((uint64_t)len_bytes) >> 61;
    uint64_t lo = ((uint64_t)len_bytes) << 3;

    memset(out, 0, N);

    for (int i = 7; i >= 0; --i) {
        out[i] = (uint8_t)(hi & 0xFFU);
        hi >>= 8;
    }

    for (int i = 15; i >= 8; --i) {
        out[i] = (uint8_t)(lo & 0xFFU);
        lo >>= 8;
    }
}

// SAFE bit handling

/* Shift a 128-bit big-endian value right by 1 bit. */
static void be128_rshift1(uint8_t x[16])
{
    uint8_t carry = 0;
    for (int i = 0; i < 16; i++) {
        uint8_t next_carry = (uint8_t)(x[i] & 1U);
        x[i] = (uint8_t)((x[i] >> 1) | (carry << 7));
        carry = next_carry;
    }
}

/* Build tweak = b || V_rep and append key */
static void make_tk(uint8_t tk[32],
                    const uint8_t key[KEY_LEN],
                    uint8_t domain_bit,
                    const uint8_t V[16])
{
    memcpy(tk, V, 16);
    tk[0] &= 0x7FU;
    tk[0] |= (uint8_t)((domain_bit & 1U) << 7);
    memcpy(tk + 16, key, KEY_LEN);
}

/* F_K^{b||V}(U) -> 32-byte output = left || right */
static void split_u_v_255(const uint8_t s[32], uint8_t U[16], uint8_t V[16])
{
    memcpy(U, s, 16);
    memcpy(V, s + 16, 16);
    be128_rshift1(V);
}

/* F_K^{b||V}(U) -> 32-byte output = left || right */
static void tprf_eval_32(const uint8_t key[KEY_LEN],
                         uint8_t domain_bit,
                         const uint8_t V[16],
                         const uint8_t U[16],
                         uint8_t out[32])
{
    uint8_t tk[32];
    make_tk(tk, key, domain_bit, V);
    forkskinny_128_256_encrypt(tk, out, out + 16, U);
}

/* Convert raw SAFE tag to preformatted IV = U || V_rep */
static void safe_iv_from_tag(const uint8_t tag[SAFE_TAG_LEN],
                             uint8_t iv[SAFE_IV_LEN])
{
    uint8_t U[16];
    uint8_t V[16];

    split_u_v_255(tag, U, V);
    memcpy(iv, U, 16);
    memcpy(iv + 16, V, 16);

    ct_memzero(U, sizeof(U));
    ct_memzero(V, sizeof(V));
}

// SFMac

int sfmac(const uint8_t key[KEY_LEN],
          const uint8_t *ad, size_t ad_len,
          const uint8_t *msg, size_t msg_len,
          uint8_t *tag, size_t tag_len)
{
    uint8_t T[TWO_N] = {0};
    uint8_t L[TWO_N];
    uint8_t zeroU[N] = {0};
    uint8_t zeroV[N] = {0};
    uint8_t tmp[TWO_N];
    uint8_t U[N];
    uint8_t V[N];
    uint8_t Y[TWO_N];
    uint8_t *X;
    size_t a_pad_len, m_pad_len, x_len;
    size_t off = 0;

    if (!key || !tag) {
        return -1;
    }
    if ((ad_len && !ad) || (msg_len && !msg)) {
        return -1;
    }
    if (tag_len > TWO_N) {
        return -1;
    }

    /* X = Pad10(A) || Pad10(M) || <|A|>_n || <|M|>_n */
    a_pad_len = pad10_len(ad_len);
    m_pad_len = pad10_len(msg_len);
    x_len = a_pad_len + m_pad_len + TWO_N;

    X = (uint8_t *)malloc(x_len);
    if (!X) {
        return -1;
    }

    off += pad10(X + off, ad, ad_len);
    off += pad10(X + off, msg, msg_len);

    encode_bitlen_be128(X + off, ad_len);
    off += N;
    encode_bitlen_be128(X + off, msg_len);
    off += N;

    /* L <- [F_K^(0^(t+1))(0^n)]_(2n) */
    tprf_eval_32(key, 0, zeroV, zeroU, L);

    /* Process X in 16-byte chunks by buffering two into a 32-byte block */
    uint8_t block[TWO_N];
    size_t block_off = 0;
    for (size_t i = 0; i < x_len; i += N) {
        memcpy(block + block_off, X + i, N);
        block_off += N;
        if (block_off == TWO_N) {
            for (size_t j = 0; j < TWO_N; ++j) {
                tmp[j] = (uint8_t)(T[j] ^ block[j]);
            }
            gf_mul(T, tmp, L);
            block_off = 0;
        }
    }

    /* Handle any leftover (shouldn't happen with current padding, but be safe) */
    if (block_off) {
        memset(block + block_off, 0, TWO_N - block_off);
        for (size_t j = 0; j < TWO_N; ++j) {
            tmp[j] = (uint8_t)(T[j] ^ block[j]);
        }
        gf_mul(T, tmp, L);
    }

    /* U || V <- [T]_(n+t) with n+t = 255 */
    split_u_v_255(T, U, V);

    /* T <- F_K^(0 || V)(U) */
    tprf_eval_32(key, 0, V, U, Y);

    memcpy(tag, Y, tag_len);

    free(X);
    ct_memzero(L, sizeof(L));
    ct_memzero(T, sizeof(T));
    ct_memzero(tmp, sizeof(tmp));
    ct_memzero(U, sizeof(U));
    ct_memzero(V, sizeof(V));
    ct_memzero(Y, sizeof(Y));

    return 0;
}

int forkskinny_safe_auth(const safe_key_t *ks,
                         const uint8_t *ad, size_t adlen,
                         const uint8_t *msg, size_t mlen,
                         uint8_t tag[SAFE_TAG_LEN])
{
    return sfmac(ks->key, ad, adlen, msg, mlen, tag, SAFE_TAG_LEN);
}

int forkskinny_safe_verify(const safe_key_t *ks,
                           const uint8_t *ad, size_t adlen,
                           const uint8_t *msg, size_t mlen,
                           const uint8_t tag[SAFE_TAG_LEN])
{
    uint8_t computed[SAFE_TAG_LEN];
    int rc;

    rc = sfmac(ks->key, ad, adlen, msg, mlen, computed, SAFE_TAG_LEN);
    if (rc != 0) {
        ct_memzero(computed, sizeof(computed));
        return -1;
    }

    rc = ct_memcmp_eq(computed, tag, SAFE_TAG_LEN) ? 0 : -1;
    ct_memzero(computed, sizeof(computed));
    return rc;
}

void forkskinny_safe_encrypt(const safe_key_t *ks,
                             const uint8_t tag[SAFE_TAG_LEN],
                             const uint8_t *pt, size_t ptlen,
                             uint8_t *ct)
{
    uint8_t iv[SAFE_IV_LEN];

    safe_iv_from_tag(tag, iv);
    fenc(ks->key, iv, pt, ptlen, ct);
    ct_memzero(iv, sizeof(iv));
}

void forkskinny_safe_decrypt(const safe_key_t *ks,
                             const uint8_t tag[SAFE_TAG_LEN],
                             const uint8_t *ct, size_t ctlen,
                             uint8_t *pt)
{
    uint8_t iv[SAFE_IV_LEN];

    safe_iv_from_tag(tag, iv);
    fenc(ks->key, iv, ct, ctlen, pt);
    ct_memzero(iv, sizeof(iv));
}

int forkskinny_safe_encrypt_auth(const safe_key_t *ks,
                                 const uint8_t *ad, size_t adlen,
                                 const uint8_t *msg, size_t mlen,
                                 uint8_t *ct,
                                 uint8_t tag[SAFE_TAG_LEN])
{
    int rc;

    rc = sfmac(ks->key, ad, adlen, msg, mlen, tag, SAFE_TAG_LEN);
    if (rc != 0) {
        return -1;
    }

    forkskinny_safe_encrypt(ks, tag, msg, mlen, ct);
    return 0;
}

int forkskinny_safe_decrypt_verify(const safe_key_t *ks,
                                   const uint8_t *ad, size_t adlen,
                                   const uint8_t *ct, size_t clen,
                                   const uint8_t tag[SAFE_TAG_LEN],
                                   uint8_t *msg)
{
    uint8_t computed[SAFE_TAG_LEN];
    int rc;

    forkskinny_safe_decrypt(ks, tag, ct, clen, msg);

    rc = sfmac(ks->key, ad, adlen, msg, clen, computed, SAFE_TAG_LEN);
    if (rc != 0) {
        ct_memzero(computed, sizeof(computed));
        ct_memzero(msg, clen);
        return -1;
    }

    rc = ct_memcmp_eq(computed, tag, SAFE_TAG_LEN) ? 0 : -1;
    ct_memzero(computed, sizeof(computed));

    if (rc != 0) {
        ct_memzero(msg, clen);
        return -1;
    }

    return 0;
}
```

## src/forkskinny_safe.h
```c
#ifndef FORKSKINNY_SAFE_H
#define FORKSKINNY_SAFE_H

#include <stddef.h>
#include <stdint.h>

#define SAFE_KEY_LEN 16
#define SAFE_TAG_LEN 32

typedef struct {
    uint8_t key[SAFE_KEY_LEN];
} safe_key_t;

int forkskinny_safe_auth(const safe_key_t *ks,
                         const uint8_t *ad, size_t adlen,
                         const uint8_t *msg, size_t mlen,
                         uint8_t tag[SAFE_TAG_LEN]);

int forkskinny_safe_verify(const safe_key_t *ks,
                           const uint8_t *ad, size_t adlen,
                           const uint8_t *msg, size_t mlen,
                           const uint8_t tag[SAFE_TAG_LEN]);

void forkskinny_safe_encrypt(const safe_key_t *ks,
                             const uint8_t tag[SAFE_TAG_LEN],
                             const uint8_t *pt, size_t ptlen,
                             uint8_t *ct);

void forkskinny_safe_decrypt(const safe_key_t *ks,
                             const uint8_t tag[SAFE_TAG_LEN],
                             const uint8_t *ct, size_t ctlen,
                             uint8_t *pt);

int forkskinny_safe_encrypt_auth(const safe_key_t *ks,
                                 const uint8_t *ad, size_t adlen,
                                 const uint8_t *msg, size_t mlen,
                                 uint8_t *ct,
                                 uint8_t tag[SAFE_TAG_LEN]);

int forkskinny_safe_decrypt_verify(const safe_key_t *ks,
                                   const uint8_t *ad, size_t adlen,
                                   const uint8_t *ct, size_t clen,
                                   const uint8_t tag[SAFE_TAG_LEN],
                                   uint8_t *msg);

#endif
```
