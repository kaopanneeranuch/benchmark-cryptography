## CMakeLists.txt
```
cmake_minimum_required(VERSION 3.20.0)
find_package(Zephyr REQUIRED HINTS $ENV{ZEPHYR_BASE})

project(skinny)

target_include_directories(app PRIVATE ../../ ../../skinny_tbc)

target_sources(app PRIVATE
	src/main.c
	src/skinny_ocb.c
	../../skinny_tbc/skinny_tbc.c
	src/bench.c
	../../SKINNY-AEAD/internal-skinny128.c
)
```

## prj.conf
```kconfig
# Timing
CONFIG_TIMING_FUNCTIONS=y

# RTT console
CONFIG_USE_SEGGER_RTT=y
CONFIG_RTT_CONSOLE=y
CONFIG_UART_CONSOLE=n
CONFIG_CONSOLE=y
```

## src/main.c
```c
#include <zephyr/kernel.h>
#include <zephyr/sys/printk.h>
#include <zephyr/timing/timing.h>
#include "bench.h"

void main(void)
{
    timing_init();
    timing_start();

    printk("\n=== Skinny-OCB AEAD Benchmark ===\n\n");

    verify_correctness();
    bench_ocb_all();

    timing_stop();
}
```

## src/bench.c
```c
#include <zephyr/kernel.h>
#include <zephyr/sys/printk.h>
#include <zephyr/timing/timing.h>
#include <string.h>
#include <stdint.h>
#include "skinny_ocb.h"
#include "bench.h"

/* ── configuration ──────────────────────────────────────── */
#define WARMUP_ITERS   10
#define BENCH_ITERS   100
#define MESSAGE_LEN   100
#define AD_LEN         0

/* work buffers */
static uint8_t pt_buf[MESSAGE_LEN];
static uint8_t ct_buf[MESSAGE_LEN];
static uint8_t dec_buf[MESSAGE_LEN];
static uint8_t tag_buf[OCB_TAG_LEN];
#if AD_LEN > 0
static uint8_t ad_buf[AD_LEN];
#else
static uint8_t *ad_buf = NULL;
#endif
static ocb_key_t ks;

static const uint8_t bench_key[OCB_KEY_LEN] = {
    0x00,0x01,0x02,0x03,0x04,0x05,0x06,0x07,
    0x08,0x09,0x0a,0x0b,0x0c,0x0d,0x0e,0x0f
};
static const uint8_t bench_nonce[OCB_NONCE_LEN] = {
    0xa0,0xa1,0xa2,0xa3,0xa4,0xa5,0xa6,0xa7,
    0xa8,0xa9,0xaa,0xab
};

static void fill_pattern(uint8_t *buf, size_t len)
{
    for (size_t i = 0; i < len; i++) buf[i] = (uint8_t)(i & 0xff);
}

static void print_hex(const char *label, const uint8_t *buf, size_t len)
{
    printk("%s", label);
    for (size_t i = 0; i < len; i++) printk("%02x", buf[i]);
    printk("\n");
}

/* ── correctness check ─────────────────────────────────── */
void verify_correctness(void)
{
    printk("--- SKINNY OCB Correctness (msg=%d ad=%d) ---\n",
           MESSAGE_LEN, AD_LEN);

    fill_pattern(pt_buf, MESSAGE_LEN);
#if AD_LEN > 0
    fill_pattern(ad_buf, AD_LEN);
#endif
    skinny_ocb_keygen(bench_key, &ks);

    skinny_ocb_encrypt_auth(&ks, bench_nonce,
                            ad_buf, AD_LEN,
                            pt_buf, MESSAGE_LEN,
                            ct_buf, tag_buf);

    print_hex("PT[0..15]: ", pt_buf, 16);
    print_hex("CT[0..15]: ", ct_buf, 16);
    print_hex("TAG:       ", tag_buf, OCB_TAG_LEN);

    int rc = skinny_ocb_decrypt_verify(&ks, bench_nonce,
                                       ad_buf, AD_LEN,
                                       ct_buf, MESSAGE_LEN,
                                       tag_buf, dec_buf);

    print_hex("DEC[0..15]:", dec_buf, 16);
    printk("Decrypt+Verify: %s\n", rc == 0 ? "OK" : "FAIL");

    if (memcmp(pt_buf, dec_buf, MESSAGE_LEN) == 0)
        printk("Plaintext match: OK\n");
    else
        printk("Plaintext match: FAIL\n");

    printk("--- End correctness ---\n\n");
}

/* ── individual benchmarks ─────────────────────────────── */

static void bench_keygen(void)
{
    timing_t start, end;
    uint64_t total_c = 0, total_ns = 0;

    for (int i = 0; i < WARMUP_ITERS; i++)
        skinny_ocb_keygen(bench_key, &ks);

    for (int i = 0; i < BENCH_ITERS; i++) {
        start = timing_counter_get();
        skinny_ocb_keygen(bench_key, &ks);
        end = timing_counter_get();
        uint64_t c = timing_cycles_get(&start, &end);
        total_c  += c;
        total_ns += timing_cycles_to_ns(c);
    }
    printk("  %-14s: %10llu cycles  |  %10llu ns\n", "keygen",
           (unsigned long long)(total_c / BENCH_ITERS),
           (unsigned long long)(total_ns / BENCH_ITERS));
}

static void bench_hash(void)
{
    timing_t start, end;
    uint64_t total_c = 0, total_ns = 0;

    fill_pattern(pt_buf, MESSAGE_LEN);
    skinny_ocb_keygen(bench_key, &ks);

    for (int i = 0; i < WARMUP_ITERS; i++)
        skinny_ocb_hash(&ks, bench_nonce,
                        ad_buf, AD_LEN,
                        pt_buf, MESSAGE_LEN, tag_buf);

    for (int i = 0; i < BENCH_ITERS; i++) {
        start = timing_counter_get();
        skinny_ocb_hash(&ks, bench_nonce,
                        ad_buf, AD_LEN,
                        pt_buf, MESSAGE_LEN, tag_buf);
        end = timing_counter_get();
        uint64_t c = timing_cycles_get(&start, &end);
        total_c  += c;
        total_ns += timing_cycles_to_ns(c);
    }
    printk("  %-14s: %10llu cycles  |  %10llu ns\n", "hash (tag)",
           (unsigned long long)(total_c / BENCH_ITERS),
           (unsigned long long)(total_ns / BENCH_ITERS));
}

static void bench_encrypt(void)
{
    timing_t start, end;
    uint64_t total_c = 0, total_ns = 0;

    fill_pattern(pt_buf, MESSAGE_LEN);
    skinny_ocb_keygen(bench_key, &ks);

    for (int i = 0; i < WARMUP_ITERS; i++)
        skinny_ocb_encrypt(&ks, bench_nonce,
                           pt_buf, MESSAGE_LEN, ct_buf);

    for (int i = 0; i < BENCH_ITERS; i++) {
        start = timing_counter_get();
        skinny_ocb_encrypt(&ks, bench_nonce,
                           pt_buf, MESSAGE_LEN, ct_buf);
        end = timing_counter_get();
        uint64_t c = timing_cycles_get(&start, &end);
        total_c  += c;
        total_ns += timing_cycles_to_ns(c);
    }
    printk("  %-14s: %10llu cycles  |  %10llu ns\n", "encrypt",
           (unsigned long long)(total_c / BENCH_ITERS),
           (unsigned long long)(total_ns / BENCH_ITERS));
}

static void bench_decrypt(void)
{
    timing_t start, end;
    uint64_t total_c = 0, total_ns = 0;

    fill_pattern(pt_buf, MESSAGE_LEN);
    skinny_ocb_keygen(bench_key, &ks);
    skinny_ocb_encrypt(&ks, bench_nonce,
                       pt_buf, MESSAGE_LEN, ct_buf);

    for (int i = 0; i < WARMUP_ITERS; i++)
        skinny_ocb_decrypt(&ks, bench_nonce,
                           ct_buf, MESSAGE_LEN, dec_buf);

    for (int i = 0; i < BENCH_ITERS; i++) {
        start = timing_counter_get();
        skinny_ocb_decrypt(&ks, bench_nonce,
                           ct_buf, MESSAGE_LEN, dec_buf);
        end = timing_counter_get();
        uint64_t c = timing_cycles_get(&start, &end);
        total_c  += c;
        total_ns += timing_cycles_to_ns(c);
    }
    printk("  %-14s: %10llu cycles  |  %10llu ns\n", "decrypt",
           (unsigned long long)(total_c / BENCH_ITERS),
           (unsigned long long)(total_ns / BENCH_ITERS));
}

static void bench_verify(void)
{
    timing_t start, end;
    uint64_t total_c = 0, total_ns = 0;

    fill_pattern(pt_buf, MESSAGE_LEN);
    skinny_ocb_keygen(bench_key, &ks);
    skinny_ocb_hash(&ks, bench_nonce,
                    ad_buf, AD_LEN,
                    pt_buf, MESSAGE_LEN, tag_buf);

    for (int i = 0; i < WARMUP_ITERS; i++)
        skinny_ocb_verify(&ks, bench_nonce,
                          ad_buf, AD_LEN,
                          pt_buf, MESSAGE_LEN, tag_buf);

    for (int i = 0; i < BENCH_ITERS; i++) {
        start = timing_counter_get();
        skinny_ocb_verify(&ks, bench_nonce,
                          ad_buf, AD_LEN,
                          pt_buf, MESSAGE_LEN, tag_buf);
        end = timing_counter_get();
        uint64_t c = timing_cycles_get(&start, &end);
        total_c  += c;
        total_ns += timing_cycles_to_ns(c);
    }
    printk("  %-14s: %10llu cycles  |  %10llu ns\n", "verify",
           (unsigned long long)(total_c / BENCH_ITERS),
           (unsigned long long)(total_ns / BENCH_ITERS));
}

/* ── top-level entry ───────────────────────────────────── */
void bench_ocb_all(void)
{
    printk("[SKINNY OCB] Benchmark  msg=%d ad=%d iters=%d\n",
           MESSAGE_LEN, AD_LEN, BENCH_ITERS);
    printk("  %-14s  %10s  %12s\n", "operation", "cycles", "ns");

    bench_keygen();
    bench_hash();
    bench_encrypt();
    bench_decrypt();
    bench_verify();

    printk("--- Benchmark complete ---\n\n");
}
```

## src/bench.h
```c
#ifndef BENCH_H
#define BENCH_H

void verify_correctness(void);
void bench_ocb_all(void);

#endif /* BENCH_H */
```

## src/skinny_ocb.c
```c
#include "skinny_ocb.h"
#include "skinny_tbc.h"
#include <string.h>

/* ══════════════════════════════════════════════════════════
 *  OCB mode instantiated with SKINNY-128-256 TBC
 *  Reference: https://eprint.iacr.org/2001/026  (OCB)
 *
 *  When using a TBC the offset-doubling mechanism of OCB is
 *  replaced by encoding (domain, counter, nonce) directly
 *  into the tweak.  This yields ΘCB / OCB-TBC.
 *
 *  SKINNY-128-256:
 *    n = 128 (block), k = 128 (key), t = 128 (tweak)
 *    nonce = 96 bits, tag = 128 bits
 *
 *  Tweak layout (128 bits = 16 bytes):
 *    domain(4 bits) || counter(28 bits) || nonce(96 bits)
 *
 *  Domain values:
 *    Encryption / decryption of message blocks:
 *      0x0  Msg full block
 *      0x1  Msg last block, padded
 *
 *    AD hash:
 *      0x2  AD full block
 *      0x3  AD last block, padded
 *
 *    Tag finalization:
 *      0x4  Tag (encrypt checksum)
 *
 *  OCB-TBC Enc(K, N, A, M) → (C, T):
 *    Σ ← 0^n  (checksum = XOR of all full plaintext blocks)
 *    For each full msg block M_i (i = 0, 1, ...):
 *      C_i ← Ẽ_K^{0x0, i, N}(M_i)
 *      Σ ← Σ ⊕ M_i
 *    If last block M* is partial (|M*| < n):
 *      pad M* → M*||10*
 *      Σ ← Σ ⊕ (M*||10*)
 *      Pad ← Ẽ_K^{0x1, m, N}(0^n)    (m = index of last block)
 *      C* ← M* ⊕ Pad[0..|M*|-1]      (truncated)
 *    Auth ← 0^n
 *    For each full AD block A_j:
 *      Auth ← Auth ⊕ Ẽ_K^{0x2, j, N}(A_j)
 *    If last AD block A* is partial:
 *      pad A* → A*||10*
 *      Auth ← Auth ⊕ Ẽ_K^{0x3, a, N}(A*||10*)
 *    T ← Ẽ_K^{0x4, 0, N}(Σ) ⊕ Auth
 *
 *  OCB-TBC Dec(K, N, A, C, T) → M or ⊥:
 *    Σ ← 0^n
 *    For each full ct block C_i:
 *      M_i ← Ẽ_K^{-1, 0x0, i, N}(C_i)    (TBC decrypt)
 *      Σ ← Σ ⊕ M_i
 *    If last block C* is partial:
 *      Pad ← Ẽ_K^{0x1, m, N}(0^n)
 *      M* ← C* ⊕ Pad[0..|C*|-1]
 *      Σ ← Σ ⊕ (M*||10*)
 *    Auth ← hash AD (same as encrypt)
 *    T' ← Ẽ_K^{0x4, 0, N}(Σ) ⊕ Auth
 *    if T' ≠ T: return ⊥
 * ══════════════════════════════════════════════════════════ */

/* ── helpers ─────────────────────────────────────────────── */

static void build_tweak(uint8_t tweak[16], uint8_t domain,
                        uint32_t counter, const uint8_t nonce[OCB_NONCE_LEN])
{
    tweak[0] = (uint8_t)((domain << 4) | ((counter >> 24) & 0x0F));
    tweak[1] = (uint8_t)((counter >> 16) & 0xFF);
    tweak[2] = (uint8_t)((counter >>  8) & 0xFF);
    tweak[3] = (uint8_t)( counter        & 0xFF);
    memcpy(tweak + 4, nonce, OCB_NONCE_LEN);
}

static void xor_block(uint8_t *dst, const uint8_t *a, const uint8_t *b,
                      size_t len)
{
    for (size_t i = 0; i < len; i++) dst[i] = a[i] ^ b[i];
}

static void pad_block(uint8_t padded[16], const uint8_t *src, size_t len)
{
    memset(padded, 0, 16);
    memcpy(padded, src, len);
    padded[len] = 0x80;
}

/* ── AD hash: returns Auth ═ ⊕ Ẽ(A_j) ──────────────────── */

static void hash_ad(const ocb_key_t *ks,
                    const uint8_t nonce[OCB_NONCE_LEN],
                    const uint8_t *ad, size_t adlen,
                    uint8_t auth[16])
{
    memset(auth, 0, 16);
    if (adlen == 0) return;

    uint8_t tweak[16], out[16], padded[16];

    size_t full = adlen / 16;
    size_t rem  = adlen % 16;

    for (size_t j = 0; j < full; j++) {
        build_tweak(tweak, 0x2, (uint32_t)j, nonce);
        skinny_encrypt(ks->key, tweak, ad + j * 16, out);
        xor_block(auth, auth, out, 16);
    }

    if (rem > 0) {
        pad_block(padded, ad + full * 16, rem);
        build_tweak(tweak, 0x3, (uint32_t)full, nonce);
        skinny_encrypt(ks->key, tweak, padded, out);
        xor_block(auth, auth, out, 16);
    }
}

/* ── OCB key setup ──────────────────────────────────────── */

void skinny_ocb_keygen(const uint8_t key[OCB_KEY_LEN],
                       ocb_key_t *ks)
{
    memcpy(ks->key, key, OCB_KEY_LEN);
}

/* ────────────────────────────────────────────────────────
 *  Encrypt: OCB-TBC encrypt message blocks
 * ──────────────────────────────────────────────────────── */
void skinny_ocb_encrypt(const ocb_key_t *ks,
                        const uint8_t nonce[OCB_NONCE_LEN],
                        const uint8_t *msg, size_t mlen,
                        uint8_t *ct)
{
    uint8_t tweak[16], zero[16], pad_ks[16];

    size_t full = mlen / 16;
    size_t rem  = mlen % 16;

    /* full blocks: C_i = Ẽ_K(M_i) */
    for (size_t i = 0; i < full; i++) {
        build_tweak(tweak, 0x0, (uint32_t)i, nonce);
        skinny_encrypt(ks->key, tweak, msg + i * 16, ct + i * 16);
    }

    /* partial last block: C* = M* ⊕ Ẽ_K(0^n)[0..|M*|] */
    if (rem > 0) {
        memset(zero, 0, 16);
        build_tweak(tweak, 0x1, (uint32_t)full, nonce);
        skinny_encrypt(ks->key, tweak, zero, pad_ks);
        xor_block(ct + full * 16, msg + full * 16, pad_ks, rem);
    }
}

/* ────────────────────────────────────────────────────────
 *  Decrypt: OCB-TBC decrypt ciphertext blocks
 * ──────────────────────────────────────────────────────── */
void skinny_ocb_decrypt(const ocb_key_t *ks,
                        const uint8_t nonce[OCB_NONCE_LEN],
                        const uint8_t *ct, size_t clen,
                        uint8_t *msg)
{
    uint8_t tweak[16], zero[16], pad_ks[16];

    size_t full = clen / 16;
    size_t rem  = clen % 16;

    /* full blocks: M_i = Ẽ_K^{-1}(C_i) */
    for (size_t i = 0; i < full; i++) {
        build_tweak(tweak, 0x0, (uint32_t)i, nonce);
        skinny_decrypt(ks->key, tweak, ct + i * 16, msg + i * 16);
    }

    /* partial last block: M* = C* ⊕ Ẽ_K(0^n)[0..|C*|] */
    if (rem > 0) {
        memset(zero, 0, 16);
        build_tweak(tweak, 0x1, (uint32_t)full, nonce);
        skinny_encrypt(ks->key, tweak, zero, pad_ks);
        xor_block(msg + full * 16, ct + full * 16, pad_ks, rem);
    }
}

/* ────────────────────────────────────────────────────────
 *  Hash (tag): checksum of plaintext ⊕ AD auth
 *    T = Ẽ_K^{0x4,0,N}(Σ) ⊕ Auth
 *  where Σ = M_0 ⊕ M_1 ⊕ ... (⊕ padded last block)
 * ──────────────────────────────────────────────────────── */
void skinny_ocb_hash(const ocb_key_t *ks,
                     const uint8_t nonce[OCB_NONCE_LEN],
                     const uint8_t *ad, size_t adlen,
                     const uint8_t *msg, size_t mlen,
                     uint8_t tag[OCB_TAG_LEN])
{
    uint8_t tweak[16], padded[16];
    uint8_t sigma[16];   /* plaintext checksum */
    uint8_t auth[16];    /* AD hash */
    memset(sigma, 0, 16);

    size_t full = mlen / 16;
    size_t rem  = mlen % 16;

    /* Σ = ⊕ M_i (full blocks) */
    for (size_t i = 0; i < full; i++)
        xor_block(sigma, sigma, msg + i * 16, 16);

    /* partial last block: Σ ⊕= (M*||10*) */
    if (rem > 0) {
        pad_block(padded, msg + full * 16, rem);
        xor_block(sigma, sigma, padded, 16);
    }

    /* T_msg = Ẽ_K^{0x4, 0, N}(Σ) */
    build_tweak(tweak, 0x4, 0, nonce);
    skinny_encrypt(ks->key, tweak, sigma, tag);

    /* Auth = hash of AD */
    hash_ad(ks, nonce, ad, adlen, auth);

    /* T = T_msg ⊕ Auth */
    xor_block(tag, tag, auth, 16);
}

/* ────────────────────────────────────────────────────────
 *  Verify: recompute tag, compare.
 * ──────────────────────────────────────────────────────── */
int skinny_ocb_verify(const ocb_key_t *ks,
                      const uint8_t nonce[OCB_NONCE_LEN],
                      const uint8_t *ad, size_t adlen,
                      const uint8_t *msg, size_t mlen,
                      const uint8_t tag[OCB_TAG_LEN])
{
    uint8_t computed[OCB_TAG_LEN];
    skinny_ocb_hash(ks, nonce, ad, adlen, msg, mlen, computed);

    int diff = 0;
    for (int i = 0; i < OCB_TAG_LEN; i++)
        diff |= computed[i] ^ tag[i];
    return (diff == 0) ? 0 : -1;
}

/* ────────────────────────────────────────────────────────
 *  Enc(K, N, A, M) → (C, T)
 *    Single-pass: encrypt blocks + accumulate checksum + AD hash
 * ──────────────────────────────────────────────────────── */
void skinny_ocb_encrypt_auth(const ocb_key_t *ks,
                             const uint8_t nonce[OCB_NONCE_LEN],
                             const uint8_t *ad, size_t adlen,
                             const uint8_t *msg, size_t mlen,
                             uint8_t *ct,
                             uint8_t tag[OCB_TAG_LEN])
{
    uint8_t tweak[16], zero[16], pad_ks[16], padded[16];
    uint8_t sigma[16], auth[16];
    memset(sigma, 0, 16);

    size_t full = mlen / 16;
    size_t rem  = mlen % 16;

    /* encrypt full blocks + accumulate checksum */
    for (size_t i = 0; i < full; i++) {
        build_tweak(tweak, 0x0, (uint32_t)i, nonce);
        skinny_encrypt(ks->key, tweak, msg + i * 16, ct + i * 16);
        xor_block(sigma, sigma, msg + i * 16, 16);
    }

    /* partial last block */
    if (rem > 0) {
        memset(zero, 0, 16);
        build_tweak(tweak, 0x1, (uint32_t)full, nonce);
        skinny_encrypt(ks->key, tweak, zero, pad_ks);
        xor_block(ct + full * 16, msg + full * 16, pad_ks, rem);

        pad_block(padded, msg + full * 16, rem);
        xor_block(sigma, sigma, padded, 16);
    }

    /* tag = Ẽ(Σ) ⊕ Auth */
    build_tweak(tweak, 0x4, 0, nonce);
    skinny_encrypt(ks->key, tweak, sigma, tag);

    hash_ad(ks, nonce, ad, adlen, auth);
    xor_block(tag, tag, auth, 16);
}

/* ────────────────────────────────────────────────────────
 *  Dec(K, N, A, C, T) → M or ⊥
 * ──────────────────────────────────────────────────────── */
int skinny_ocb_decrypt_verify(const ocb_key_t *ks,
                              const uint8_t nonce[OCB_NONCE_LEN],
                              const uint8_t *ad, size_t adlen,
                              const uint8_t *ct, size_t clen,
                              const uint8_t tag[OCB_TAG_LEN],
                              uint8_t *msg)
{
    uint8_t tweak[16], zero[16], pad_ks[16], padded[16];
    uint8_t sigma[16], auth[16], computed_tag[16];
    memset(sigma, 0, 16);

    size_t full = clen / 16;
    size_t rem  = clen % 16;

    /* decrypt full blocks + accumulate checksum */
    for (size_t i = 0; i < full; i++) {
        build_tweak(tweak, 0x0, (uint32_t)i, nonce);
        skinny_decrypt(ks->key, tweak, ct + i * 16, msg + i * 16);
        xor_block(sigma, sigma, msg + i * 16, 16);
    }

    /* partial last block */
    if (rem > 0) {
        memset(zero, 0, 16);
        build_tweak(tweak, 0x1, (uint32_t)full, nonce);
        skinny_encrypt(ks->key, tweak, zero, pad_ks);
        xor_block(msg + full * 16, ct + full * 16, pad_ks, rem);

        pad_block(padded, msg + full * 16, rem);
        xor_block(sigma, sigma, padded, 16);
    }

    /* verify tag */
    build_tweak(tweak, 0x4, 0, nonce);
    skinny_encrypt(ks->key, tweak, sigma, computed_tag);

    hash_ad(ks, nonce, ad, adlen, auth);
    xor_block(computed_tag, computed_tag, auth, 16);

    int diff = 0;
    for (int i = 0; i < OCB_TAG_LEN; i++)
        diff |= computed_tag[i] ^ tag[i];

    if (diff != 0) {
        memset(msg, 0, clen);
        return -1;
    }
    return 0;
}
```

## src/skinny_ocb.h
```c
#ifndef SKINNY_OCB_H
#define SKINNY_OCB_H

#include <stdint.h>
#include <stddef.h>

#define OCB_KEY_LEN    16
#define OCB_NONCE_LEN  12
#define OCB_TAG_LEN    16
#define OCB_BLOCK_LEN  16

typedef struct {
    uint8_t key[OCB_KEY_LEN];
} ocb_key_t;

/* Key setup */
void skinny_ocb_keygen(const uint8_t key[OCB_KEY_LEN],
                       ocb_key_t *ks);

/* Full AEAD */
void skinny_ocb_encrypt_auth(const ocb_key_t *ks,
                             const uint8_t nonce[OCB_NONCE_LEN],
                             const uint8_t *ad, size_t adlen,
                             const uint8_t *msg, size_t mlen,
                             uint8_t *ct,
                             uint8_t tag[OCB_TAG_LEN]);

int  skinny_ocb_decrypt_verify(const ocb_key_t *ks,
                               const uint8_t nonce[OCB_NONCE_LEN],
                               const uint8_t *ad, size_t adlen,
                               const uint8_t *ct, size_t clen,
                               const uint8_t tag[OCB_TAG_LEN],
                               uint8_t *msg);

/* Split operations for benchmarking */
void skinny_ocb_hash(const ocb_key_t *ks,
                     const uint8_t nonce[OCB_NONCE_LEN],
                     const uint8_t *ad, size_t adlen,
                     const uint8_t *msg, size_t mlen,
                     uint8_t tag[OCB_TAG_LEN]);

void skinny_ocb_encrypt(const ocb_key_t *ks,
                        const uint8_t nonce[OCB_NONCE_LEN],
                        const uint8_t *msg, size_t mlen,
                        uint8_t *ct);

void skinny_ocb_decrypt(const ocb_key_t *ks,
                        const uint8_t nonce[OCB_NONCE_LEN],
                        const uint8_t *ct, size_t clen,
                        uint8_t *msg);

int  skinny_ocb_verify(const ocb_key_t *ks,
                       const uint8_t nonce[OCB_NONCE_LEN],
                       const uint8_t *ad, size_t adlen,
                       const uint8_t *msg, size_t mlen,
                       const uint8_t tag[OCB_TAG_LEN]);

#endif /* SKINNY_OCB_H */
```
