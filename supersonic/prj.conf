## CMakeLists.txt
```
cmake_minimum_required(VERSION 3.20.0)
find_package(Zephyr REQUIRED HINTS $ENV{ZEPHYR_BASE})

project(supersonic)

zephyr_include_directories(
    ../BC__Butterknife/include
    ../forkskinny-opt32
    src/include
)

target_sources(app PRIVATE
    src/main.c
    src/supersonic_butterknife.c
    src/supersonic_forkskinny.c
    src/gctr3.c
    ../BC__Butterknife/source/butterknife256_tks.c
    ../BC__Butterknife/source/butterknife256.c
    ../forkskinny-opt32/internal-forkskinny.c
)
```

## prj.conf
```kconfig
CONFIG_TIMING_FUNCTIONS=y

# UART console
CONFIG_UART_CONSOLE=y
CONFIG_CONSOLE=y

# Increase stack size for benchmarking
CONFIG_MAIN_STACK_SIZE=16384
```

## src/main.c
```c
#include <zephyr/kernel.h>
#include <zephyr/sys/printk.h>
#include <zephyr/timing/timing.h>

#include <inttypes.h>
#include <stdint.h>
#include <string.h>

#include "include/gctr3.h"
#include "include/sonics_ref.h"
#include "include/supersonic.h"
#include "butterknife.h"

#define WARMUP_ITERS  10
#define BENCH_ITERS  100
#define MAX_MSG_LEN  4096
#define TOTAL_ITERS  (WARMUP_ITERS + BENCH_ITERS)

typedef void (*supersonic_fn_t)(const uint8_t key[16],
                                uint8_t out_left[16],
                                uint8_t out_right[16],
                                const uint8_t *message,
                                const uint32_t mlen);

static uint8_t msg_buf[4096];
static uint8_t out_buf[4096];
static uint8_t dec_buf[4096];
static const uint8_t bench_key[16] = {
    0x00, 0x01, 0x02, 0x03,
    0x04, 0x05, 0x06, 0x07,
    0x08, 0x09, 0x0a, 0x0b,
    0x0c, 0x0d, 0x0e, 0x0f
};
static const uint8_t gctr_r[16] = {
    0xa0, 0xa1, 0xa2, 0xa3,
    0xa4, 0xa5, 0xa6, 0xa7,
    0xa8, 0xa9, 0xaa, 0xab,
    0xac, 0xad, 0xae, 0xaf
};
static const uint8_t gctr_n[16] = {
    0xb0, 0xb1, 0xb2, 0xb3,
    0xb4, 0xb5, 0xb6, 0xb7,
    0xb8, 0xb9, 0xba, 0xbb,
    0xbc, 0xbd, 0xbe, 0xbf
};
static const uint8_t gctr_iv[32] = {
    0xa0, 0xa1, 0xa2, 0xa3, 0xa4, 0xa5, 0xa6, 0xa7,
    0xa8, 0xa9, 0xaa, 0xab, 0xac, 0xad, 0xae, 0xaf,
    0xb0, 0xb1, 0xb2, 0xb3, 0xb4, 0xb5, 0xb6, 0xb7,
    0xb8, 0xb9, 0xba, 0xbb, 0xbc, 0xbd, 0xbe, 0xbf
};
/* For GCTR-3-prime, use tag = R || N */
static const uint8_t gctr_tag[32] = {
    0xa0, 0xa1, 0xa2, 0xa3, 0xa4, 0xa5, 0xa6, 0xa7,
    0xa8, 0xa9, 0xaa, 0xab, 0xac, 0xad, 0xae, 0xaf,
    0xb0, 0xb1, 0xb2, 0xb3, 0xb4, 0xb5, 0xb6, 0xb7,
    0xb8, 0xb9, 0xba, 0xbb, 0xbc, 0xbd, 0xbe, 0xbf
};

static volatile uint8_t sink;

static void print_counters(const char *name1, uint32_t c1,
                           const char *name2, uint32_t c2)
{
    if (c2 > 0)
        printk("    [leg/op] %s=%" PRIu32 "  %s=%" PRIu32 "\n",
               name1, c1 / TOTAL_ITERS, name2, c2 / TOTAL_ITERS);
    else
        printk("    [leg/op] %s=%" PRIu32 "\n",
               name1, c1 / TOTAL_ITERS);
}

static void fill_pattern(uint8_t *buf, uint32_t len)
{
    for (uint32_t i = 0; i < len; ++i) {
        buf[i] = (uint8_t)(i & 0xffU);
    }
}

static void print_hex(const char *label, const uint8_t *data, size_t len)
{
    printk("    %-22s:", label);
    for (size_t i = 0; i < len; ++i)
        printk(" %02x", data[i]);
    printk("\n");
}

/* ---- correctness: GCTR-3 encrypt/decrypt roundtrip --------------------- */

static void check_gctr3_correctness(void)
{
    static uint8_t pt[64];
    static uint8_t ct[64];
    static uint8_t rt[64];

    fill_pattern(pt, 64);

    printk("  gctr3_forkskinny:\n");
    gctr_3_forkskinny(bench_key, gctr_r, gctr_n, pt, 64, ct);
    print_hex("ct (first 16 B)", ct, 16);
    gctr_3_forkskinny(bench_key, gctr_r, gctr_n, ct, 64, rt);
    printk("    decrypt: %s\n", memcmp(pt, rt, 64) == 0 ? "[PASS]" : "[FAIL]");

    printk("  gctr3_butterknife:\n");
    gctr_3_butterknife_iv_full(bench_key, gctr_iv, pt, 64, ct);
    print_hex("ct (first 16 B)", ct, 16);
    gctr_3_butterknife_iv_full(bench_key, gctr_iv, ct, 64, rt);
    printk("    decrypt: %s\n", memcmp(pt, rt, 64) == 0 ? "[PASS]" : "[FAIL]");

    printk("  gctr3_prime_forkskinny:\n");
    gctr_3_prime(bench_key, gctr_tag, pt, 64, ct);
    print_hex("ct (first 16 B)", ct, 16);
    gctr_3_prime(bench_key, gctr_tag, ct, 64, rt);
    printk("    decrypt: %s\n", memcmp(pt, rt, 64) == 0 ? "[PASS]" : "[FAIL]");

    printk("  gctr3_prime_butterknife:\n");
    gctr_3_prime_butterknife(bench_key, gctr_tag, pt, 64, ct);
    print_hex("ct (first 16 B)", ct, 16);
    gctr_3_prime_butterknife(bench_key, gctr_tag, ct, 64, rt);
    printk("    decrypt: %s\n", memcmp(pt, rt, 64) == 0 ? "[PASS]" : "[FAIL]");
}

/* ---- correctness: supersonic tag verify -------------------------------- */

static void check_supersonic_correctness(void)
{
    static uint8_t msg[64];
    uint8_t tl[16], tr[16], cl[16], cr[16];
    int match;

    fill_pattern(msg, 64);

    /* supersonic_256_forkskinny */
    printk("  supersonic_256_forkskinny:\n");
    supersonic_256_forkskinny(bench_key, tl, tr, msg, 64);
    print_hex("tag_L", tl, 16);
    print_hex("tag_R", tr, 16);

    supersonic_256_forkskinny(bench_key, cl, cr, msg, 64);
    match = (memcmp(tl, cl, 16) == 0 && memcmp(tr, cr, 16) == 0);
    printk("    verify(same msg):    %s\n", match ? "[PASS] MATCH" : "[FAIL] MISMATCH");

    msg[0] ^= 0xff;
    supersonic_256_forkskinny(bench_key, cl, cr, msg, 64);
    match = (memcmp(tl, cl, 16) == 0 && memcmp(tr, cr, 16) == 0);
    printk("    verify(tampered):    %s\n", !match ? "[PASS] MISMATCH (correct)" : "[FAIL] still MATCH");
    msg[0] ^= 0xff;

    /* supersonic_256_butterknife */
    printk("  supersonic_256_butterknife:\n");
    supersonic_256_butterknife(bench_key, tl, tr, msg, 64);
    print_hex("tag_L", tl, 16);
    print_hex("tag_R", tr, 16);

    supersonic_256_butterknife(bench_key, cl, cr, msg, 64);
    match = (memcmp(tl, cl, 16) == 0 && memcmp(tr, cr, 16) == 0);
    printk("    verify(same msg):    %s\n", match ? "[PASS] MATCH" : "[FAIL] MISMATCH");

    msg[0] ^= 0xff;
    supersonic_256_butterknife(bench_key, cl, cr, msg, 64);
    match = (memcmp(tl, cl, 16) == 0 && memcmp(tr, cr, 16) == 0);
    printk("    verify(tampered):    %s\n", !match ? "[PASS] MISMATCH (correct)" : "[FAIL] still MATCH");
    msg[0] ^= 0xff;
}

/* ---- bench: supersonic tag verify (recompute + compare) ---------------- */

static void bench_supersonic_verify(uint32_t mlen)
{
    timing_t start;
    timing_t end;
    uint64_t total_cycles;
    uint64_t total_ns;
    uint8_t ref_l[16], ref_r[16];
    uint8_t chk_l[16], chk_r[16];
    volatile uint8_t match;
    uint32_t c1leg, c2leg;

    fill_pattern(msg_buf, mlen);

    /* --- supersonic_256_forkskinny verify --- */
    supersonic_256_forkskinny(bench_key, ref_l, ref_r, msg_buf, mlen);

    total_cycles = 0; total_ns = 0;
    forkskinny_counters_reset();
    for (int i = 0; i < WARMUP_ITERS; ++i)
        supersonic_256_forkskinny(bench_key, chk_l, chk_r, msg_buf, mlen);
    for (int i = 0; i < BENCH_ITERS; ++i) {
        start = timing_counter_get();
        supersonic_256_forkskinny(bench_key, chk_l, chk_r, msg_buf, mlen);
        match = (memcmp(ref_l, chk_l, 16) == 0 && memcmp(ref_r, chk_r, 16) == 0) ? 1u : 0u;
        end = timing_counter_get();
        uint64_t cycles = timing_cycles_get(&start, &end);
        total_cycles += cycles;
        total_ns += timing_cycles_to_ns(cycles);
    }
    sink ^= match;
    printk("  %-26s %6u B : %12" PRIu64 " cycles | %12" PRIu64 " ns\n",
           "supersonic_256_fs_verify", mlen,
           total_cycles / BENCH_ITERS, total_ns / BENCH_ITERS);
    printk("    [leg/op] legs=%" PRIu32 "  (1-leg=%" PRIu32 "  2-leg=%" PRIu32 ")\n",
           g_fs128_256_legs       / TOTAL_ITERS,
           g_fs128_256_1leg_calls / TOTAL_ITERS,
           g_fs128_256_2leg_calls / TOTAL_ITERS);
    k_msleep(1);

    /* --- supersonic_256_butterknife verify --- */
    supersonic_256_butterknife(bench_key, ref_l, ref_r, msg_buf, mlen);

    total_cycles = 0; total_ns = 0;
    supersonic_bk_reset_counters();
    for (int i = 0; i < WARMUP_ITERS; ++i)
        supersonic_256_butterknife(bench_key, chk_l, chk_r, msg_buf, mlen);
    for (int i = 0; i < BENCH_ITERS; ++i) {
        start = timing_counter_get();
        supersonic_256_butterknife(bench_key, chk_l, chk_r, msg_buf, mlen);
        match = (memcmp(ref_l, chk_l, 16) == 0 && memcmp(ref_r, chk_r, 16) == 0) ? 1u : 0u;
        end = timing_counter_get();
        uint64_t cycles = timing_cycles_get(&start, &end);
        total_cycles += cycles;
        total_ns += timing_cycles_to_ns(cycles);
    }
    sink ^= match;
    printk("  %-26s %6u B : %12" PRIu64 " cycles | %12" PRIu64 " ns\n",
           "supersonic_256_bk_verify", mlen,
           total_cycles / BENCH_ITERS, total_ns / BENCH_ITERS);
    supersonic_bk_get_counters(&c1leg, &c2leg);
    printk("    [leg/op] legs=%" PRIu32 "  (1-leg=%" PRIu32 "  2-leg=%" PRIu32 ")\n",
           (c1leg + 2u * c2leg) / TOTAL_ITERS,
           c1leg / TOTAL_ITERS,
           c2leg / TOTAL_ITERS);
}

static void bench_supersonic_variant(const char *name, supersonic_fn_t fn, uint32_t mlen)
{
    timing_t start;
    timing_t end;
    uint64_t total_cycles = 0;
    uint64_t total_ns = 0;
    uint8_t out_left[16];
    uint8_t out_right[16];

    fill_pattern(msg_buf, mlen);

    for (int i = 0; i < WARMUP_ITERS; ++i) {
        fn(bench_key, out_left, out_right, msg_buf, mlen);
    }

    for (int i = 0; i < BENCH_ITERS; ++i) {
        start = timing_counter_get();
        fn(bench_key, out_left, out_right, msg_buf, mlen);
        end = timing_counter_get();

        uint64_t cycles = timing_cycles_get(&start, &end);
        total_cycles += cycles;
        total_ns += timing_cycles_to_ns(cycles);
    }

    sink ^= out_left[0] ^ out_right[0];

    printk("  %-26s %6u B : %12" PRIu64 " cycles | %12" PRIu64 " ns\n",
           name,
           mlen,
           total_cycles / BENCH_ITERS,
           total_ns / BENCH_ITERS);
}

static void bench_gctr_variants(uint32_t mlen)
{
    timing_t start;
    timing_t end;
    uint64_t total_cycles;
    uint64_t total_ns;

    fill_pattern(msg_buf, mlen);

    /* gctr3_forkskinny */
    total_cycles = 0; total_ns = 0;
    forkskinny_counters_reset();
    for (int i = 0; i < WARMUP_ITERS; ++i)
        gctr_3_forkskinny(bench_key, gctr_r, gctr_n, msg_buf, mlen, out_buf);
    for (int i = 0; i < BENCH_ITERS; ++i) {
        start = timing_counter_get();
        gctr_3_forkskinny(bench_key, gctr_r, gctr_n, msg_buf, mlen, out_buf);
        end = timing_counter_get();
        uint64_t cycles = timing_cycles_get(&start, &end);
        total_cycles += cycles;
        total_ns += timing_cycles_to_ns(cycles);
    }
    sink ^= out_buf[0];
    printk("  %-26s %6u B : %12" PRIu64 " cycles | %12" PRIu64 " ns\n",
           "gctr3_forkskinny", mlen,
           total_cycles / BENCH_ITERS, total_ns / BENCH_ITERS);
    printk("    [leg/op] legs=%" PRIu32 "  (1-leg=%" PRIu32 "  2-leg=%" PRIu32 ")\n",
           g_fs128_256_legs       / TOTAL_ITERS,
           g_fs128_256_1leg_calls / TOTAL_ITERS,
           g_fs128_256_2leg_calls / TOTAL_ITERS);
    k_msleep(1);

    /* gctr3_butterknife */
    total_cycles = 0; total_ns = 0;
    butterknife_counters_reset();
    for (int i = 0; i < WARMUP_ITERS; ++i)
        gctr_3_butterknife_iv_full(bench_key, gctr_iv, msg_buf, mlen, out_buf);
    for (int i = 0; i < BENCH_ITERS; ++i) {
        start = timing_counter_get();
        gctr_3_butterknife_iv_full(bench_key, gctr_iv, msg_buf, mlen, out_buf);
        end = timing_counter_get();
        uint64_t cycles = timing_cycles_get(&start, &end);
        total_cycles += cycles;
        total_ns += timing_cycles_to_ns(cycles);
    }
    sink ^= out_buf[0];
    printk("  %-26s %6u B : %12" PRIu64 " cycles | %12" PRIu64 " ns\n",
           "gctr3_butterknife", mlen,
           total_cycles / BENCH_ITERS, total_ns / BENCH_ITERS);
    print_counters("butterknife", g_butterknife_256_enc_calls, "", 0);
    k_msleep(1);

    /* gctr3_prime_forkskinny */
    total_cycles = 0; total_ns = 0;
    forkskinny_counters_reset();
    for (int i = 0; i < WARMUP_ITERS; ++i)
        gctr_3_prime(bench_key, gctr_tag, msg_buf, mlen, out_buf);
    for (int i = 0; i < BENCH_ITERS; ++i) {
        start = timing_counter_get();
        gctr_3_prime(bench_key, gctr_tag, msg_buf, mlen, out_buf);
        end = timing_counter_get();
        uint64_t cycles = timing_cycles_get(&start, &end);
        total_cycles += cycles;
        total_ns += timing_cycles_to_ns(cycles);
    }
    sink ^= out_buf[0];
    printk("  %-26s %6u B : %12" PRIu64 " cycles | %12" PRIu64 " ns\n",
           "gctr3_prime_forkskinny", mlen,
           total_cycles / BENCH_ITERS, total_ns / BENCH_ITERS);
    printk("    [leg/op] legs=%" PRIu32 "  (1-leg=%" PRIu32 "  2-leg=%" PRIu32 ")\n",
           g_fs128_256_legs       / TOTAL_ITERS,
           g_fs128_256_1leg_calls / TOTAL_ITERS,
           g_fs128_256_2leg_calls / TOTAL_ITERS);
    k_msleep(1);

    /* gctr3_prime_butterknife */
    total_cycles = 0; total_ns = 0;
    butterknife_counters_reset();
    for (int i = 0; i < WARMUP_ITERS; ++i)
        gctr_3_prime_butterknife(bench_key, gctr_tag, msg_buf, mlen, out_buf);
    for (int i = 0; i < BENCH_ITERS; ++i) {
        start = timing_counter_get();
        gctr_3_prime_butterknife(bench_key, gctr_tag, msg_buf, mlen, out_buf);
        end = timing_counter_get();
        uint64_t cycles = timing_cycles_get(&start, &end);
        total_cycles += cycles;
        total_ns += timing_cycles_to_ns(cycles);
    }
    sink ^= out_buf[0];
    printk("  %-26s %6u B : %12" PRIu64 " cycles | %12" PRIu64 " ns\n",
           "gctr3_prime_butterknife", mlen,
           total_cycles / BENCH_ITERS, total_ns / BENCH_ITERS);
    print_counters("butterknife", g_butterknife_256_enc_calls, "", 0);
}

static void bench_gctr_decrypt_variants(uint32_t mlen)
{
    timing_t start;
    timing_t end;
    uint64_t total_cycles;
    uint64_t total_ns;

    fill_pattern(msg_buf, mlen);

    /* gctr3_forkskinny decrypt */
    gctr_3_forkskinny(bench_key, gctr_r, gctr_n, msg_buf, mlen, out_buf);
    total_cycles = 0; total_ns = 0;
    forkskinny_counters_reset();
    for (int i = 0; i < WARMUP_ITERS; ++i)
        gctr_3_forkskinny(bench_key, gctr_r, gctr_n, out_buf, mlen, dec_buf);
    for (int i = 0; i < BENCH_ITERS; ++i) {
        start = timing_counter_get();
        gctr_3_forkskinny(bench_key, gctr_r, gctr_n, out_buf, mlen, dec_buf);
        end = timing_counter_get();
        uint64_t cycles = timing_cycles_get(&start, &end);
        total_cycles += cycles;
        total_ns += timing_cycles_to_ns(cycles);
    }
    sink ^= dec_buf[0];
    printk("  %-26s %6u B : %12" PRIu64 " cycles | %12" PRIu64 " ns\n",
           "gctr3_fs_decrypt", mlen,
           total_cycles / BENCH_ITERS, total_ns / BENCH_ITERS);
    printk("    [leg/op] legs=%" PRIu32 "  (1-leg=%" PRIu32 "  2-leg=%" PRIu32 ")\n",
           g_fs128_256_legs       / TOTAL_ITERS,
           g_fs128_256_1leg_calls / TOTAL_ITERS,
           g_fs128_256_2leg_calls / TOTAL_ITERS);
    k_msleep(1);

    /* gctr3_butterknife decrypt */
    gctr_3_butterknife_iv_full(bench_key, gctr_iv, msg_buf, mlen, out_buf);
    total_cycles = 0; total_ns = 0;
    butterknife_counters_reset();
    for (int i = 0; i < WARMUP_ITERS; ++i)
        gctr_3_butterknife_iv_full(bench_key, gctr_iv, out_buf, mlen, dec_buf);
    for (int i = 0; i < BENCH_ITERS; ++i) {
        start = timing_counter_get();
        gctr_3_butterknife_iv_full(bench_key, gctr_iv, out_buf, mlen, dec_buf);
        end = timing_counter_get();
        uint64_t cycles = timing_cycles_get(&start, &end);
        total_cycles += cycles;
        total_ns += timing_cycles_to_ns(cycles);
    }
    sink ^= dec_buf[0];
    printk("  %-26s %6u B : %12" PRIu64 " cycles | %12" PRIu64 " ns\n",
           "gctr3_bk_decrypt", mlen,
           total_cycles / BENCH_ITERS, total_ns / BENCH_ITERS);
    print_counters("butterknife", g_butterknife_256_enc_calls, "", 0);
    k_msleep(1);

    /* gctr3_prime_forkskinny decrypt */
    gctr_3_prime(bench_key, gctr_tag, msg_buf, mlen, out_buf);
    total_cycles = 0; total_ns = 0;
    forkskinny_counters_reset();
    for (int i = 0; i < WARMUP_ITERS; ++i)
        gctr_3_prime(bench_key, gctr_tag, out_buf, mlen, dec_buf);
    for (int i = 0; i < BENCH_ITERS; ++i) {
        start = timing_counter_get();
        gctr_3_prime(bench_key, gctr_tag, out_buf, mlen, dec_buf);
        end = timing_counter_get();
        uint64_t cycles = timing_cycles_get(&start, &end);
        total_cycles += cycles;
        total_ns += timing_cycles_to_ns(cycles);
    }
    sink ^= dec_buf[0];
    printk("  %-26s %6u B : %12" PRIu64 " cycles | %12" PRIu64 " ns\n",
           "gctr3_prime_fs_decrypt", mlen,
           total_cycles / BENCH_ITERS, total_ns / BENCH_ITERS);
    printk("    [leg/op] legs=%" PRIu32 "  (1-leg=%" PRIu32 "  2-leg=%" PRIu32 ")\n",
           g_fs128_256_legs       / TOTAL_ITERS,
           g_fs128_256_1leg_calls / TOTAL_ITERS,
           g_fs128_256_2leg_calls / TOTAL_ITERS);
    k_msleep(1);

    /* gctr3_prime_butterknife decrypt */
    gctr_3_prime_butterknife(bench_key, gctr_tag, msg_buf, mlen, out_buf);
    total_cycles = 0; total_ns = 0;
    butterknife_counters_reset();
    for (int i = 0; i < WARMUP_ITERS; ++i)
        gctr_3_prime_butterknife(bench_key, gctr_tag, out_buf, mlen, dec_buf);
    for (int i = 0; i < BENCH_ITERS; ++i) {
        start = timing_counter_get();
        gctr_3_prime_butterknife(bench_key, gctr_tag, out_buf, mlen, dec_buf);
        end = timing_counter_get();
        uint64_t cycles = timing_cycles_get(&start, &end);
        total_cycles += cycles;
        total_ns += timing_cycles_to_ns(cycles);
    }
    sink ^= dec_buf[0];
    printk("  %-26s %6u B : %12" PRIu64 " cycles | %12" PRIu64 " ns\n",
           "gctr3_prime_bk_decrypt", mlen,
           total_cycles / BENCH_ITERS, total_ns / BENCH_ITERS);
    print_counters("butterknife", g_butterknife_256_enc_calls, "", 0);
}

static void bench_size(uint32_t mlen)
{
    uint32_t c1leg, c2leg;

    printk("\n[Message size: %u bytes]\n", mlen);

    forkskinny_counters_reset();
    bench_supersonic_variant("supersonic_256_forkskinny", supersonic_256_forkskinny, mlen);
    printk("    [leg/op] legs=%" PRIu32 "  (1-leg=%" PRIu32 "  2-leg=%" PRIu32 ")\n",
           g_fs128_256_legs       / TOTAL_ITERS,
           g_fs128_256_1leg_calls / TOTAL_ITERS,
           g_fs128_256_2leg_calls / TOTAL_ITERS);
    k_msleep(1);

    supersonic_bk_reset_counters();
    bench_supersonic_variant("supersonic_256_butterknife", supersonic_256_butterknife, mlen);
    supersonic_bk_get_counters(&c1leg, &c2leg);
    printk("    [leg/op] legs=%" PRIu32 "  (1-leg=%" PRIu32 "  2-leg=%" PRIu32 ")\n",
           (c1leg + 2u * c2leg) / TOTAL_ITERS,
           c1leg / TOTAL_ITERS,
           c2leg / TOTAL_ITERS);
    k_msleep(1);

    bench_gctr_variants(mlen);
    bench_gctr_decrypt_variants(mlen);
    bench_supersonic_verify(mlen);
}

int main(void)
{
    timing_init();
    timing_start();

    printk("\n=== Supersonic/GCTR3 Benchmark ===\n");
    printk("iters=%d, warmup=%d\n", BENCH_ITERS, WARMUP_ITERS);
    printk("format: <variant> <size> : <avg cycles> | <avg ns>\n");

    printk("\n[Correctness checks]\n");
    check_gctr3_correctness();
    check_supersonic_correctness();

    bench_size(8);
    bench_size(100);
    bench_size(4096);

    printk("\nBenchmark done (sink=%u).\n", sink);
    return 0;
}
```

## src/gctr3.c
```c
#include "include/gctr3.h"
#include "butterknife.h"
#include "internal-forkskinny.h"

#include <string.h>

/* ---- shared helpers ---------------------------------------------------- */

static void gctr3_xor_block(uint8_t out[GCTR3_N],
                             const uint8_t a[GCTR3_N],
                             const uint8_t b[GCTR3_N])
{
    for (size_t i = 0; i < GCTR3_N; ++i)
        out[i] = (uint8_t)(a[i] ^ b[i]);
}

static void gctr3_inc_be(uint8_t x[GCTR3_N])
{
    for (int i = (int)GCTR3_N - 1; i >= 0; --i) {
        x[i] = (uint8_t)(x[i] + 1u);
        if (x[i] != 0u)
            break;
    }
}

/* Force the two domain-separation bits to "10". */
static void gctr3_set_domain_10(uint8_t tweak[GCTR3_N])
{
    tweak[0] &= 0x3Fu;
    tweak[0] |= 0x80u;
}

/* ---- GCTR-3 / ForkSkinny ----------------------------------------------- */

/*
 * T_j = R xor <j>
 * X_j = N  (fixed for the whole message)
 */
void gctr_3_forkskinny(const uint8_t key[GCTR3_KEY_LEN],
                       const uint8_t R[GCTR3_N],
                       const uint8_t N[GCTR3_N],
                       const uint8_t *in, size_t len,
                       uint8_t *out)
{
    uint8_t tk[GCTR3_TWO_N];
    uint8_t j_enc[GCTR3_N];
    size_t offset = 0;

    memset(j_enc, 0, sizeof(j_enc));
    memcpy(tk + GCTR3_N, key, GCTR3_KEY_LEN);

    while (offset < len) {
        uint8_t stream[GCTR3_TWO_N];
        size_t remaining = len - offset;
        size_t take = remaining < GCTR3_TWO_N ? remaining : GCTR3_TWO_N;

        gctr3_inc_be(j_enc);
        gctr3_xor_block(tk, R, j_enc);

        if (remaining <= GCTR3_N)
            forkskinny_128_256_encrypt(tk, stream, NULL, N);
        else
            forkskinny_128_256_encrypt(tk, stream, stream + GCTR3_N, N);

        for (size_t i = 0; i < take; ++i)
            out[offset + i] = (uint8_t)(in[offset + i] ^ stream[i]);

        offset += take;
    }
}

void gctr_3_forkskinny_iv(const uint8_t key[GCTR3_KEY_LEN],
                          const uint8_t iv[GCTR3_TWO_N],
                          const uint8_t *in, size_t len,
                          uint8_t *out)
{
    gctr_3_forkskinny(key, iv, iv + GCTR3_N, in, len, out);
}

/* ---- GCTR-3 / Butterknife ---------------------------------------------- */

void gctr_3_butterknife(const uint8_t key[GCTR3_KEY_LEN],
                        const uint8_t R[GCTR3_N],
                        const uint8_t N[GCTR3_N],
                        const uint8_t *in, size_t len,
                        uint8_t *out,
                        uint8_t num_branches)
{
    uint8_t tweakey[GCTR3_TWO_N];
    uint8_t j_enc[GCTR3_N];
    uint8_t stream[GCTR3_N * GCTR3_BK_BRANCHES];
    size_t offset = 0u;

    if (num_branches == 0u || num_branches > GCTR3_BK_BRANCHES)
        return;

    memcpy(tweakey + GCTR3_N, key, GCTR3_KEY_LEN);
    memset(j_enc, 0, sizeof(j_enc));

    while (offset < len) {
        size_t remaining = len - offset;
        size_t b = (remaining + GCTR3_N - 1u) / GCTR3_N;
        if (b > num_branches)
            b = num_branches;
        size_t chunk = (size_t)GCTR3_N * (size_t)b;
        size_t take = remaining < chunk ? remaining : chunk;

        gctr3_inc_be(j_enc);
        gctr3_xor_block(tweakey, R, j_enc);

        butterknife_256_encrypt(tweakey, stream, N, (uint8_t)b);

        for (size_t i = 0; i < take; ++i)
            out[offset + i] = (uint8_t)(in[offset + i] ^ stream[i]);

        offset += take;
    }
}

void gctr_3_butterknife_iv(const uint8_t key[GCTR3_KEY_LEN],
                           const uint8_t iv[GCTR3_TWO_N],
                           const uint8_t *in, size_t len,
                           uint8_t *out,
                           uint8_t num_branches)
{
    gctr_3_butterknife(key, iv, iv + GCTR3_N, in, len, out, num_branches);
}

void gctr_3_butterknife_iv_full(const uint8_t key[GCTR3_KEY_LEN],
                                const uint8_t iv[GCTR3_TWO_N],
                                const uint8_t *in, size_t len,
                                uint8_t *out)
{
    gctr_3_butterknife_iv(key, iv, in, len, out, (uint8_t)GCTR3_BK_BRANCHES);
}

/* ---- GCTR-3' / ForkSkinny ---------------------------------------------- */

/*
 * T_j = (R xor <j>) with domain bits forced to "10"
 * X_j = N  (second n-bit half of tag)
 * tag = R || N  (32 bytes)
 */
void gctr_3_prime(const uint8_t *key,
                  const uint8_t tag[GCTR3_TWO_N],
                  const uint8_t *in, size_t len,
                  uint8_t *out)
{
    uint8_t tk[GCTR3_TWO_N];
    uint8_t j_enc[GCTR3_N];
    size_t offset = 0u;

    const uint8_t *R = tag;
    const uint8_t *N = tag + GCTR3_N;

    memset(j_enc, 0, sizeof(j_enc));
    memcpy(tk + GCTR3_N, key, GCTR3_KEY_LEN);

    while (offset < len) {
        uint8_t stream[GCTR3_TWO_N];
        size_t remaining = len - offset;
        size_t take = remaining < GCTR3_TWO_N ? remaining : GCTR3_TWO_N;

        gctr3_inc_be(j_enc);
        gctr3_xor_block(tk, R, j_enc);
        gctr3_set_domain_10(tk);

        if (remaining <= GCTR3_N)
            forkskinny_128_256_encrypt(tk, stream, NULL, N);
        else
            forkskinny_128_256_encrypt(tk, stream, stream + GCTR3_N, N);

        for (size_t j = 0; j < take; ++j)
            out[offset + j] = (uint8_t)(in[offset + j] ^ stream[j]);

        offset += take;
    }
}

/* ---- GCTR-3' / Butterknife --------------------------------------------- */

void gctr_3_prime_butterknife_rn(const uint8_t key[GCTR3_KEY_LEN],
                                 const uint8_t R[GCTR3_N],
                                 const uint8_t N[GCTR3_N],
                                 const uint8_t *in, size_t len,
                                 uint8_t *out)
{
    uint8_t tweakey[GCTR3_TWO_N];
    uint8_t j_enc[GCTR3_N];
    uint8_t stream[GCTR3_N * GCTR3_BK_BRANCHES];
    size_t offset = 0u;

    memset(j_enc, 0, sizeof(j_enc));
    memcpy(tweakey + GCTR3_N, key, GCTR3_KEY_LEN);

    while (offset < len) {
        size_t remaining = len - offset;
        size_t b = (remaining + GCTR3_N - 1u) / GCTR3_N;
        if (b > GCTR3_BK_BRANCHES)
            b = GCTR3_BK_BRANCHES;
        size_t chunk = (size_t)GCTR3_N * (size_t)b;
        size_t take = remaining < chunk ? remaining : chunk;

        gctr3_inc_be(j_enc);
        gctr3_xor_block(tweakey, R, j_enc);
        gctr3_set_domain_10(tweakey);

        butterknife_256_encrypt(tweakey, stream, N, (uint8_t)b);

        for (size_t i = 0; i < take; ++i)
            out[offset + i] = (uint8_t)(in[offset + i] ^ stream[i]);

        offset += take;
    }
}

void gctr_3_prime_butterknife(const uint8_t key[GCTR3_KEY_LEN],
                              const uint8_t tag[GCTR3_TWO_N],
                              const uint8_t *in, size_t len,
                              uint8_t *out)
{
    gctr_3_prime_butterknife_rn(key, tag, tag + GCTR3_N, in, len, out);
}
```

## src/host_compat.h
```c
#pragma once
#include <stdio.h>
#include <stdint.h>
#include <time.h>
#include <x86intrin.h>

#define printk printf

typedef uint64_t timing_t;

static uint64_t _host_cpu_hz;

static inline void timing_init(void) {
    struct timespec t0, t1;
    uint64_t c0, c1;
    clock_gettime(CLOCK_MONOTONIC, &t0);
    c0 = __rdtsc();
    struct timespec end = { t0.tv_sec, t0.tv_nsec + 10000000L };
    if (end.tv_nsec >= 1000000000L) { end.tv_sec++; end.tv_nsec -= 1000000000L; }
    do { clock_gettime(CLOCK_MONOTONIC, &t1); }
    while (t1.tv_sec < end.tv_sec ||
           (t1.tv_sec == end.tv_sec && t1.tv_nsec < end.tv_nsec));
    c1 = __rdtsc();
    uint64_t ns = (uint64_t)(t1.tv_sec - t0.tv_sec) * 1000000000ULL
                + (uint64_t)(t1.tv_nsec - t0.tv_nsec);
    _host_cpu_hz = (c1 - c0) * 1000000000ULL / ns;
}

static inline void timing_start(void) {}
static inline void timing_stop(void)  {}

static inline timing_t timing_counter_get(void) { return (timing_t)__rdtsc(); }

static inline uint64_t timing_cycles_get(timing_t *s, timing_t *e) { return *e - *s; }

static inline uint64_t timing_cycles_to_ns(uint64_t cycles) {
    return _host_cpu_hz ? cycles * 1000000000ULL / _host_cpu_hz : 0;
}

static inline void k_msleep(int ms) { (void)ms; }
```

## src/supersonic_butterknife.c
```c
#include <stdint.h>
#include <string.h>
#include <stdlib.h>
#include "butterknife.h"
#include "sonics_ref.h"
#include "internal-forkskinny.h"
#include "include/supersonic.h"

/* ── call counters ─────────────────────────────────────────── */
static uint32_t cnt_1leg;  /* Butterknife 1-leg calls */
static uint32_t cnt_2leg;  /* Butterknife 2-leg calls */

void supersonic_bk_reset_counters(void)
{
    cnt_1leg = cnt_2leg = 0;
}

void supersonic_bk_get_counters(uint32_t *oneleg, uint32_t *twoleg)
{
    *oneleg = cnt_1leg;
    *twoleg = cnt_2leg;
}

static void arrXOR(uint8_t *out, const uint8_t *right, uint16_t len){
    for(uint8_t i = 0; i<len; ++i){
        out[i] ^= right[i];
    }
}

/* Double Function in GF(2^128) */
static void arrDOUBLE_128(uint8_t out[16]){
    uint8_t tmp;
    
    tmp = (out[15] >> 7) & 1;
    for (uint8_t i = 0;  i < 15;  ++i){
        out[i] = (out[i] << 1) | ((out[i+1] >> 7) & 1);
    }
    out[15] = out[15] << 1;
    out[0] ^= 0x87 * tmp;
}

static void supersonic_256_round(Sonics_256_struct_t *Sonic, SonicChains *Chains, uint8_t buffer[SONICS_256_K_SIZE + SONICS_256_T_SIZE + 1], uint16_t Nr){
    /* Round function */
    arrXOR(Chains->kt, Sonic->P + SONICS_256_N_SIZE, SONICS_256_K_SIZE); //k-Chain
    arrXOR(Sonic->P, Sonic->mask, SONICS_256_N_SIZE); //input-block
    arrXOR(Sonic->P + SONICS_256_N_SIZE, Sonic->K_prime, SONICS_256_K_SIZE); //key-block
    /* Set counter into 12 bit but keeps last 4 empty*/
    Sonic->P[SONICS_256_P_SIZE - 1] = (uint8_t)((Nr+1)&0xff);        //tweak-block
    Sonic->P[SONICS_256_P_SIZE    ] = (uint8_t)(((Nr+1)&0x0f00)>>4);
    butterknife_256_precompute_rtk(Sonic->P + SONICS_256_N_SIZE, Sonic->bk_rtk, 1);
    butterknife_256_encrypt_w_rtk(Sonic->bk_rtk, buffer, Sonic->P, 1);
    cnt_1leg++;

    arrXOR(Chains->m,  buffer, SONICS_256_N_SIZE); //m-Chain
    arrDOUBLE_128(Chains->m);
    arrXOR(buffer, Sonic->P + SONICS_256_N_SIZE + SONICS_256_K_SIZE, SONICS_256_T_SIZE); //t-Chain
    arrXOR(Chains->kt + SONICS_256_K_SIZE, buffer, SONICS_256_T_SIZE); 
}

void supersonic_256_butterknife(const uint8_t key[16], 
                                uint8_t out_left[16], uint8_t out_right[16], 
                                const uint8_t *message, const uint32_t mlen){
    uint8_t res;
    uint16_t i, numP;
    uint8_t Kmask[SONICS_256_K_SIZE + SONICS_256_N_SIZE], buffer[SONICS_256_K_SIZE + SONICS_256_T_SIZE+1];
    uint32_t rtk[4*(BUTTERKNIFE_ROUNDS+1)];
    SonicChains Chains;
    Sonics_256_struct_t Sonic;

    res = mlen%(SONICS_256_P_SIZE-1);
    numP = (uint16_t)(mlen/(SONICS_256_P_SIZE-1)) - 1 + (res>0)*1;

    Sonic.bk_rtk = rtk;
    Sonic.K_prime = Kmask;
    Sonic.mask = Kmask + SONICS_256_K_SIZE;
    memset(Sonic.P, 0, SONICS_256_P_SIZE + 1);
    memset(Chains.m, 0, SONICS_256_N_SIZE);
    memset(Chains.kt, 0, SONICS_256_K_SIZE + SONICS_256_T_SIZE + 1);
    memset(buffer, 0, SONICS_256_K_SIZE + SONICS_256_T_SIZE + 1);

    /* Key expansion forkcipher call to generate K' and Mask: FC(K, 0^t, 0^m) */
    memcpy(Sonic.P, key, SONICS_256_K_SIZE);
    butterknife_256_precompute_rtk(Sonic.P, Sonic.bk_rtk, 2);
    butterknife_256_encrypt_w_rtk(Sonic.bk_rtk, Kmask, Sonic.P + SONICS_256_K_SIZE, 2);
    cnt_2leg++;

    for(i=0; i<numP; ++i){            
        /** 
         * Sonic.P order: 
         * M_3i   = 'Input'
         * M_3i+1 = 'Key'
         * M_3i+2 = 'Tweak'
         **/
        memcpy(Sonic.P, message + (SONICS_256_P_SIZE-1)*i, (SONICS_256_P_SIZE-1));
        supersonic_256_round(&Sonic, &Chains, buffer, i);
    }
    /* Padding */
    memset(Sonic.P, 0, SONICS_256_P_SIZE+1);
    Sonic.P[res] = SONICS_END_OF_MESSAGE;
    memcpy(Sonic.P, message + numP*(SONICS_256_P_SIZE-1), (SONICS_256_P_SIZE-1)*(res==0) + res);
    supersonic_256_round(&Sonic, &Chains, buffer, numP);

    /* Last Round */
    Chains.kt[SONICS_256_K_SIZE + SONICS_256_T_SIZE] = 0b01 + (0b10 * (res>0));
    arrXOR(Chains.kt, Sonic.K_prime, SONICS_256_K_SIZE);
    arrXOR(Chains.m,  Sonic.mask, SONICS_256_N_SIZE);
    butterknife_256_precompute_rtk(Chains.kt, Sonic.bk_rtk, 2);
    butterknife_256_encrypt_w_rtk(Sonic.bk_rtk, buffer, Chains.m, 2);
    cnt_2leg++;

    memcpy(out_left, buffer, SONICS_256_N_SIZE);
    memcpy(out_right, buffer + SONICS_256_N_SIZE, SONICS_256_N_SIZE);
}
```

## src/supersonic_forkskinny.c
```c
#include <stdint.h>
#include <stdlib.h>
#include <string.h>
#include "butterknife.h"
#include "sonics_ref.h"
#include "internal-forkskinny.h"
#include "include/supersonic.h"

static void arrXOR(uint8_t *out, const uint8_t *right, uint16_t len){
    for(uint8_t i = 0; i<len; ++i){
        out[i] ^= right[i];
    }
}

/* Double Function in GF(2^128) */
static void arrDOUBLE_128(uint8_t out[16]){
    uint8_t tmp;
    
    tmp = (out[15] >> 7) & 1;
    for (uint8_t i = 0;  i < 15;  ++i){
        out[i] = (out[i] << 1) | ((out[i+1] >> 7) & 1);
    }
    out[15] = out[15] << 1;
    out[0] ^= 0x87 * tmp;
}

/* Double Function in GF(2^64) */
static void arrDOUBLE_64(uint8_t out[8]){
    uint8_t tmp;
    
    tmp = (out[7] >> 7) & 1;
    for (uint8_t i = 0;  i < 7;  ++i){
        out[i] = (out[i] << 1) | ((out[i+1] >> 7) & 1);
    }
    out[7] = out[7] << 1;
    out[0] ^= 0x1b * tmp;
}

static void supersonic_384_round(Sonics_384_struct_t *Sonic, SonicChains *Chains, uint8_t buffer[SONICS_384_K_SIZE + SONICS_384_T_SIZE + 1], uint16_t Nr){
    /* Round function */
    arrXOR(Chains->kt, Sonic->P + SONICS_384_N_SIZE, SONICS_384_K_SIZE); //k-Chain
    arrXOR(Sonic->P, Sonic->mask, SONICS_384_N_SIZE); //input-block
    arrXOR(Sonic->P + SONICS_384_N_SIZE, Sonic->K_prime, SONICS_384_K_SIZE); //key-block
    /* Set counter into 12 bit but keeps last 4 empty*/
    Sonic->P[SONICS_384_P_SIZE - 1] = (uint8_t)((Nr+1)&0xff);        //tweak-block
    Sonic->P[SONICS_384_P_SIZE    ] = (uint8_t)(((Nr+1)&0x0f00)>>4);
    forkskinny_128_384_init_tks_part(Sonic->fs_tks1, Sonic->P + SONICS_384_N_SIZE                      , FORKSKINNY_128_384_ROUNDS_BEFORE + FORKSKINNY_128_384_ROUNDS_AFTER, 0); //reduced rounds
    forkskinny_128_384_init_tks_part(Sonic->fs_tks2, Sonic->P + SONICS_384_N_SIZE + SONICS_384_K_SIZE  , FORKSKINNY_128_384_ROUNDS_BEFORE + FORKSKINNY_128_384_ROUNDS_AFTER, 1); //reduced rounds
    forkskinny_128_384_init_tks_part(Sonic->fs_tks3, Sonic->P + SONICS_384_N_SIZE + SONICS_384_K_SIZE*2, FORKSKINNY_128_384_ROUNDS_BEFORE + FORKSKINNY_128_384_ROUNDS_AFTER, 2); //reduced rounds
    forkskinny_128_384_encrypt_with_tks(Sonic->fs_tks1, Sonic->fs_tks2, Sonic->fs_tks3, 0, buffer, Sonic->P); // in this forkskinny implementation the right output is the first branch

    arrXOR(Chains->m,  buffer, SONICS_384_N_SIZE); //m-Chain
    arrDOUBLE_128(Chains->m);
    arrXOR(buffer, Sonic->P + SONICS_384_N_SIZE + SONICS_384_K_SIZE, SONICS_384_T_SIZE); //t-Chain
    arrXOR(Chains->kt + SONICS_384_K_SIZE, buffer, SONICS_384_T_SIZE); 
}

static void supersonic_256_round(Sonics_256_struct_t *Sonic, SonicChains *Chains, uint8_t buffer[SONICS_256_K_SIZE + SONICS_256_T_SIZE + 1], uint16_t Nr){
    /* Round function */
    arrXOR(Chains->kt, Sonic->P + SONICS_256_N_SIZE, SONICS_256_K_SIZE); //k-Chain
    arrXOR(Sonic->P, Sonic->mask, SONICS_256_N_SIZE); //input-block
    arrXOR(Sonic->P + SONICS_256_N_SIZE, Sonic->K_prime, SONICS_256_K_SIZE); //key-block
    /* Set counter into 12 bit but keeps last 4 empty*/
    Sonic->P[SONICS_256_P_SIZE - 1] = (uint8_t)((Nr+1)&0xff);        //tweak-block
    Sonic->P[SONICS_256_P_SIZE    ] = (uint8_t)(((Nr+1)&0x0f00)>>4);
    forkskinny_128_256_init_tks_part(Sonic->fs_tks1, Sonic->P + SONICS_256_N_SIZE                      , FORKSKINNY_128_256_ROUNDS_BEFORE + FORKSKINNY_128_256_ROUNDS_AFTER, 0); //reduced rounds
    forkskinny_128_256_init_tks_part(Sonic->fs_tks2, Sonic->P + SONICS_256_N_SIZE + SONICS_256_K_SIZE  , FORKSKINNY_128_256_ROUNDS_BEFORE + FORKSKINNY_128_256_ROUNDS_AFTER, 1); //reduced rounds
    forkskinny_128_256_encrypt_with_tks(Sonic->fs_tks1, Sonic->fs_tks2, 0, buffer, Sonic->P); // in this forkskinny implementation the right output is the first branch

    arrXOR(Chains->m,  buffer, SONICS_256_N_SIZE); //m-Chain
    arrDOUBLE_128(Chains->m);
    arrXOR(buffer, Sonic->P + SONICS_256_N_SIZE + SONICS_256_K_SIZE, SONICS_256_T_SIZE); //t-Chain
    arrXOR(Chains->kt + SONICS_256_K_SIZE, buffer, SONICS_256_T_SIZE); 
}

static void supersonic_192_round(Sonics_192_struct_t *Sonic, SonicChains *Chains, uint8_t buffer[SONICS_192_K_SIZE + SONICS_192_T_SIZE + 1], uint16_t Nr){
    /* Round function */
    arrXOR(Chains->kt, Sonic->P + SONICS_192_N_SIZE, SONICS_192_K_SIZE); //k-Chain
    arrXOR(Sonic->P, Sonic->mask, SONICS_192_N_SIZE); //input-block
    arrXOR(Sonic->P + SONICS_192_N_SIZE, Sonic->K_prime, SONICS_192_K_SIZE); //key-block
    /* Set counter into 12 bit but keeps last 4 empty*/
    Sonic->P[SONICS_192_P_SIZE - 1] = (uint8_t)((Nr+1)&0xff);        //tweak-block
    Sonic->P[SONICS_192_P_SIZE    ] = (uint8_t)(((Nr+1)&0x0f00)>>4);
    forkskinny_64_192_init_tks_keypart(Sonic->fs_tks1, Sonic->P + SONICS_192_N_SIZE, FORKSKINNY_64_192_ROUNDS_BEFORE + FORKSKINNY_64_192_ROUNDS_AFTER); //reduced rounds
    forkskinny_64_192_init_tks_tweakpart(Sonic->fs_tks2, Sonic->P + SONICS_192_N_SIZE + SONICS_192_K_SIZE  , FORKSKINNY_64_192_ROUNDS_BEFORE + FORKSKINNY_64_192_ROUNDS_AFTER); //reduced rounds
    forkskinny_64_192_encrypt_with_tks(Sonic->fs_tks1, Sonic->fs_tks2, 0, buffer, Sonic->P); // in this forkskinny implementation the right output is the first branch

    arrXOR(Chains->m,  buffer, SONICS_192_N_SIZE); //m-Chain
    arrDOUBLE_64(Chains->m);
    arrXOR(buffer, Sonic->P + SONICS_192_N_SIZE + SONICS_192_K_SIZE, SONICS_192_T_SIZE); //t-Chain
    arrXOR(Chains->kt + SONICS_192_K_SIZE, buffer, SONICS_192_T_SIZE); 
}

void supersonic_384_forkskinny(const uint8_t key[16], 
                               uint8_t out_left[16], uint8_t out_right[16], 
                               const uint8_t *message, const uint32_t mlen){
    uint8_t res;
    uint16_t i, numP;
    uint8_t K_prime[SONICS_384_K_SIZE], mask[SONICS_384_N_SIZE], buffer[SONICS_384_K_SIZE + SONICS_384_T_SIZE+1];
    forkskinny_128_384_tweakey_schedule_t tks1, tks2, tks3;
    SonicChains Chains;
    Sonics_384_struct_t Sonic;

    res = mlen%(SONICS_384_P_SIZE-1);
    numP = (uint16_t)(mlen/(SONICS_384_P_SIZE-1)) - 1 + (res>0)*1;

    Sonic.fs_tks1 = &tks1;
    Sonic.fs_tks2 = &tks2;
    Sonic.fs_tks3 = &tks3;
    Sonic.K_prime = K_prime;
    Sonic.mask = mask;
    memset(Sonic.P, 0, SONICS_384_P_SIZE + 1);
    memset(Chains.m, 0, SONICS_384_N_SIZE);
    memset(Chains.kt, 0, SONICS_384_K_SIZE + SONICS_384_T_SIZE + 1);
    memset(buffer, 0, SONICS_384_K_SIZE + SONICS_384_T_SIZE + 1);

    // /* Key expansion forkcipher call to generate K' and Mask: FC(K, 0^t, 0^m) */
    forkskinny_128_384_init_tks_part(Sonic.fs_tks1, key       , FORKSKINNY_128_384_ROUNDS_BEFORE + 2*FORKSKINNY_128_384_ROUNDS_AFTER, 0);
    forkskinny_128_384_init_tks_part(Sonic.fs_tks2, Sonic.P, FORKSKINNY_128_384_ROUNDS_BEFORE + 2*FORKSKINNY_128_384_ROUNDS_AFTER, 1);
    forkskinny_128_384_init_tks_part(Sonic.fs_tks3, Sonic.P, FORKSKINNY_128_384_ROUNDS_BEFORE + 2*FORKSKINNY_128_384_ROUNDS_AFTER, 2);
    forkskinny_128_384_encrypt_with_tks(Sonic.fs_tks1, Sonic.fs_tks2, Sonic.fs_tks3, Sonic.K_prime, Sonic.mask, Sonic.P); 

    for(i=0; i<numP; ++i){            
        /** 
         * Sonic.P order: 
         * M_3i   = 'Input'
         * M_3i+1 = 'Key'
         * M_3i+2 = 'Tweak'
         **/
        memcpy(Sonic.P, message + (SONICS_384_P_SIZE-1)*i, (SONICS_384_P_SIZE-1));
        supersonic_384_round(&Sonic, &Chains, buffer, i);
    }
    /* Padding */
    memset(Sonic.P, 0, SONICS_384_P_SIZE+1);
    Sonic.P[res] = SONICS_END_OF_MESSAGE;
    memcpy(Sonic.P, message + numP*(SONICS_384_P_SIZE-1), (SONICS_384_P_SIZE-1)*(res==0) + res);
    supersonic_384_round(&Sonic, &Chains, buffer, numP);

    /* Last Round */
    Chains.kt[SONICS_384_K_SIZE + SONICS_384_T_SIZE] = 0b01 + (0b10 * (res>0));
    arrXOR(Chains.kt, Sonic.K_prime, SONICS_384_K_SIZE);
    arrXOR(Chains.m,  Sonic.mask, SONICS_384_N_SIZE);
    forkskinny_128_384_init_tks_part(Sonic.fs_tks1, Chains.kt                      , FORKSKINNY_128_384_ROUNDS_BEFORE + 2*FORKSKINNY_128_384_ROUNDS_AFTER, 0);
    forkskinny_128_384_init_tks_part(Sonic.fs_tks2, Chains.kt + SONICS_384_K_SIZE  , FORKSKINNY_128_384_ROUNDS_BEFORE + 2*FORKSKINNY_128_384_ROUNDS_AFTER, 1);
    forkskinny_128_384_init_tks_part(Sonic.fs_tks3, Chains.kt + SONICS_384_K_SIZE*2, FORKSKINNY_128_384_ROUNDS_BEFORE + 2*FORKSKINNY_128_384_ROUNDS_AFTER, 2);
    forkskinny_128_384_encrypt_with_tks(Sonic.fs_tks1, Sonic.fs_tks2, Sonic.fs_tks3, out_left, out_right, Chains.m);
}

void supersonic_256_forkskinny(const uint8_t key[16], 
                               uint8_t out_left[16], uint8_t out_right[16], 
                               const uint8_t *message, const uint32_t mlen){
    uint8_t res;
    uint16_t i, numP;
    uint8_t K_prime[SONICS_256_K_SIZE], mask[SONICS_256_N_SIZE], buffer[SONICS_256_K_SIZE + SONICS_256_T_SIZE+1];
    forkskinny_128_256_tweakey_schedule_t tks1, tks2;
    SonicChains Chains;
    Sonics_256_struct_t Sonic;

    res = mlen%(SONICS_256_P_SIZE-1);
    numP = (uint16_t)(mlen/(SONICS_256_P_SIZE-1)) - 1 + (res>0)*1;

    Sonic.fs_tks1 = &tks1;
    Sonic.fs_tks2 = &tks2;
    Sonic.K_prime = K_prime;
    Sonic.mask = mask;
    memset(Sonic.P, 0, SONICS_256_P_SIZE + 1);
    memset(Chains.m, 0, SONICS_256_N_SIZE);
    memset(Chains.kt, 0, SONICS_256_K_SIZE + SONICS_256_T_SIZE + 1);
    memset(buffer, 0, SONICS_256_K_SIZE + SONICS_256_T_SIZE + 1);

    // /* Key expansion forkcipher call to generate K' and Mask: FC(K, 0^t, 0^m) */
    forkskinny_128_256_init_tks_part(Sonic.fs_tks1, key    , FORKSKINNY_128_256_ROUNDS_BEFORE + 2*FORKSKINNY_128_256_ROUNDS_AFTER, 0);
    forkskinny_128_256_init_tks_part(Sonic.fs_tks2, Sonic.P, FORKSKINNY_128_256_ROUNDS_BEFORE + 2*FORKSKINNY_128_256_ROUNDS_AFTER, 1);
    forkskinny_128_256_encrypt_with_tks(Sonic.fs_tks1, Sonic.fs_tks2, Sonic.K_prime, Sonic.mask, Sonic.P); 

    for(i=0; i<numP; ++i){            
        /** 
         * Sonic.P order: 
         * M_3i   = 'Input'
         * M_3i+1 = 'Key'
         * M_3i+2 = 'Tweak'
         **/
        memcpy(Sonic.P, message + (SONICS_256_P_SIZE-1)*i, (SONICS_256_P_SIZE-1));
        supersonic_256_round(&Sonic, &Chains, buffer, i);
    }
    /* Padding */
    memset(Sonic.P, 0, SONICS_256_P_SIZE+1);
    Sonic.P[res] = SONICS_END_OF_MESSAGE;
    memcpy(Sonic.P, message + numP*(SONICS_256_P_SIZE-1), (SONICS_256_P_SIZE-1)*(res==0) + res);
    supersonic_256_round(&Sonic, &Chains, buffer, numP);

    /* Last Round */
    Chains.kt[SONICS_256_K_SIZE + SONICS_256_T_SIZE] = 0b01 + (0b10 * (res>0));
    arrXOR(Chains.kt, Sonic.K_prime, SONICS_256_K_SIZE);
    arrXOR(Chains.m,  Sonic.mask, SONICS_256_N_SIZE);
    forkskinny_128_256_init_tks_part(Sonic.fs_tks1, Chains.kt                      , FORKSKINNY_128_256_ROUNDS_BEFORE + 2*FORKSKINNY_128_256_ROUNDS_AFTER, 0);
    forkskinny_128_256_init_tks_part(Sonic.fs_tks2, Chains.kt + SONICS_256_K_SIZE  , FORKSKINNY_128_256_ROUNDS_BEFORE + 2*FORKSKINNY_128_256_ROUNDS_AFTER, 1);
    forkskinny_128_256_encrypt_with_tks(Sonic.fs_tks1, Sonic.fs_tks2, out_left, out_right, Chains.m);
}

void supersonic_192_forkskinny(const uint8_t key[16], 
                               uint8_t out_left[8], uint8_t out_right[8], 
                               const uint8_t *message, const uint32_t mlen){
    uint8_t res;
    uint16_t i, numP;
    uint8_t K_prime[SONICS_192_K_SIZE], mask[SONICS_192_N_SIZE], buffer[SONICS_192_K_SIZE + SONICS_192_T_SIZE+1];
    forkskinny_64_192_tweakey_schedule_t tks1, tks2;
    SonicChains Chains;
    Sonics_192_struct_t Sonic;

    res = mlen%(SONICS_192_P_SIZE-1);
    numP = (uint16_t)(mlen/(SONICS_192_P_SIZE-1)) - 1 + (res>0)*1;

    Sonic.fs_tks1 = &tks1;
    Sonic.fs_tks2 = &tks2;
    Sonic.K_prime = K_prime;
    Sonic.mask = mask;
    memset(Sonic.P, 0, SONICS_192_P_SIZE + 1);
    memset(Chains.m, 0, SONICS_192_N_SIZE);
    memset(Chains.kt, 0, SONICS_192_K_SIZE + SONICS_192_T_SIZE + 1);
    memset(buffer, 0, SONICS_192_K_SIZE + SONICS_192_T_SIZE + 1);

    // /* Key expansion forkcipher call to generate K' and Mask: FC(K, 0^t, 0^m) */
    forkskinny_64_192_init_tks_keypart(Sonic.fs_tks1, key, FORKSKINNY_64_192_ROUNDS_BEFORE + 2*FORKSKINNY_64_192_ROUNDS_AFTER);
    forkskinny_64_192_init_tks_tweakpart(Sonic.fs_tks2, Sonic.P, FORKSKINNY_64_192_ROUNDS_BEFORE + 2*FORKSKINNY_64_192_ROUNDS_AFTER);
    forkskinny_64_192_encrypt_with_tks(Sonic.fs_tks1, Sonic.fs_tks2, Sonic.K_prime, Sonic.K_prime + SONICS_192_K_SIZE/2, Sonic.P); 
    Sonic.P[SONICS_192_N_SIZE -1] = 1;
    forkskinny_64_192_encrypt_with_tks(Sonic.fs_tks1, Sonic.fs_tks2, 0, Sonic.mask, Sonic.P);

    for(i=0; i<numP; ++i){            
        /** 
         * Sonic.P order: 
         * M_3i   = 'Input'
         * M_3i+1 = 'Key'
         * M_3i+2 = 'Tweak'
         **/
        memcpy(Sonic.P, message + (SONICS_192_P_SIZE-1)*i, (SONICS_192_P_SIZE-1));
        supersonic_192_round(&Sonic, &Chains, buffer, i);
    }
    /* Padding */
    memset(Sonic.P, 0, SONICS_192_P_SIZE+1);
    Sonic.P[res] = SONICS_END_OF_MESSAGE;
    memcpy(Sonic.P, message + numP*(SONICS_192_P_SIZE-1), (SONICS_192_P_SIZE-1)*(res==0) + res);
    supersonic_192_round(&Sonic, &Chains, buffer, numP);

    /* Last Round */
    Chains.kt[SONICS_192_K_SIZE + SONICS_192_T_SIZE] = 0b01 + (0b10 * (res>0));
    arrXOR(Chains.kt, Sonic.K_prime, SONICS_192_K_SIZE);
    arrXOR(Chains.m,  Sonic.mask, SONICS_192_N_SIZE);
    forkskinny_64_192_init_tks_keypart(Sonic.fs_tks1, Chains.kt, FORKSKINNY_64_192_ROUNDS_BEFORE + 2*FORKSKINNY_64_192_ROUNDS_AFTER);
    forkskinny_64_192_init_tks_tweakpart(Sonic.fs_tks2, Chains.kt + SONICS_192_K_SIZE, FORKSKINNY_64_192_ROUNDS_BEFORE + 2*FORKSKINNY_64_192_ROUNDS_AFTER);
    forkskinny_64_192_encrypt_with_tks(Sonic.fs_tks1, Sonic.fs_tks2, out_left, out_right, Chains.m);
}

void forkskinny_supersonic_tag(const uint8_t key[16],
                               const uint8_t *message,
                               uint32_t message_len,
                               uint8_t tag[32])
{
    supersonic_256_forkskinny(key, tag, tag + 16, message, message_len);
}
```
