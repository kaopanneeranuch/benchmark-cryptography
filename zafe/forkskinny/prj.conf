## CMakeLists.txt
```
cmake_minimum_required(VERSION 3.20.0)
find_package(Zephyr REQUIRED HINTS $ENV{ZEPHYR_BASE})

project(forkskinny)

target_include_directories(app PRIVATE
	../../forkskinny-opt32
	../../
	../../GCTR-3/forkskinny
	${CMAKE_CURRENT_SOURCE_DIR}/src
	${CMAKE_CURRENT_SOURCE_DIR}/src/libopencm3
)

target_sources(app PRIVATE
	src/main.c
	src/bench.c
	src/forkskinny_zafe.c
	src/forkskinny_zafe_opt.c
	src/stm32wrapper_zephyr.c
	../../GCTR-3/forkskinny/fenc.c
	../../forkskinny-opt32/internal-forkskinny.c
)
```

## prj.conf
```kconfig
# Timing
CONFIG_TIMING_FUNCTIONS=y

# UART console
CONFIG_UART_CONSOLE=y
CONFIG_CONSOLE=y

# Give the crypto code room
CONFIG_MAIN_STACK_SIZE=8192
```

## src/main.c
```c
#include <zephyr/kernel.h>
#include <zephyr/sys/printk.h>
#include <zephyr/timing/timing.h>
#include "bench.h"

int main(void)
{
    printk("\n=== ForkSkinny-ZAFE AEAD Benchmark ===\n\n");
    bench_zafe_all();

    printk("\n=== ForkSkinny-ZAFE-OPT AEAD Benchmark ===\n\n");
    bench_zafe_opt_all();

    return 0;
}
```

## src/bench.c
```c
#include <zephyr/kernel.h>
#include <zephyr/sys/printk.h>
#include <zephyr/timing/timing.h>
#include <string.h>
#include <stdint.h>

#include "forkskinny_zafe.h"
#include "forkskinny_zafe_opt.h"
#include "bench.h"
#include "internal-forkskinny.h"

/* ── configuration ──────────────────────────────────────── */
#define WARMUP_ITERS   10
#define BENCH_ITERS   100
#define MESSAGE_LEN   100
#define AD_LEN         0

/* work buffers */
static uint8_t pt_buf[MESSAGE_LEN];
static uint8_t ct_buf[MESSAGE_LEN];
static uint8_t dec_buf[MESSAGE_LEN];
static uint8_t tag_buf[ZAFE_TAG_LEN];

#if AD_LEN > 0
static uint8_t ad_buf[AD_LEN];
#else
static uint8_t *ad_buf = NULL;
#endif

static zafe_key_t ks;

/* 32-byte key: first 16 bytes for enc_key, next 16 bytes for mac_key */
static const uint8_t bench_key[ZAFE_KEY_LEN] = {
    0x00,0x01,0x02,0x03,0x04,0x05,0x06,0x07,
    0x08,0x09,0x0a,0x0b,0x0c,0x0d,0x0e,0x0f,
    0x10,0x11,0x12,0x13,0x14,0x15,0x16,0x17,
    0x18,0x19,0x1a,0x1b,0x1c,0x1d,0x1e,0x1f
};

static void fill_pattern(uint8_t *buf, size_t len)
{
    if (!buf || len == 0) {
        return;
    }

    for (size_t i = 0; i < len; i++) {
        buf[i] = (uint8_t)(i & 0xFF);
    }
}

static void print_hex(const char *label, const uint8_t *buf, size_t len)
{
    printk("%s", label);
    for (size_t i = 0; i < len; i++) {
        printk("%02x", buf[i]);
    }
    printk("\n");
}

/* ── correctness check ─────────────────────────────────── */
void verify_correctness(void)
{
    int rc;

    printk("--- ForkSkinny ZAFE Correctness (msg=%d ad=%d) ---\n",
           MESSAGE_LEN, AD_LEN);

    fill_pattern(pt_buf, MESSAGE_LEN);
    fill_pattern(ad_buf, AD_LEN);

    /* initialize key schedule */
    memcpy(ks.enc_key, bench_key, ZAFE_ENC_KEY_LEN);
    memcpy(ks.mac_key, bench_key + ZAFE_ENC_KEY_LEN, ZAFE_MAC_KEY_LEN);

    rc = forkskinny_zafe_encrypt_auth(&ks,
                                      ad_buf, AD_LEN,
                                      pt_buf, MESSAGE_LEN,
                                      ct_buf, tag_buf);

    printk("Encrypt+Auth:   %s\n", rc == 0 ? "OK" : "FAIL");
    if (rc != 0) {
        printk("--- End correctness ---\n\n");
        return;
    }

    print_hex("PT[0..15]: ", pt_buf, 16);
    print_hex("CT[0..15]: ", ct_buf, 16);
    print_hex("TAG:       ", tag_buf, ZAFE_TAG_LEN);

    rc = forkskinny_zafe_decrypt_verify(&ks,
                                        ad_buf, AD_LEN,
                                        ct_buf, MESSAGE_LEN,
                                        tag_buf, dec_buf);

    print_hex("DEC[0..15]: ", dec_buf, 16);
    printk("Decrypt+Verify: %s\n", rc == 0 ? "OK" : "FAIL");

    if (rc == 0 && memcmp(pt_buf, dec_buf, MESSAGE_LEN) == 0) {
        printk("Plaintext match: OK\n");
    } else {
        printk("Plaintext match: FAIL\n");
    }

    printk("--- End correctness ---\n\n");
}

/* ── individual benchmarks ─────────────────────────────── */


static void bench_hash(void)
{
    timing_t start, end;
    uint64_t total_c = 0, total_ns = 0;

    fill_pattern(pt_buf, MESSAGE_LEN);
    fill_pattern(ad_buf, AD_LEN);
    memcpy(ks.enc_key, bench_key, ZAFE_ENC_KEY_LEN);
    memcpy(ks.mac_key, bench_key + ZAFE_ENC_KEY_LEN, ZAFE_MAC_KEY_LEN);

    for (int i = 0; i < WARMUP_ITERS; i++) {
        (void)forkskinny_zafe_auth(&ks,
                                   ad_buf, AD_LEN,
                                   pt_buf, MESSAGE_LEN,
                                   tag_buf);
    }

    /* probe: one un-timed call to count primitive invocations */
    forkskinny_counters_reset();
    (void)forkskinny_zafe_auth(&ks, ad_buf, AD_LEN, pt_buf, MESSAGE_LEN, tag_buf);
    uint32_t enc_per_op = g_fs128_256_enc_calls;
    uint32_t dec_per_op = g_fs128_256_dec_calls;

    for (int i = 0; i < WARMUP_ITERS; i++) {
        (void)forkskinny_zafe_auth(&ks,
                                   ad_buf, AD_LEN,
                                   pt_buf, MESSAGE_LEN,
                                   tag_buf);
    }

    for (int i = 0; i < BENCH_ITERS; i++) {
        start = timing_counter_get();
        (void)forkskinny_zafe_auth(&ks,
                                   ad_buf, AD_LEN,
                                   pt_buf, MESSAGE_LEN,
                                   tag_buf);
        end = timing_counter_get();

        {
            uint64_t c = timing_cycles_get(&start, &end);
            total_c  += c;
            total_ns += timing_cycles_to_ns(c);
        }
    }

    printk("  %-14s: %10llu cycles  |  %10llu ns\n", "hash (tag)",
           (unsigned long long)(total_c / BENCH_ITERS),
           (unsigned long long)(total_ns / BENCH_ITERS));
    printk("    [prim/op] FS-128-256: enc=%lu dec=%lu\n",
           (unsigned long)enc_per_op, (unsigned long)dec_per_op);
}

static void bench_encrypt(void)
{
    timing_t start, end;
    uint64_t total_c = 0, total_ns = 0;

    fill_pattern(pt_buf, MESSAGE_LEN);
    fill_pattern(ad_buf, AD_LEN);
    memcpy(ks.enc_key, bench_key, ZAFE_ENC_KEY_LEN);
    memcpy(ks.mac_key, bench_key + ZAFE_ENC_KEY_LEN, ZAFE_MAC_KEY_LEN);

    (void)forkskinny_zafe_auth(&ks,
                               ad_buf, AD_LEN,
                               pt_buf, MESSAGE_LEN,
                               tag_buf);

    /* probe: one un-timed call to count primitive invocations */
    {
        uint8_t tag_local[ZAFE_TAG_LEN];
        memcpy(tag_local, tag_buf, ZAFE_TAG_LEN);
        forkskinny_counters_reset();
        forkskinny_zafe_encrypt(&ks, tag_local, pt_buf, MESSAGE_LEN, ct_buf);
    }
    uint32_t enc_per_op = g_fs128_256_enc_calls;
    uint32_t dec_per_op = g_fs128_256_dec_calls;

    for (int i = 0; i < WARMUP_ITERS; i++) {
        uint8_t tag_local[ZAFE_TAG_LEN];
        memcpy(tag_local, tag_buf, ZAFE_TAG_LEN);
        forkskinny_zafe_encrypt(&ks, tag_local, pt_buf, MESSAGE_LEN, ct_buf);
    }

    for (int i = 0; i < BENCH_ITERS; i++) {
        uint8_t tag_local[ZAFE_TAG_LEN];
        memcpy(tag_local, tag_buf, ZAFE_TAG_LEN);

        start = timing_counter_get();
        forkskinny_zafe_encrypt(&ks, tag_local, pt_buf, MESSAGE_LEN, ct_buf);
        end = timing_counter_get();

        {
            uint64_t c = timing_cycles_get(&start, &end);
            total_c  += c;
            total_ns += timing_cycles_to_ns(c);
        }
    }

    printk("  %-14s: %10llu cycles  |  %10llu ns\n", "encrypt",
           (unsigned long long)(total_c / BENCH_ITERS),
           (unsigned long long)(total_ns / BENCH_ITERS));
    printk("    [prim/op] FS-128-256: enc=%lu dec=%lu\n",
           (unsigned long)enc_per_op, (unsigned long)dec_per_op);
}

static void bench_decrypt(void)
{
    timing_t start, end;
    uint64_t total_c = 0, total_ns = 0;

    fill_pattern(pt_buf, MESSAGE_LEN);
    fill_pattern(ad_buf, AD_LEN);
    memcpy(ks.enc_key, bench_key, ZAFE_ENC_KEY_LEN);
    memcpy(ks.mac_key, bench_key + ZAFE_ENC_KEY_LEN, ZAFE_MAC_KEY_LEN);

    (void)forkskinny_zafe_encrypt_auth(&ks,
                                       ad_buf, AD_LEN,
                                       pt_buf, MESSAGE_LEN,
                                       ct_buf, tag_buf);

    /* probe: one un-timed call to count primitive invocations */
    {
        uint8_t tag_local[ZAFE_TAG_LEN];
        memcpy(tag_local, tag_buf, ZAFE_TAG_LEN);
        forkskinny_counters_reset();
        forkskinny_zafe_decrypt(&ks, tag_local, ct_buf, MESSAGE_LEN, dec_buf);
    }
    uint32_t enc_per_op = g_fs128_256_enc_calls;
    uint32_t dec_per_op = g_fs128_256_dec_calls;

    for (int i = 0; i < WARMUP_ITERS; i++) {
        uint8_t tag_local[ZAFE_TAG_LEN];
        memcpy(tag_local, tag_buf, ZAFE_TAG_LEN);
        forkskinny_zafe_decrypt(&ks, tag_local, ct_buf, MESSAGE_LEN, dec_buf);
    }

    for (int i = 0; i < BENCH_ITERS; i++) {
        uint8_t tag_local[ZAFE_TAG_LEN];
        memcpy(tag_local, tag_buf, ZAFE_TAG_LEN);

        start = timing_counter_get();
        forkskinny_zafe_decrypt(&ks, tag_local, ct_buf, MESSAGE_LEN, dec_buf);
        end = timing_counter_get();

        {
            uint64_t c = timing_cycles_get(&start, &end);
            total_c  += c;
            total_ns += timing_cycles_to_ns(c);
        }
    }

    printk("  %-14s: %10llu cycles  |  %10llu ns\n", "decrypt",
           (unsigned long long)(total_c / BENCH_ITERS),
           (unsigned long long)(total_ns / BENCH_ITERS));
    printk("    [prim/op] FS-128-256: enc=%lu dec=%lu\n",
           (unsigned long)enc_per_op, (unsigned long)dec_per_op);
}

static void bench_verify(void)
{
    timing_t start, end;
    uint64_t total_c = 0, total_ns = 0;

    fill_pattern(pt_buf, MESSAGE_LEN);
    fill_pattern(ad_buf, AD_LEN);
    memcpy(ks.enc_key, bench_key, ZAFE_ENC_KEY_LEN);
    memcpy(ks.mac_key, bench_key + ZAFE_ENC_KEY_LEN, ZAFE_MAC_KEY_LEN);

    (void)forkskinny_zafe_auth(&ks,
                               ad_buf, AD_LEN,
                               pt_buf, MESSAGE_LEN,
                               tag_buf);

    /* probe: one un-timed call to count primitive invocations */
    forkskinny_counters_reset();
    (void)forkskinny_zafe_verify(&ks, ad_buf, AD_LEN, pt_buf, MESSAGE_LEN, tag_buf);
    uint32_t enc_per_op = g_fs128_256_enc_calls;
    uint32_t dec_per_op = g_fs128_256_dec_calls;

    for (int i = 0; i < WARMUP_ITERS; i++) {
        (void)forkskinny_zafe_verify(&ks,
                                     ad_buf, AD_LEN,
                                     pt_buf, MESSAGE_LEN,
                                     tag_buf);
    }

    for (int i = 0; i < BENCH_ITERS; i++) {
        start = timing_counter_get();
        (void)forkskinny_zafe_verify(&ks,
                                     ad_buf, AD_LEN,
                                     pt_buf, MESSAGE_LEN,
                                     tag_buf);
        end = timing_counter_get();

        {
            uint64_t c = timing_cycles_get(&start, &end);
            total_c  += c;
            total_ns += timing_cycles_to_ns(c);
        }
    }

    printk("  %-14s: %10llu cycles  |  %10llu ns\n", "verify",
           (unsigned long long)(total_c / BENCH_ITERS),
           (unsigned long long)(total_ns / BENCH_ITERS));
    printk("    [prim/op] FS-128-256: enc=%lu dec=%lu\n",
           (unsigned long)enc_per_op, (unsigned long)dec_per_op);
}

/* ── top-level entry ───────────────────────────────────── */
void bench_zafe_all(void)
{
    timing_init();
    timing_start();

    printk("[FORKSKINNY ZAFE] Benchmark  msg=%d ad=%d iters=%d\n",
           MESSAGE_LEN, AD_LEN, BENCH_ITERS);
    printk("  sizes:  key=%d  nonce=none  tag=%d  pt=%d  ct=%d  ad=%d  (bytes)\n",
           ZAFE_KEY_LEN, ZAFE_TAG_LEN, MESSAGE_LEN, MESSAGE_LEN, AD_LEN);
    printk("  %-14s  %10s  %12s\n", "operation", "cycles", "ns");

    verify_correctness();

    bench_hash();
    bench_encrypt();
    bench_decrypt();
    bench_verify();

    timing_stop();

    printk("--- Benchmark complete ---\n\n");
}

/* ── OPT variants ──────────────────────────────────────── */

void verify_correctness_opt(void)
{
    int rc;

    printk("--- ForkSkinny ZAFE-OPT Correctness (msg=%d ad=%d) ---\n",
           MESSAGE_LEN, AD_LEN);

    fill_pattern(pt_buf, MESSAGE_LEN);
    fill_pattern(ad_buf, AD_LEN);

    memcpy(ks.enc_key, bench_key, ZAFE_ENC_KEY_LEN);
    memcpy(ks.mac_key, bench_key + ZAFE_ENC_KEY_LEN, ZAFE_MAC_KEY_LEN);

    rc = forkskinny_zafe_opt_encrypt_auth(&ks,
                                          ad_buf, AD_LEN,
                                          pt_buf, MESSAGE_LEN,
                                          ct_buf, tag_buf);

    printk("Encrypt+Auth:   %s\n", rc == 0 ? "OK" : "FAIL");
    if (rc != 0) {
        printk("--- End correctness ---\n\n");
        return;
    }

    print_hex("PT[0..15]: ", pt_buf, 16);
    print_hex("CT[0..15]: ", ct_buf, 16);
    print_hex("TAG:       ", tag_buf, ZAFE_TAG_LEN);

    rc = forkskinny_zafe_opt_decrypt_verify(&ks,
                                            ad_buf, AD_LEN,
                                            ct_buf, MESSAGE_LEN,
                                            tag_buf, dec_buf);

    print_hex("DEC[0..15]: ", dec_buf, 16);
    printk("Decrypt+Verify: %s\n", rc == 0 ? "OK" : "FAIL");

    if (rc == 0 && memcmp(pt_buf, dec_buf, MESSAGE_LEN) == 0) {
        printk("Plaintext match: OK\n");
    } else {
        printk("Plaintext match: FAIL\n");
    }

    printk("--- End correctness ---\n\n");
}

static void bench_hash_opt(void)
{
    timing_t start, end;
    uint64_t total_c = 0, total_ns = 0;

    fill_pattern(pt_buf, MESSAGE_LEN);
    fill_pattern(ad_buf, AD_LEN);
    memcpy(ks.enc_key, bench_key, ZAFE_ENC_KEY_LEN);
    memcpy(ks.mac_key, bench_key + ZAFE_ENC_KEY_LEN, ZAFE_MAC_KEY_LEN);

    for (int i = 0; i < WARMUP_ITERS; i++)
        (void)forkskinny_zafe_opt_auth(&ks, ad_buf, AD_LEN, pt_buf, MESSAGE_LEN, tag_buf);

    forkskinny_counters_reset();
    (void)forkskinny_zafe_opt_auth(&ks, ad_buf, AD_LEN, pt_buf, MESSAGE_LEN, tag_buf);
    uint32_t enc_per_op = g_fs128_256_enc_calls;
    uint32_t dec_per_op = g_fs128_256_dec_calls;

    for (int i = 0; i < WARMUP_ITERS; i++)
        (void)forkskinny_zafe_opt_auth(&ks, ad_buf, AD_LEN, pt_buf, MESSAGE_LEN, tag_buf);

    for (int i = 0; i < BENCH_ITERS; i++) {
        start = timing_counter_get();
        (void)forkskinny_zafe_opt_auth(&ks, ad_buf, AD_LEN, pt_buf, MESSAGE_LEN, tag_buf);
        end = timing_counter_get();
        uint64_t c = timing_cycles_get(&start, &end);
        total_c  += c;
        total_ns += timing_cycles_to_ns(c);
    }

    printk("  %-14s: %10llu cycles  |  %10llu ns\n", "hash (tag)",
           (unsigned long long)(total_c / BENCH_ITERS),
           (unsigned long long)(total_ns / BENCH_ITERS));
    printk("    [prim/op] FS-128-256: enc=%lu dec=%lu\n",
           (unsigned long)enc_per_op, (unsigned long)dec_per_op);
}

static void bench_encrypt_opt(void)
{
    timing_t start, end;
    uint64_t total_c = 0, total_ns = 0;

    fill_pattern(pt_buf, MESSAGE_LEN);
    fill_pattern(ad_buf, AD_LEN);
    memcpy(ks.enc_key, bench_key, ZAFE_ENC_KEY_LEN);
    memcpy(ks.mac_key, bench_key + ZAFE_ENC_KEY_LEN, ZAFE_MAC_KEY_LEN);

    (void)forkskinny_zafe_opt_auth(&ks, ad_buf, AD_LEN, pt_buf, MESSAGE_LEN, tag_buf);

    {
        uint8_t tag_local[ZAFE_TAG_LEN];
        memcpy(tag_local, tag_buf, ZAFE_TAG_LEN);
        forkskinny_counters_reset();
        forkskinny_zafe_opt_encrypt(&ks, tag_local, pt_buf, MESSAGE_LEN, ct_buf);
    }
    uint32_t enc_per_op = g_fs128_256_enc_calls;
    uint32_t dec_per_op = g_fs128_256_dec_calls;

    for (int i = 0; i < WARMUP_ITERS; i++) {
        uint8_t tag_local[ZAFE_TAG_LEN];
        memcpy(tag_local, tag_buf, ZAFE_TAG_LEN);
        forkskinny_zafe_opt_encrypt(&ks, tag_local, pt_buf, MESSAGE_LEN, ct_buf);
    }

    for (int i = 0; i < BENCH_ITERS; i++) {
        uint8_t tag_local[ZAFE_TAG_LEN];
        memcpy(tag_local, tag_buf, ZAFE_TAG_LEN);
        start = timing_counter_get();
        forkskinny_zafe_opt_encrypt(&ks, tag_local, pt_buf, MESSAGE_LEN, ct_buf);
        end = timing_counter_get();
        uint64_t c = timing_cycles_get(&start, &end);
        total_c  += c;
        total_ns += timing_cycles_to_ns(c);
    }

    printk("  %-14s: %10llu cycles  |  %10llu ns\n", "encrypt",
           (unsigned long long)(total_c / BENCH_ITERS),
           (unsigned long long)(total_ns / BENCH_ITERS));
    printk("    [prim/op] FS-128-256: enc=%lu dec=%lu\n",
           (unsigned long)enc_per_op, (unsigned long)dec_per_op);
}

static void bench_decrypt_opt(void)
{
    timing_t start, end;
    uint64_t total_c = 0, total_ns = 0;

    fill_pattern(pt_buf, MESSAGE_LEN);
    fill_pattern(ad_buf, AD_LEN);
    memcpy(ks.enc_key, bench_key, ZAFE_ENC_KEY_LEN);
    memcpy(ks.mac_key, bench_key + ZAFE_ENC_KEY_LEN, ZAFE_MAC_KEY_LEN);

    (void)forkskinny_zafe_opt_encrypt_auth(&ks, ad_buf, AD_LEN, pt_buf, MESSAGE_LEN, ct_buf, tag_buf);

    {
        uint8_t tag_local[ZAFE_TAG_LEN];
        memcpy(tag_local, tag_buf, ZAFE_TAG_LEN);
        forkskinny_counters_reset();
        forkskinny_zafe_opt_decrypt(&ks, tag_local, ct_buf, MESSAGE_LEN, dec_buf);
    }
    uint32_t enc_per_op = g_fs128_256_enc_calls;
    uint32_t dec_per_op = g_fs128_256_dec_calls;

    for (int i = 0; i < WARMUP_ITERS; i++) {
        uint8_t tag_local[ZAFE_TAG_LEN];
        memcpy(tag_local, tag_buf, ZAFE_TAG_LEN);
        forkskinny_zafe_opt_decrypt(&ks, tag_local, ct_buf, MESSAGE_LEN, dec_buf);
    }

    for (int i = 0; i < BENCH_ITERS; i++) {
        uint8_t tag_local[ZAFE_TAG_LEN];
        memcpy(tag_local, tag_buf, ZAFE_TAG_LEN);
        start = timing_counter_get();
        forkskinny_zafe_opt_decrypt(&ks, tag_local, ct_buf, MESSAGE_LEN, dec_buf);
        end = timing_counter_get();
        uint64_t c = timing_cycles_get(&start, &end);
        total_c  += c;
        total_ns += timing_cycles_to_ns(c);
    }

    printk("  %-14s: %10llu cycles  |  %10llu ns\n", "decrypt",
           (unsigned long long)(total_c / BENCH_ITERS),
           (unsigned long long)(total_ns / BENCH_ITERS));
    printk("    [prim/op] FS-128-256: enc=%lu dec=%lu\n",
           (unsigned long)enc_per_op, (unsigned long)dec_per_op);
}

static void bench_verify_opt(void)
{
    timing_t start, end;
    uint64_t total_c = 0, total_ns = 0;

    fill_pattern(pt_buf, MESSAGE_LEN);
    fill_pattern(ad_buf, AD_LEN);
    memcpy(ks.enc_key, bench_key, ZAFE_ENC_KEY_LEN);
    memcpy(ks.mac_key, bench_key + ZAFE_ENC_KEY_LEN, ZAFE_MAC_KEY_LEN);

    (void)forkskinny_zafe_opt_auth(&ks, ad_buf, AD_LEN, pt_buf, MESSAGE_LEN, tag_buf);

    forkskinny_counters_reset();
    (void)forkskinny_zafe_opt_verify(&ks, ad_buf, AD_LEN, pt_buf, MESSAGE_LEN, tag_buf);
    uint32_t enc_per_op = g_fs128_256_enc_calls;
    uint32_t dec_per_op = g_fs128_256_dec_calls;

    for (int i = 0; i < WARMUP_ITERS; i++)
        (void)forkskinny_zafe_opt_verify(&ks, ad_buf, AD_LEN, pt_buf, MESSAGE_LEN, tag_buf);

    for (int i = 0; i < BENCH_ITERS; i++) {
        start = timing_counter_get();
        (void)forkskinny_zafe_opt_verify(&ks, ad_buf, AD_LEN, pt_buf, MESSAGE_LEN, tag_buf);
        end = timing_counter_get();
        uint64_t c = timing_cycles_get(&start, &end);
        total_c  += c;
        total_ns += timing_cycles_to_ns(c);
    }

    printk("  %-14s: %10llu cycles  |  %10llu ns\n", "verify",
           (unsigned long long)(total_c / BENCH_ITERS),
           (unsigned long long)(total_ns / BENCH_ITERS));
    printk("    [prim/op] FS-128-256: enc=%lu dec=%lu\n",
           (unsigned long)enc_per_op, (unsigned long)dec_per_op);
}

void bench_zafe_opt_all(void)
{
    timing_init();
    timing_start();

    printk("[FORKSKINNY ZAFE-OPT] Benchmark  msg=%d ad=%d iters=%d\n",
           MESSAGE_LEN, AD_LEN, BENCH_ITERS);
    printk("  sizes:  key=%d  nonce=none  tag=%d  pt=%d  ct=%d  ad=%d  (bytes)\n",
           ZAFE_KEY_LEN, ZAFE_TAG_LEN, MESSAGE_LEN, MESSAGE_LEN, AD_LEN);
    printk("  %-14s  %10s  %12s\n", "operation", "cycles", "ns");

    verify_correctness_opt();

    bench_hash_opt();
    bench_encrypt_opt();
    bench_decrypt_opt();
    bench_verify_opt();

    timing_stop();

    printk("--- Benchmark complete ---\n\n");
}
```

## src/bench.h
```c
#ifndef BENCH_H
#define BENCH_H

void verify_correctness(void);
void bench_zafe_all(void);

void verify_correctness_opt(void);
void bench_zafe_opt_all(void);

#endif /* BENCH_H */
```

## src/forkskinny_zafe.c
```c
#include "forkskinny_zafe.h"
#include "internal-forkskinny.h"
#include "fenc.h"
#include "stm32wrapper.h"

#include <stdint.h>
#include <stddef.h>
#include <stdlib.h>
#include <string.h>

#define N            16
#define TWO_N        32
#define KEY_LEN      16

#define ZT_BYTES     15
#define ZBLOCK_LEN   (N + ZT_BYTES)

// helper

static void ct_memzero(void *p, size_t n)
{
    volatile uint8_t *vp = (volatile uint8_t *)p;
    while (n--) {
        *vp++ = 0;
    }
}

static int ct_memcmp_eq(const uint8_t *a, const uint8_t *b, size_t n)
{
    uint8_t diff = 0;
    for (size_t i = 0; i < n; ++i) {
        diff |= (uint8_t)(a[i] ^ b[i]);
    }
    return diff == 0;
}

/* ----------------------------- ZHASH / ZMAC / ZFMac ----------------------------- */

/* Map pasted-code macros to local definitions */
#ifndef KS
#define KS KEY_LEN
#endif
#ifndef TS
#define TS (ZT_BYTES + 1)
#endif
#ifndef BS
#define BS N
#endif

#ifndef MIN
#define MIN(a,b) ((a) < (b) ? (a) : (b))
#endif

typedef struct {
    unsigned char tweakey[KS + TS];
    unsigned char message[BS];
    unsigned char mask_l[BS];
    unsigned char mask_r[BS];
    unsigned char out[BS * 2];
} ZmacStruct;

typedef struct {
    unsigned char u[BS];
    unsigned char v[TS];
} MacChains;

static void arrXOR(unsigned char *out, unsigned char *right, uint16_t len){
    for(uint16_t i = 0; i < len; ++i){
        out[i] ^= right[i];
    }
}

static void arrLeftByOne(unsigned char *out, int len){
    for (int i = 0;  i < len - 1;  ++i){
        out[i] = (unsigned char)((out[i] << 1) | ((out[i+1] >> 7) & 1));
    }
    out[len-1] = (unsigned char)(out[len-1] << 1);
}

static void arrMULT(unsigned char *out, uint8_t prpol, uint8_t len){
    uint8_t tmp = (out[len-1] >> 7) & 1;
    arrLeftByOne(out, len);
    out[0] ^= prpol * tmp;
}

static void ZHASH(ZmacStruct *pZmac, MacChains *pChains, unsigned char prpol){
    unsigned char tmp[TS-1], cmask[BS];
    memcpy(tmp, pZmac->tweakey + KS, TS-1);

    arrXOR(pZmac->message, pZmac->mask_l, BS);
    arrXOR(pZmac->tweakey + KS, pZmac->mask_r, MIN(TS-1, BS));

    pZmac->tweakey[KS + TS-1] = 0x08;
    forkskinny_128_256_encrypt(pZmac->tweakey, cmask, NULL, pZmac->message);

    arrXOR(pChains->u, cmask, BS);
    arrMULT(pChains->u, prpol, BS);

    arrXOR(tmp, cmask, MIN(TS-1, BS));
    arrXOR(pChains->v, tmp, TS-1);

    arrMULT(pZmac->mask_l, prpol, BS);
    arrMULT(pZmac->mask_r, prpol, BS);
}

static void ZFIN(ZmacStruct *pZmac, uint8_t fin){
    unsigned char tmp[BS];
    /* Y_1 */
    pZmac->tweakey[KS+TS-1] = fin;
    forkskinny_128_256_encrypt(pZmac->tweakey, pZmac->out, NULL, pZmac->message);

    ++pZmac->tweakey[KS+TS-1];
    forkskinny_128_256_encrypt(pZmac->tweakey, tmp, NULL, pZmac->message);
    arrXOR(pZmac->out, tmp, BS);

    /* Y_2 */
    ++pZmac->tweakey[KS+TS-1];
    forkskinny_128_256_encrypt(pZmac->tweakey, &pZmac->out[BS], NULL, pZmac->message);

    ++pZmac->tweakey[KS+TS-1];
    forkskinny_128_256_encrypt(pZmac->tweakey, tmp, NULL, pZmac->message);
    arrXOR(&pZmac->out[BS], tmp, BS);
}

static void ZMAC_padding(ZmacStruct *pZmac, uint8_t *fin, uint8_t res, uint64_t *cc){
    if (res){
        memset(pZmac->message, 0, BS);
        memset(pZmac->tweakey + KS, 0, TS);
        if(res >= BS){
            res -= BS;
            pZmac->tweakey[KS+res] ^= (1<<7);
            recv_USART_bytes(pZmac->message, BS,cc);
            recv_USART_bytes(pZmac->tweakey + KS, res,cc);
        } else{
            recv_USART_bytes(pZmac->message, res,cc);
            pZmac->message[res] ^= (1<<7);
        }
        *fin = 4;
    } else{
        recv_USART_bytes(pZmac->message, BS, cc);
        recv_USART_bytes(pZmac->tweakey + KS, TS-1, cc);
        *fin = 0;
    }
}

static void ZMAC_encrypt(unsigned char *out_left, unsigned char *out_right, unsigned char *key, uint32_t mlen, uint64_t *cc){
    DWT_CYCCNT = 0;
    uint8_t pbsize = TS+BS-1;
    uint8_t res = mlen%pbsize, fin = 0;
    uint16_t nP_complete = (res) ? (uint16_t)(mlen/pbsize) : (uint16_t)((mlen/pbsize)-1);
    ZmacStruct Zmac;
    MacChains Chains;

    memcpy(Zmac.tweakey, key, KS);
    memset(Zmac.tweakey + KS, 0, TS);
    memset(Zmac.message, 0, BS);
    memset(Chains.u, 0, BS);
    memset(Chains.v, 0, TS);

#if BS == 16
        unsigned char prpol = 0b10000111;
#else
        unsigned char prpol = 0b00011011;
#endif

    Zmac.tweakey[KS+TS-1] = 0x09;
    forkskinny_128_256_encrypt(Zmac.tweakey, Zmac.mask_l, NULL, Zmac.message);

    Zmac.tweakey[KS+TS-2] = 0x01;
    forkskinny_128_256_encrypt(Zmac.tweakey, Zmac.mask_r, NULL, Zmac.message);

    send_USART_bytes(&pbsize,1,cc);
    for(uint16_t i = 0;i<nP_complete; ++i){
        recv_USART_bytes(Zmac.message, BS,cc);
        recv_USART_bytes(Zmac.tweakey + KS, TS-1,cc);
        ZHASH(&Zmac, &Chains, prpol);
        send_USART_bytes(0,1,cc);
    }
    ZMAC_padding(&Zmac, &fin, res, cc);

    ZHASH(&Zmac, &Chains, prpol);
    memcpy(Zmac.tweakey + KS, Chains.v, TS);
    memcpy(Zmac.message, Chains.u, BS);
    ZFIN(&Zmac, fin);
    send_USART_bytes(0,1,cc);

    memcpy(out_left, Zmac.out, BS);
    memcpy(out_right, Zmac.out +BS, BS);
}


/* ----------------------------- IV derivation for GCTR core ----------------------------- */

/* fenc() expects a preformatted 32-byte IV = U || V_rep.
 * In this adaptation, ZAFE exposes a 32-byte tag and uses it directly as IV.
 */
static void zafe_iv_from_tag(const uint8_t tag[ZAFE_TAG_LEN],
                             uint8_t iv[TWO_N])
{
    memcpy(iv, tag, TWO_N);
}

/* ----------------------------- zfmac wrapper (streaming) ----------------------------- */

static int zfmac(const unsigned char key[KEY_LEN],
                 const unsigned char *ad, size_t adlen,
                 const unsigned char *msg, size_t mlen,
                 unsigned char *tag, size_t taglen)
{
    unsigned char out_l[BS], out_r[BS];
    uint64_t cc = 0;

    if (taglen < TWO_N) return -1;

    ZMAC_encrypt(out_l, out_r, (unsigned char *)key, (uint32_t)mlen, &cc);

    memcpy(tag, out_l, BS);
    memcpy(tag + BS, out_r, BS);

    return 0;
}

/* ----------------------------- public API ----------------------------- */

int forkskinny_zafe_auth(const zafe_key_t *ks,
                         const uint8_t *ad, size_t adlen,
                         const uint8_t *msg, size_t mlen,
                         uint8_t tag[ZAFE_TAG_LEN])
{
    return zfmac(ks->mac_key, ad, adlen, msg, mlen, tag, ZAFE_TAG_LEN);
}

int forkskinny_zafe_verify(const zafe_key_t *ks,
                           const uint8_t *ad, size_t adlen,
                           const uint8_t *msg, size_t mlen,
                           const uint8_t tag[ZAFE_TAG_LEN])
{
    uint8_t computed[ZAFE_TAG_LEN];
    int rc;

    rc = zfmac(ks->mac_key, ad, adlen, msg, mlen, computed, ZAFE_TAG_LEN);
    if (rc != 0) {
        ct_memzero(computed, sizeof(computed));
        return -1;
    }

    rc = ct_memcmp_eq(computed, tag, ZAFE_TAG_LEN) ? 0 : -1;
    ct_memzero(computed, sizeof(computed));
    return rc;
}

void forkskinny_zafe_encrypt(const zafe_key_t *ks,
                             const uint8_t tag[ZAFE_TAG_LEN],
                             const uint8_t *msg, size_t mlen,
                             uint8_t *ct)
{
    uint8_t iv[TWO_N];

    zafe_iv_from_tag(tag, iv);
    fenc(ks->enc_key, iv, msg, mlen, ct);
    ct_memzero(iv, sizeof(iv));
}

void forkskinny_zafe_decrypt(const zafe_key_t *ks,
                             const uint8_t tag[ZAFE_TAG_LEN],
                             const uint8_t *ct, size_t clen,
                             uint8_t *msg)
{
    uint8_t iv[TWO_N];

    zafe_iv_from_tag(tag, iv);
    fenc(ks->enc_key, iv, ct, clen, msg);
    ct_memzero(iv, sizeof(iv));
}

int forkskinny_zafe_encrypt_auth(const zafe_key_t *ks,
                                 const uint8_t *ad, size_t adlen,
                                 const uint8_t *msg, size_t mlen,
                                 uint8_t *ct,
                                 uint8_t tag[ZAFE_TAG_LEN])
{
    int rc;

    rc = forkskinny_zafe_auth(ks, ad, adlen, msg, mlen, tag);
    if (rc != 0) {
        return -1;
    }

    forkskinny_zafe_encrypt(ks, tag, msg, mlen, ct);
    return 0;
}

int forkskinny_zafe_decrypt_verify(const zafe_key_t *ks,
                                   const uint8_t *ad, size_t adlen,
                                   const uint8_t *ct, size_t clen,
                                   const uint8_t tag[ZAFE_TAG_LEN],
                                   uint8_t *msg)
{
    int rc;

    forkskinny_zafe_decrypt(ks, tag, ct, clen, msg);

    rc = forkskinny_zafe_verify(ks, ad, adlen, msg, clen, tag);
    if (rc != 0) {
        ct_memzero(msg, clen);
        return -1;
    }

    return 0;
}
```

## src/forkskinny_zafe.h
```c
#ifndef FORKSKINNY_ZAFE_H
#define FORKSKINNY_ZAFE_H

#include <stddef.h>
#include <stdint.h>

#define ZAFE_ENC_KEY_LEN 16
#define ZAFE_MAC_KEY_LEN 16
#define ZAFE_KEY_LEN     (ZAFE_ENC_KEY_LEN + ZAFE_MAC_KEY_LEN)
#define ZAFE_TAG_LEN     32

typedef struct {
    uint8_t enc_key[ZAFE_ENC_KEY_LEN];
    uint8_t mac_key[ZAFE_MAC_KEY_LEN];
} zafe_key_t;

int forkskinny_zafe_auth(const zafe_key_t *ks,
                         const uint8_t *ad, size_t adlen,
                         const uint8_t *msg, size_t mlen,
                         uint8_t tag[ZAFE_TAG_LEN]);

int forkskinny_zafe_verify(const zafe_key_t *ks,
                           const uint8_t *ad, size_t adlen,
                           const uint8_t *msg, size_t mlen,
                           const uint8_t tag[ZAFE_TAG_LEN]);

void forkskinny_zafe_encrypt(const zafe_key_t *ks,
                             const uint8_t tag[ZAFE_TAG_LEN],
                             const uint8_t *msg, size_t mlen,
                             uint8_t *ct);

void forkskinny_zafe_decrypt(const zafe_key_t *ks,
                             const uint8_t tag[ZAFE_TAG_LEN],
                             const uint8_t *ct, size_t clen,
                             uint8_t *msg);

int forkskinny_zafe_encrypt_auth(const zafe_key_t *ks,
                                 const uint8_t *ad, size_t adlen,
                                 const uint8_t *msg, size_t mlen,
                                 uint8_t *ct,
                                 uint8_t tag[ZAFE_TAG_LEN]);

int forkskinny_zafe_decrypt_verify(const zafe_key_t *ks,
                                   const uint8_t *ad, size_t adlen,
                                   const uint8_t *ct, size_t clen,
                                   const uint8_t tag[ZAFE_TAG_LEN],
                                   uint8_t *msg);

#endif
```

## src/forkskinny_zafe_opt.c
```c
#include "forkskinny_zafe_opt.h"
#include "internal-forkskinny.h"
#include "fenc.h"
#include "stm32wrapper.h"

#include <stdint.h>
#include <stddef.h>
#include <stdlib.h>
#include <string.h>

#define N            16
#define TWO_N        32
#define KEY_LEN      16

#define ZT_BYTES     15
#define ZBLOCK_LEN   (N + ZT_BYTES)

// helper

static void ct_memzero(void *p, size_t n)
{
    volatile uint8_t *vp = (volatile uint8_t *)p;
    while (n--) {
        *vp++ = 0;
    }
}

static int ct_memcmp_eq(const uint8_t *a, const uint8_t *b, size_t n)
{
    uint8_t diff = 0;
    for (size_t i = 0; i < n; ++i) {
        diff |= (uint8_t)(a[i] ^ b[i]);
    }
    return diff == 0;
}

/* ----------------------------- ZHASH / ZMAC / ZFMac ----------------------------- */

/* Map pasted-code macros to local definitions */
#ifndef KS
#define KS KEY_LEN
#endif
#ifndef TS
#define TS (ZT_BYTES + 1)
#endif
#ifndef BS
#define BS N
#endif

#ifndef MIN
#define MIN(a,b) ((a) < (b) ? (a) : (b))
#endif

typedef struct {
    unsigned char tweakey[KS + TS];
    unsigned char message[BS];
    unsigned char mask_l[BS];
    unsigned char mask_r[BS];
    unsigned char out[BS * 2];
} ZmacStruct;

typedef struct {
    unsigned char u[BS];
    unsigned char v[TS];
} MacChains;

static void arrXOR(unsigned char *out, unsigned char *right, uint16_t len){
    for(uint16_t i = 0; i < len; ++i){
        out[i] ^= right[i];
    }
}

static void arrLeftByOne(unsigned char *out, int len){
    for (int i = 0;  i < len - 1;  ++i){
        out[i] = (unsigned char)((out[i] << 1) | ((out[i+1] >> 7) & 1));
    }
    out[len-1] = (unsigned char)(out[len-1] << 1);
}

static void arrMULT(unsigned char *out, uint8_t prpol, uint8_t len){
    uint8_t tmp = (out[len-1] >> 7) & 1;
    arrLeftByOne(out, len);
    out[0] ^= prpol * tmp;
}

static void ZHASH(ZmacStruct *pZmac, MacChains *pChains, unsigned char prpol){
    unsigned char tmp[TS-1], cmask_l[BS], cmask_r[BS];
    memcpy(tmp, pZmac->tweakey + KS, TS-1);

    arrXOR(pZmac->message, pZmac->mask_l, BS);
    arrXOR(pZmac->tweakey + KS, pZmac->mask_r, MIN(TS-1, BS));

    /* Both fork legs: C0 (left) updates u-chain, C1 (right) updates v-chain */
    pZmac->tweakey[KS + TS-1] = 0x08;
    forkskinny_128_256_encrypt(pZmac->tweakey, cmask_l, cmask_r, pZmac->message);

    arrXOR(pChains->u, cmask_l, BS);
    arrMULT(pChains->u, prpol, BS);

    arrXOR(tmp, cmask_r, MIN(TS-1, BS));
    arrXOR(pChains->v, tmp, TS-1);

    arrMULT(pZmac->mask_l, prpol, BS);
    arrMULT(pZmac->mask_r, prpol, BS);
}

static void ZFIN(ZmacStruct *pZmac, uint8_t fin){
    unsigned char tmp[BS];
    /* Y_1 = C0(fin) XOR C1(fin): both fork legs from one call */
    pZmac->tweakey[KS+TS-1] = fin;
    forkskinny_128_256_encrypt(pZmac->tweakey, pZmac->out, tmp, pZmac->message);
    arrXOR(pZmac->out, tmp, BS);

    /* Y_2 = C0(fin+2) XOR C1(fin+2): both fork legs from one call */
    pZmac->tweakey[KS+TS-1] = (uint8_t)(fin + 2);
    forkskinny_128_256_encrypt(pZmac->tweakey, &pZmac->out[BS], tmp, pZmac->message);
    arrXOR(&pZmac->out[BS], tmp, BS);
}

static void ZMAC_padding(ZmacStruct *pZmac, uint8_t *fin, uint8_t res, uint64_t *cc){
    if (res){
        memset(pZmac->message, 0, BS);
        memset(pZmac->tweakey + KS, 0, TS);
        if(res >= BS){
            res -= BS;
            pZmac->tweakey[KS+res] ^= (1<<7);
            recv_USART_bytes(pZmac->message, BS,cc);
            recv_USART_bytes(pZmac->tweakey + KS, res,cc);
        } else{
            recv_USART_bytes(pZmac->message, res,cc);
            pZmac->message[res] ^= (1<<7);
        }
        *fin = 4;
    } else{
        recv_USART_bytes(pZmac->message, BS, cc);
        recv_USART_bytes(pZmac->tweakey + KS, TS-1, cc);
        *fin = 0;
    }
}

static void ZMAC_encrypt(unsigned char *out_left, unsigned char *out_right, unsigned char *key, uint32_t mlen, uint64_t *cc){
    DWT_CYCCNT = 0;
    uint8_t pbsize = TS+BS-1;
    uint8_t res = mlen%pbsize, fin = 0;
    uint16_t nP_complete = (res) ? (uint16_t)(mlen/pbsize) : (uint16_t)((mlen/pbsize)-1);
    ZmacStruct Zmac;
    MacChains Chains;

    memcpy(Zmac.tweakey, key, KS);
    memset(Zmac.tweakey + KS, 0, TS);
    memset(Zmac.message, 0, BS);
    memset(Chains.u, 0, BS);
    memset(Chains.v, 0, TS);

#if BS == 16
        unsigned char prpol = 0b10000111;
#else
        unsigned char prpol = 0b00011011;
#endif

    Zmac.tweakey[KS+TS-1] = 0x09;
    forkskinny_128_256_encrypt(Zmac.tweakey, Zmac.mask_l, NULL, Zmac.message);

    Zmac.tweakey[KS+TS-2] = 0x01;
    forkskinny_128_256_encrypt(Zmac.tweakey, Zmac.mask_r, NULL, Zmac.message);

    send_USART_bytes(&pbsize,1,cc);
    for(uint16_t i = 0;i<nP_complete; ++i){
        recv_USART_bytes(Zmac.message, BS,cc);
        recv_USART_bytes(Zmac.tweakey + KS, TS-1,cc);
        ZHASH(&Zmac, &Chains, prpol);
        send_USART_bytes(0,1,cc);
    }
    ZMAC_padding(&Zmac, &fin, res, cc);

    ZHASH(&Zmac, &Chains, prpol);
    memcpy(Zmac.tweakey + KS, Chains.v, TS);
    memcpy(Zmac.message, Chains.u, BS);
    ZFIN(&Zmac, fin);
    send_USART_bytes(0,1,cc);

    memcpy(out_left, Zmac.out, BS);
    memcpy(out_right, Zmac.out +BS, BS);
}


/* ----------------------------- IV derivation for GCTR core ----------------------------- */

/* fenc() expects a preformatted 32-byte IV = U || V_rep.
 * In this adaptation, ZAFE exposes a 32-byte tag and uses it directly as IV.
 */
static void zafe_iv_from_tag(const uint8_t tag[ZAFE_TAG_LEN],
                             uint8_t iv[TWO_N])
{
    memcpy(iv, tag, TWO_N);
}

/* ----------------------------- zfmac wrapper (streaming) ----------------------------- */

static int zfmac(const unsigned char key[KEY_LEN],
                 const unsigned char *ad, size_t adlen,
                 const unsigned char *msg, size_t mlen,
                 unsigned char *tag, size_t taglen)
{
    unsigned char out_l[BS], out_r[BS];
    uint64_t cc = 0;

    if (taglen < TWO_N) return -1;

    ZMAC_encrypt(out_l, out_r, (unsigned char *)key, (uint32_t)mlen, &cc);

    memcpy(tag, out_l, BS);
    memcpy(tag + BS, out_r, BS);

    return 0;
}

/* ----------------------------- public API ----------------------------- */

int forkskinny_zafe_opt_auth(const zafe_key_t *ks,
                         const uint8_t *ad, size_t adlen,
                         const uint8_t *msg, size_t mlen,
                         uint8_t tag[ZAFE_TAG_LEN])
{
    return zfmac(ks->mac_key, ad, adlen, msg, mlen, tag, ZAFE_TAG_LEN);
}

int forkskinny_zafe_opt_verify(const zafe_key_t *ks,
                           const uint8_t *ad, size_t adlen,
                           const uint8_t *msg, size_t mlen,
                           const uint8_t tag[ZAFE_TAG_LEN])
{
    uint8_t computed[ZAFE_TAG_LEN];
    int rc;

    rc = zfmac(ks->mac_key, ad, adlen, msg, mlen, computed, ZAFE_TAG_LEN);
    if (rc != 0) {
        ct_memzero(computed, sizeof(computed));
        return -1;
    }

    rc = ct_memcmp_eq(computed, tag, ZAFE_TAG_LEN) ? 0 : -1;
    ct_memzero(computed, sizeof(computed));
    return rc;
}

void forkskinny_zafe_opt_encrypt(const zafe_key_t *ks,
                             const uint8_t tag[ZAFE_TAG_LEN],
                             const uint8_t *msg, size_t mlen,
                             uint8_t *ct)
{
    uint8_t iv[TWO_N];

    zafe_iv_from_tag(tag, iv);
    fenc(ks->enc_key, iv, msg, mlen, ct);
    ct_memzero(iv, sizeof(iv));
}

void forkskinny_zafe_opt_decrypt(const zafe_key_t *ks,
                             const uint8_t tag[ZAFE_TAG_LEN],
                             const uint8_t *ct, size_t clen,
                             uint8_t *msg)
{
    uint8_t iv[TWO_N];

    zafe_iv_from_tag(tag, iv);
    fenc(ks->enc_key, iv, ct, clen, msg);
    ct_memzero(iv, sizeof(iv));
}

int forkskinny_zafe_opt_encrypt_auth(const zafe_key_t *ks,
                                 const uint8_t *ad, size_t adlen,
                                 const uint8_t *msg, size_t mlen,
                                 uint8_t *ct,
                                 uint8_t tag[ZAFE_TAG_LEN])
{
    int rc;

    rc = forkskinny_zafe_opt_auth(ks, ad, adlen, msg, mlen, tag);
    if (rc != 0) {
        return -1;
    }

    forkskinny_zafe_opt_encrypt(ks, tag, msg, mlen, ct);
    return 0;
}

int forkskinny_zafe_opt_decrypt_verify(const zafe_key_t *ks,
                                   const uint8_t *ad, size_t adlen,
                                   const uint8_t *ct, size_t clen,
                                   const uint8_t tag[ZAFE_TAG_LEN],
                                   uint8_t *msg)
{
    int rc;

    forkskinny_zafe_opt_decrypt(ks, tag, ct, clen, msg);

    rc = forkskinny_zafe_opt_verify(ks, ad, adlen, msg, clen, tag);
    if (rc != 0) {
        ct_memzero(msg, clen);
        return -1;
    }

    return 0;
}
```

## src/forkskinny_zafe_opt.h
```c
#ifndef FORKSKINNY_ZAFE_OPT_H
#define FORKSKINNY_ZAFE_OPT_H

#include "forkskinny_zafe.h"

int forkskinny_zafe_opt_auth(const zafe_key_t *ks,
                             const uint8_t *ad, size_t adlen,
                             const uint8_t *msg, size_t mlen,
                             uint8_t tag[ZAFE_TAG_LEN]);

int forkskinny_zafe_opt_verify(const zafe_key_t *ks,
                               const uint8_t *ad, size_t adlen,
                               const uint8_t *msg, size_t mlen,
                               const uint8_t tag[ZAFE_TAG_LEN]);

void forkskinny_zafe_opt_encrypt(const zafe_key_t *ks,
                                 const uint8_t tag[ZAFE_TAG_LEN],
                                 const uint8_t *msg, size_t mlen,
                                 uint8_t *ct);

void forkskinny_zafe_opt_decrypt(const zafe_key_t *ks,
                                 const uint8_t tag[ZAFE_TAG_LEN],
                                 const uint8_t *ct, size_t clen,
                                 uint8_t *msg);

int forkskinny_zafe_opt_encrypt_auth(const zafe_key_t *ks,
                                     const uint8_t *ad, size_t adlen,
                                     const uint8_t *msg, size_t mlen,
                                     uint8_t *ct,
                                     uint8_t tag[ZAFE_TAG_LEN]);

int forkskinny_zafe_opt_decrypt_verify(const zafe_key_t *ks,
                                       const uint8_t *ad, size_t adlen,
                                       const uint8_t *ct, size_t clen,
                                       const uint8_t tag[ZAFE_TAG_LEN],
                                       uint8_t *msg);

#endif
```

## src/stm32f4_wrapper.c
```c
#include <stdint.h>
#include "stm32wrapper.h"

/* 24 MHz */
/* original clock as defined in the all the aes you need repo*/
const struct rcc_clock_scale benchmarkclock = {
  .pllm = 8, //VCOin = HSE / PLLM = 1 MHz
  .plln = 192, //VCOout = VCOin * PLLN = 192 MHz
  .pllp = 8, //PLLCLK = VCOout / PLLP = 24 MHz (low to have 0WS)
  .pllq = 4, //PLL48CLK = VCOout / PLLQ = 48 MHz (required for USB, RNG)
  .pllr = 0,
  .hpre = RCC_CFGR_HPRE_DIV_NONE,
  .ppre1 = RCC_CFGR_PPRE_DIV_2,
  .ppre2 = RCC_CFGR_PPRE_DIV_NONE,
  .pll_source = RCC_CFGR_PLLSRC_HSE_CLK,
  .voltage_scale = PWR_SCALE1,
  .flash_config = FLASH_ACR_DCEN | FLASH_ACR_ICEN | FLASH_ACR_LATENCY_0WS,
  .ahb_frequency = 24000000,
  .apb1_frequency = 12000000,
  .apb2_frequency = 24000000,
};


/* our own (external) clock configuration for the measurements */
const struct rcc_clock_scale externalclock = {
    //HSE = 8 MHz
    .pllm = 8, //VCOin = HSE / PLLM = 1 MHz
    .plln = 192, //VCOout = VCOin * PLLN = 192 MHz
    .pllp = 8, //PLLCLK = VCOout / PLLP = 24 MHz (low to have 0WS)
    .pllq = 8, //PLL48CLK = VCOout / PLLQ = 48 MHz (required for USB, RNG)
    .hpre = RCC_CFGR_HPRE_DIV_NONE,
    .ppre1 = RCC_CFGR_PPRE_DIV_2,
    .ppre2 = RCC_CFGR_PPRE_DIV_NONE,
    .flash_config = FLASH_ACR_LATENCY_0WS,
    .apb1_frequency = 12000000,
    .apb2_frequency = 24000000,
};

void clock_setup(void)
{
    rcc_clock_setup_pll(&benchmarkclock);
    rcc_periph_clock_enable(RCC_GPIOA);
    rcc_periph_clock_enable(RCC_USART2);
    rcc_periph_clock_enable(RCC_CCMDATARAM);
    rcc_periph_clock_enable(RCC_RNG);

    flash_prefetch_enable();
}

void gpio_setup(void)
{
    gpio_mode_setup(GPIOA, GPIO_MODE_AF, GPIO_PUPD_NONE, GPIO2 | GPIO3);
    gpio_set_af(GPIOA, GPIO_AF7, GPIO2 | GPIO3);

    gpio_mode_setup(GPIOA, GPIO_MODE_OUTPUT, GPIO_PUPD_NONE, GPIO15);
    gpio_set_output_options(GPIOA, GPIO_OTYPE_PP, GPIO_OSPEED_100MHZ, GPIO15);
}

void usart_setup(int baud)
{
    usart_set_baudrate(USART2, baud);
    usart_set_databits(USART2, 8);
    usart_set_stopbits(USART2, USART_STOPBITS_1);
    usart_set_mode(USART2, USART_MODE_TX_RX);
    usart_set_parity(USART2, USART_PARITY_NONE);
    usart_set_flow_control(USART2, USART_FLOWCONTROL_NONE);

    usart_enable(USART2);
}

void flash_setup(void)
{
    FLASH_ACR |= FLASH_ACR_ICEN;
    FLASH_ACR |= FLASH_ACR_DCEN;
    FLASH_ACR |= FLASH_ACR_PRFTEN;
}

void send_USART_str(const char* in)
{
    int i;
    for(i = 0; in[i] != 0; i++) {
        usart_send_blocking(USART2, (unsigned char)in[i]);
    }
    usart_send_blocking(USART2, '\r');
    usart_send_blocking(USART2, '\n');
}

void send_USART_bytes(const unsigned char* in, int n, uint64_t *cc)
{   
    *cc += DWT_CYCCNT;
    int i;
    for(i = 0; i < n; i++) {
        usart_send_blocking(USART2, in[i]);
    }
    DWT_CYCCNT = 0;
}

void recv_USART_bytes(unsigned char* in, int n, uint64_t *cc)
{   
    *cc += DWT_CYCCNT;
    int i;
    for(i = 0; i < n; i++) {
        in[i] = (uint8_t)usart_recv_blocking(USART2);
    }
    DWT_CYCCNT = 0;
}

void trigger_high()
{
  gpio_set(GPIOA, GPIO15);
}

void trigger_low()
{
  gpio_clear(GPIOA, GPIO15);
}
```

## src/stm32wrapper.h
```c
#ifndef STMWRAP_H
#define STMWRAP_H

#include <stdint.h>
#include <stdint.h>

/* When building under Zephyr (or other non-STM32 environments) avoid including
 * libopencm3 headers; provide minimal declarations so the wrapper can be
 * stubbed for testing/build. */
#ifdef __ZEPHYR__

/* Minimal DWT cycle counter symbol used by ZMAC timing code. */
extern volatile uint32_t DWT_CYCCNT;

void clock_setup(void);
void gpio_setup(void);
void usart_setup(int baud);
void send_USART_str(const char* in);
void send_USART_bytes(const unsigned char* in, int n, uint64_t *cc);
void recv_USART_bytes(unsigned char* in, int n, uint64_t *cc);
void flash_setup(void);
void trigger_high(void);
void trigger_low(void);

#else

#include <libopencm3/stm32/rcc.h>
#include <libopencm3/stm32/gpio.h>
#include <libopencm3/stm32/usart.h>
#include <libopencm3/cm3/scs.h>
#include <libopencm3/cm3/dwt.h>
#include <libopencm3/stm32/flash.h>

#ifdef STM32F4
#include <libopencm3/stm32/rng.h>
#endif

void clock_setup(void);
void gpio_setup(void);
void usart_setup(int baud);
void send_USART_str(const char* in);
void send_USART_bytes(const unsigned char* in, int n, uint64_t *cc);
void recv_USART_bytes(unsigned char* in, int n, uint64_t *cc);
void flash_setup(void);
void trigger_high(void);
void trigger_low(void);

#endif

void clock_setup(void);
void gpio_setup(void);
void usart_setup(int baud);
void send_USART_str(const char* in);
void send_USART_bytes(const unsigned char* in, int n, uint64_t *cc);
void recv_USART_bytes(unsigned char* in, int n, uint64_t *cc);
void flash_setup(void);
void trigger_high(void);
void trigger_low(void);

#endif
```

## src/stm32wrapper_zephyr.c
```c
#include <stdint.h>
#include <string.h>
#include "stm32wrapper.h"

/* Minimal Zephyr-compatible stubs for the STM32 wrapper functions so the
 * project can build under Zephyr. These are placeholders; at runtime you
 * should provide platform-appropriate implementations. */

volatile uint32_t DWT_CYCCNT = 0;

void clock_setup(void) { }
void gpio_setup(void) { }
void usart_setup(int baud) { (void)baud; }
void send_USART_str(const char* in) { (void)in; }

void send_USART_bytes(const unsigned char* in, int n, uint64_t *cc)
{
    (void)in; (void)n; if (cc) *cc += DWT_CYCCNT; DWT_CYCCNT = 0;
}

void recv_USART_bytes(unsigned char* in, int n, uint64_t *cc)
{
    (void)cc; /* produce zeroed output */
    if (in && n > 0) memset(in, 0, (size_t)n);
    DWT_CYCCNT = 0;
}

void flash_setup(void) { }
void trigger_high(void) { }
void trigger_low(void) { }
```
