## CMakeLists.txt
```
cmake_minimum_required(VERSION 3.20.0)
find_package(Zephyr REQUIRED HINTS $ENV{ZEPHYR_BASE})

project(aes-128)

target_sources(app PRIVATE
	src/main.c
	src/utils.c
	src/gf.c
	src/ghash.c
	src/aesgcm.c
	src/aes_sw.c
    src/bench.c
)

## Use default mbed TLS AES symbols (no MBEDTLS_AES_ALT)

# When TF-M is not built, the top-level build still expects a
# tfm_merged.hex. Create it by copying zephyr.hex so merge step succeeds.
if(NOT CONFIG_BUILD_WITH_TFM)
	set(_zephyr_hex ${CMAKE_BINARY_DIR}/zephyr/zephyr.hex)
	set(_tfm_merged ${CMAKE_BINARY_DIR}/zephyr/tfm_merged.hex)
	add_custom_command(
		OUTPUT ${_tfm_merged}
		COMMAND ${CMAKE_COMMAND} -E copy_if_different ${_zephyr_hex} ${_tfm_merged}
		DEPENDS ${_zephyr_hex}
		COMMENT "Creating tfm_merged.hex by copying zephyr.hex (no TF-M build)"
	)
	add_custom_target(tfm_merged_copy ALL DEPENDS ${_tfm_merged})
endif()
```

## prj.conf
```kconfig
# Enable timing helpers used by the benchmark
CONFIG_TIMING_FUNCTIONS=y

# Enable mbedTLS software AES via Oberon backend (no CC3xx — CC312 is secure-only on nRF5340)
CONFIG_NRF_SECURITY=y

CONFIG_MBEDTLS_LEGACY_CRYPTO_C=y
CONFIG_MBEDTLS_AES_C=y
CONFIG_BUILD_WITH_TFM=n

# Increase stack for benchmarking
CONFIG_MAIN_STACK_SIZE=8192

# RTT console
CONFIG_USE_SEGGER_RTT=y
CONFIG_RTT_CONSOLE=y
CONFIG_UART_CONSOLE=n
CONFIG_CONSOLE=y
```

## src/main.c
```c
#include <zephyr/kernel.h>
#include <zephyr/sys/printk.h>
#include <zephyr/timing/timing.h>
#include <psa/crypto.h>
#include <string.h>
#include "aesgcm.h"
#include "bench.h"

/* ── shared test vector ─────────────────────────────────── */
static const uint8_t TEST_KEY[16] = {
    0x00,0x01,0x02,0x03,0x04,0x05,0x06,0x07,
    0x08,0x09,0x0a,0x0b,0x0c,0x0d,0x0e,0x0f
};
static const uint8_t TEST_NONCE[12] = {
    0xa0,0xa1,0xa2,0xa3,0xa4,0xa5,0xa6,0xa7,0xa8,0xa9,0xaa,0xab
};
static const uint8_t TEST_PT[] = "Hello, AES-128-GCM!";
#define TEST_PT_LEN  (sizeof(TEST_PT) - 1)

static void print_hex(const char *label, const uint8_t *buf, size_t len)
{
    printk("  %-8s", label);
    for (size_t i = 0; i < len; i++) printk("%02x", buf[i]);
    printk("\n");
}

/* ── correctness ────────────────────────────────────────── */
static void correctness_our_impl(uint8_t *ct_out, uint8_t *tag_out)
{
    printk("[Our AES-128-GCM]\n");
    aes_gcm_encrypt(TEST_KEY, TEST_NONCE, NULL, 0,
                    TEST_PT, TEST_PT_LEN, ct_out, tag_out);
    print_hex("CT:", ct_out, TEST_PT_LEN);
    print_hex("TAG:", tag_out, 16);

    uint8_t dec[TEST_PT_LEN];
    int rc = aes_gcm_decrypt(TEST_KEY, TEST_NONCE, NULL, 0,
                              ct_out, TEST_PT_LEN, tag_out, dec);
    dec[TEST_PT_LEN] = '\0';
    printk("  DEC:    %s\n", dec);
    printk("  verify: %s\n\n", rc == 0 ? "OK" : "FAIL");
}

static void correctness_psa(uint8_t *ct_out, uint8_t *tag_out)
{
    printk("[PSA AES-128-GCM]\n");

    psa_key_id_t key;
    psa_key_attributes_t attr = PSA_KEY_ATTRIBUTES_INIT;
    psa_set_key_type(&attr, PSA_KEY_TYPE_AES);
    psa_set_key_bits(&attr, 128);
    psa_set_key_usage_flags(&attr, PSA_KEY_USAGE_ENCRYPT | PSA_KEY_USAGE_DECRYPT);
    psa_set_key_algorithm(&attr, PSA_ALG_GCM);

    psa_status_t st = psa_import_key(&attr, TEST_KEY, sizeof(TEST_KEY), &key);
    if (st != PSA_SUCCESS) { printk("  import_key failed: %d\n", (int)st); return; }

    /* PSA output = ciphertext || tag (16 bytes) */
    uint8_t output[TEST_PT_LEN + 16];
    size_t out_len;
    st = psa_aead_encrypt(key, PSA_ALG_GCM,
                           TEST_NONCE, sizeof(TEST_NONCE),
                           NULL, 0,
                           TEST_PT, TEST_PT_LEN,
                           output, sizeof(output), &out_len);
    if (st != PSA_SUCCESS) {
        printk("  encrypt failed: %d\n", (int)st);
        psa_destroy_key(key);
        return;
    }
    memcpy(ct_out,  output,             TEST_PT_LEN);
    memcpy(tag_out, output + TEST_PT_LEN, 16);
    print_hex("CT:", ct_out, TEST_PT_LEN);
    print_hex("TAG:", tag_out, 16);

    uint8_t dec[TEST_PT_LEN + 1];
    size_t dec_len;
    st = psa_aead_decrypt(key, PSA_ALG_GCM,
                           TEST_NONCE, sizeof(TEST_NONCE),
                           NULL, 0,
                           output, out_len,
                           dec, sizeof(dec), &dec_len);
    dec[TEST_PT_LEN] = '\0';
    printk("  DEC:    %s\n", dec);
    printk("  verify: %s\n\n", st == PSA_SUCCESS ? "OK" : "FAIL");

    psa_destroy_key(key);
}

int main(void)
{
    timing_init();
    timing_start();

    printk("\n=== AES-128 GCM Benchmark ===\n\n");

    psa_crypto_init();

    /* ── correctness: same input, compare outputs ── */
    printk("--- Correctness (same key/nonce/pt) ---\n");
    printk("  PT: \"%.*s\"\n\n", (int)TEST_PT_LEN, TEST_PT);

    uint8_t our_ct[TEST_PT_LEN], our_tag[16];
    uint8_t psa_ct[TEST_PT_LEN], psa_tag[16];

    correctness_our_impl(our_ct, our_tag);
    correctness_psa(psa_ct, psa_tag);

    printk("[CT match]  %s\n",
           memcmp(our_ct,  psa_ct,  TEST_PT_LEN) == 0 ? "OK" : "MISMATCH");
    printk("[TAG match] %s\n\n",
           memcmp(our_tag, psa_tag, 16) == 0 ? "OK" : "MISMATCH");

    /* ── timing ── */
    printk("--- Timing ---\n\n");
    bench_gcm_all();

    timing_stop();
    return 0;
}
```

## src/aes_sw.c
```c
/*
 * aes_sw.c  –  Standalone pure-C AES-128 ECB encrypt.
 *
 * Byte-oriented reference implementation following FIPS-197 directly.
 * No hardware, no Oberon, no mbedTLS – plain portable C only.
 *
 * State layout: s[row + 4*col], matching FIPS-197 column-major order.
 * Row 0 is the top row; Col 0 is the leftmost column.
 */

#include "aes_sw.h"
#include <string.h>
#include <stdint.h>

/* ── AES S-box (FIPS-197 Figure 7) ─────────────────────────────────────── */
static const uint8_t sbox[256] = {
    0x63,0x7c,0x77,0x7b,0xf2,0x6b,0x6f,0xc5,0x30,0x01,0x67,0x2b,0xfe,0xd7,0xab,0x76,
    0xca,0x82,0xc9,0x7d,0xfa,0x59,0x47,0xf0,0xad,0xd4,0xa2,0xaf,0x9c,0xa4,0x72,0xc0,
    0xb7,0xfd,0x93,0x26,0x36,0x3f,0xf7,0xcc,0x34,0xa5,0xe5,0xf1,0x71,0xd8,0x31,0x15,
    0x04,0xc7,0x23,0xc3,0x18,0x96,0x05,0x9a,0x07,0x12,0x80,0xe2,0xeb,0x27,0xb2,0x75,
    0x09,0x83,0x2c,0x1a,0x1b,0x6e,0x5a,0xa0,0x52,0x3b,0xd6,0xb3,0x29,0xe3,0x2f,0x84,
    0x53,0xd1,0x00,0xed,0x20,0xfc,0xb1,0x5b,0x6a,0xcb,0xbe,0x39,0x4a,0x4c,0x58,0xcf,
    0xd0,0xef,0xaa,0xfb,0x43,0x4d,0x33,0x85,0x45,0xf9,0x02,0x7f,0x50,0x3c,0x9f,0xa8,
    0x51,0xa3,0x40,0x8f,0x92,0x9d,0x38,0xf5,0xbc,0xb6,0xda,0x21,0x10,0xff,0xf3,0xd2,
    0xcd,0x0c,0x13,0xec,0x5f,0x97,0x44,0x17,0xc4,0xa7,0x7e,0x3d,0x64,0x5d,0x19,0x73,
    0x60,0x81,0x4f,0xdc,0x22,0x2a,0x90,0x88,0x46,0xee,0xb8,0x14,0xde,0x5e,0x0b,0xdb,
    0xe0,0x32,0x3a,0x0a,0x49,0x06,0x24,0x5c,0xc2,0xd3,0xac,0x62,0x91,0x95,0xe4,0x79,
    0xe7,0xc8,0x37,0x6d,0x8d,0xd5,0x4e,0xa9,0x6c,0x56,0xf4,0xea,0x65,0x7a,0xae,0x08,
    0xba,0x78,0x25,0x2e,0x1c,0xa6,0xb4,0xc6,0xe8,0xdd,0x74,0x1f,0x4b,0xbd,0x8b,0x8a,
    0x70,0x3e,0xb5,0x66,0x48,0x03,0xf6,0x0e,0x61,0x35,0x57,0xb9,0x86,0xc1,0x1d,0x9e,
    0xe1,0xf8,0x98,0x11,0x69,0xd9,0x8e,0x94,0x9b,0x1e,0x87,0xe9,0xce,0x55,0x28,0xdf,
    0x8c,0xa1,0x89,0x0d,0xbf,0xe6,0x42,0x68,0x41,0x99,0x2d,0x0f,0xb0,0x54,0xbb,0x16
};

/* Rcon[1..10] for AES-128 key schedule (index 0 unused) */
static const uint8_t rcon[11] = {
    0x00, 0x01, 0x02, 0x04, 0x08, 0x10, 0x20, 0x40, 0x80, 0x1b, 0x36
};

/* Multiply by 2 in GF(2^8), reduction polynomial 0x1b */
static inline uint8_t xtime(uint8_t x)
{
    return (uint8_t)((x << 1) ^ ((x & 0x80u) ? 0x1bu : 0x00u));
}

void aes_sw_encrypt_128(const uint8_t key[16], const uint8_t in[16], uint8_t out[16])
{
    /* Round keys: 11 × 16 bytes = 176 bytes */
    uint8_t rk[11 * 16];
    uint8_t s[16];
    uint8_t t;

    /* ── Key expansion (FIPS-197 §5.2, Nk=4, Nr=10) ── */
    memcpy(rk, key, 16);
    for (int i = 4; i < 44; i++) {
        uint8_t tmp[4];
        memcpy(tmp, &rk[(i - 1) * 4], 4);
        if (i % 4 == 0) {
            /* RotWord */
            t = tmp[0]; tmp[0] = tmp[1]; tmp[1] = tmp[2]; tmp[2] = tmp[3]; tmp[3] = t;
            /* SubWord */
            tmp[0] = sbox[tmp[0]]; tmp[1] = sbox[tmp[1]];
            tmp[2] = sbox[tmp[2]]; tmp[3] = sbox[tmp[3]];
            /* XOR Rcon */
            tmp[0] ^= rcon[i / 4];
        }
        rk[i * 4 + 0] = rk[(i - 4) * 4 + 0] ^ tmp[0];
        rk[i * 4 + 1] = rk[(i - 4) * 4 + 1] ^ tmp[1];
        rk[i * 4 + 2] = rk[(i - 4) * 4 + 2] ^ tmp[2];
        rk[i * 4 + 3] = rk[(i - 4) * 4 + 3] ^ tmp[3];
    }

    /* ── Load state (column-major: s[row + 4*col]) ── */
    memcpy(s, in, 16);

    /* ── Initial AddRoundKey ── */
    for (int i = 0; i < 16; i++) s[i] ^= rk[i];

    /* ── Rounds 1 .. Nr-1 (full rounds) ── */
    for (int round = 1; round <= 9; round++) {

        /* SubBytes */
        for (int i = 0; i < 16; i++) s[i] = sbox[s[i]];

        /* ShiftRows – row indices in column-major s[row + 4*col] */
        /* Row 1: cyclic left shift by 1 */
        t = s[1]; s[1] = s[5]; s[5] = s[9]; s[9] = s[13]; s[13] = t;
        /* Row 2: cyclic left shift by 2 */
        t = s[2]; s[2] = s[10]; s[10] = t;
        t = s[6]; s[6] = s[14]; s[14] = t;
        /* Row 3: cyclic left shift by 3 (= right shift by 1) */
        t = s[15]; s[15] = s[11]; s[11] = s[7]; s[7] = s[3]; s[3] = t;

        /* MixColumns – one column at a time */
        for (int c = 0; c < 4; c++) {
            uint8_t a0 = s[0 + c * 4];
            uint8_t a1 = s[1 + c * 4];
            uint8_t a2 = s[2 + c * 4];
            uint8_t a3 = s[3 + c * 4];
            s[0 + c * 4] = xtime(a0) ^ (xtime(a1) ^ a1) ^ a2 ^ a3;
            s[1 + c * 4] = a0 ^ xtime(a1) ^ (xtime(a2) ^ a2) ^ a3;
            s[2 + c * 4] = a0 ^ a1 ^ xtime(a2) ^ (xtime(a3) ^ a3);
            s[3 + c * 4] = (xtime(a0) ^ a0) ^ a1 ^ a2 ^ xtime(a3);
        }

        /* AddRoundKey */
        for (int i = 0; i < 16; i++) s[i] ^= rk[round * 16 + i];
    }

    /* ── Final round (no MixColumns) ── */
    for (int i = 0; i < 16; i++) s[i] = sbox[s[i]];
    /* ShiftRows */
    t = s[1]; s[1] = s[5]; s[5] = s[9]; s[9] = s[13]; s[13] = t;
    t = s[2]; s[2] = s[10]; s[10] = t;
    t = s[6]; s[6] = s[14]; s[14] = t;
    t = s[15]; s[15] = s[11]; s[11] = s[7]; s[7] = s[3]; s[3] = t;
    /* AddRoundKey */
    for (int i = 0; i < 16; i++) s[i] ^= rk[10 * 16 + i];

    memcpy(out, s, 16);
}
```

## src/aes_sw.h
```c
#ifndef AES_SW_H
#define AES_SW_H

#include <stdint.h>

/* Standalone pure-C AES-128 ECB block encrypt (no hardware, no Oberon). */
void aes_sw_encrypt_128(const uint8_t key[16], const uint8_t in[16], uint8_t out[16]);

#endif /* AES_SW_H */
```

## src/aesgcm.c
```c
#include "aesgcm.h"
#include "ghash.h"
#include <mbedtls/aes.h>
#include <string.h>

uint32_t g_aes_enc_calls = 0;
void aes_counters_reset(void) { g_aes_enc_calls = 0; }

static void inc_be32(uint8_t ctr[16]) { for (int i = 15; i >= 12; i--) if (++ctr[i]) break; }

static int ct_memcmp(const uint8_t *a, const uint8_t *b, size_t n)
{
    uint8_t diff = 0;
    for (size_t i = 0; i < n; i++) diff |= (uint8_t)(a[i] ^ b[i]);
    return diff;
}

/* Encrypt one block using a pre-expanded context */
static void aes_block(mbedtls_aes_context *ctx, const uint8_t in[16], uint8_t out[16])
{
    ++g_aes_enc_calls;
    mbedtls_aes_crypt_ecb(ctx, MBEDTLS_AES_ENCRYPT, in, out);
}

/* Public single-block helper (kept for API compat / bench counter probing) */
void aes_encrypt_block(const uint8_t key[16], const uint8_t in[16], uint8_t out[16])
{
    ++g_aes_enc_calls;
    mbedtls_aes_context ctx;
    mbedtls_aes_init(&ctx);
    mbedtls_aes_setkey_enc(&ctx, key, 128);
    mbedtls_aes_crypt_ecb(&ctx, MBEDTLS_AES_ENCRYPT, in, out);
    mbedtls_aes_free(&ctx);
}

/* CTR encrypt — key expanded once */
void aes_ctr_encrypt(const uint8_t key[16], const uint8_t nonce[12],
                     const uint8_t *pt, size_t len, uint8_t *ct)
{
    mbedtls_aes_context ctx;
    mbedtls_aes_init(&ctx);
    mbedtls_aes_setkey_enc(&ctx, key, 128);

    uint8_t counter[16] = {0};
    memcpy(counter, nonce, 12);
    counter[15] = 1;
    inc_be32(counter);

    size_t off = 0; uint8_t stream[16];
    while (off < len) {
        aes_block(&ctx, counter, stream);
        size_t chunk = (len - off) < 16 ? (len - off) : 16;
        for (size_t i = 0; i < chunk; i++) ct[off + i] = pt[off + i] ^ stream[i];
        off += chunk; inc_be32(counter);
    }
    mbedtls_aes_free(&ctx);
}

/* Full GCM encrypt — key expanded once for all AES calls */
void aes_gcm_encrypt(const uint8_t key[16], const uint8_t nonce[12],
                     const uint8_t *aad, size_t aad_len,
                     const uint8_t *pt, size_t len,
                     uint8_t *ct, uint8_t tag[16])
{
    mbedtls_aes_context ctx;
    mbedtls_aes_init(&ctx);
    mbedtls_aes_setkey_enc(&ctx, key, 128);

    uint8_t zero[16] = {0}, H[16], J0[16] = {0}, S[16], GH[16];

    aes_block(&ctx, zero, H);

    memcpy(J0, nonce, 12);
    J0[15] = 1;

    /* CTR encrypt */
    uint8_t counter[16];
    memcpy(counter, J0, 16);
    inc_be32(counter);
    size_t off = 0; uint8_t stream[16];
    while (off < len) {
        aes_block(&ctx, counter, stream);
        size_t chunk = (len - off) < 16 ? (len - off) : 16;
        for (size_t i = 0; i < chunk; i++) ct[off + i] = pt[off + i] ^ stream[i];
        off += chunk; inc_be32(counter);
    }

    ghash(H, aad, aad_len, ct, len, GH);
    aes_block(&ctx, J0, S);
    for (int i = 0; i < 16; i++) tag[i] = (uint8_t)(S[i] ^ GH[i]);

    mbedtls_aes_free(&ctx);
}

/* Full GCM decrypt — key expanded once */
int aes_gcm_decrypt(const uint8_t key[16], const uint8_t nonce[12],
                    const uint8_t *aad, size_t aad_len,
                    const uint8_t *ct, size_t len,
                    const uint8_t tag[16], uint8_t *pt)
{
    mbedtls_aes_context ctx;
    mbedtls_aes_init(&ctx);
    mbedtls_aes_setkey_enc(&ctx, key, 128);

    uint8_t zero[16] = {0}, H[16], J0[16] = {0}, S[16], GH[16], expected[16];

    aes_block(&ctx, zero, H);

    memcpy(J0, nonce, 12);
    J0[15] = 1;

    ghash(H, aad, aad_len, ct, len, GH);
    aes_block(&ctx, J0, S);
    for (int i = 0; i < 16; i++) expected[i] = (uint8_t)(S[i] ^ GH[i]);

    if (ct_memcmp(expected, tag, 16) != 0) {
        mbedtls_aes_free(&ctx);
        return -1;
    }

    uint8_t counter[16];
    memcpy(counter, J0, 16);
    inc_be32(counter);
    size_t off = 0; uint8_t stream[16];
    while (off < len) {
        aes_block(&ctx, counter, stream);
        size_t chunk = (len - off) < 16 ? (len - off) : 16;
        for (size_t i = 0; i < chunk; i++) pt[off + i] = ct[off + i] ^ stream[i];
        off += chunk; inc_be32(counter);
    }

    mbedtls_aes_free(&ctx);
    return 0;
}

static void gcm_derive_j0(const uint8_t H[16], const uint8_t *iv, size_t iv_len, uint8_t J0[16])
{
    if (iv_len == 12) {
        memset(J0, 0, 16);
        memcpy(J0, iv, 12);
        J0[15] = 1;
    } else {
        ghash(H, NULL, 0, iv, iv_len, J0);
    }
}

void aes_128_gcm_encrypt(const uint8_t key[16], const uint8_t nonce[12],
                         const uint8_t *pt, size_t len, uint8_t *ct)
{
    aes_ctr_encrypt(key, nonce, pt, len, ct);
}

void aes_128_gcm_decrypt(const uint8_t key[16], const uint8_t nonce[12],
                         const uint8_t *ct, size_t len, uint8_t *pt)
{
    aes_ctr_encrypt(key, nonce, ct, len, pt);
}

void aes_128_gcm_auth(const uint8_t key[16],
                      const uint8_t *iv, size_t iv_len,
                      const uint8_t *aad, size_t aad_len,
                      const uint8_t *ct, size_t len,
                      uint8_t tag[16])
{
    mbedtls_aes_context ctx;
    mbedtls_aes_init(&ctx);
    mbedtls_aes_setkey_enc(&ctx, key, 128);

    uint8_t zero[16] = {0}, H[16], J0[16], S[16], GH[16];
    aes_block(&ctx, zero, H);
    gcm_derive_j0(H, iv, iv_len, J0);
    ghash(H, aad, aad_len, ct, len, GH);
    aes_block(&ctx, J0, S);
    for (int i = 0; i < 16; i++) tag[i] = (uint8_t)(S[i] ^ GH[i]);

    mbedtls_aes_free(&ctx);
}

int aes_128_gcm_verify(const uint8_t key[16],
                       const uint8_t *iv, size_t iv_len,
                       const uint8_t *aad, size_t aad_len,
                       const uint8_t *ct, size_t len,
                       const uint8_t tag[16])
{
    mbedtls_aes_context ctx;
    mbedtls_aes_init(&ctx);
    mbedtls_aes_setkey_enc(&ctx, key, 128);

    uint8_t zero[16] = {0}, H[16], J0[16], S[16], GH[16], expected[16];
    aes_block(&ctx, zero, H);
    gcm_derive_j0(H, iv, iv_len, J0);
    ghash(H, aad, aad_len, ct, len, GH);
    aes_block(&ctx, J0, S);
    for (int i = 0; i < 16; i++) expected[i] = (uint8_t)(S[i] ^ GH[i]);

    mbedtls_aes_free(&ctx);
    return ct_memcmp(expected, tag, 16) == 0 ? 0 : -1;
}

void aes_128_gcm_encrypt_auth(const uint8_t key[16],
                               const uint8_t *iv, size_t iv_len,
                               const uint8_t *aad, size_t aad_len,
                               const uint8_t *pt, size_t len,
                               uint8_t *ct, uint8_t tag[16])
{
    mbedtls_aes_context ctx;
    mbedtls_aes_init(&ctx);
    mbedtls_aes_setkey_enc(&ctx, key, 128);

    uint8_t zero[16] = {0}, H[16], J0[16], S[16], GH[16];
    aes_block(&ctx, zero, H);
    gcm_derive_j0(H, iv, iv_len, J0);

    uint8_t ctr[16];
    memcpy(ctr, J0, 16);
    size_t off = 0; uint8_t stream[16];
    while (off < len) {
        inc_be32(ctr);
        aes_block(&ctx, ctr, stream);
        size_t chunk = (len - off) < 16 ? (len - off) : 16;
        for (size_t i = 0; i < chunk; ++i) ct[off + i] = pt[off + i] ^ stream[i];
        off += chunk;
    }

    ghash(H, aad, aad_len, ct, len, GH);
    aes_block(&ctx, J0, S);
    for (int i = 0; i < 16; i++) tag[i] = (uint8_t)(S[i] ^ GH[i]);

    mbedtls_aes_free(&ctx);
}

int aes_128_gcm_decrypt_verify(const uint8_t key[16],
                                const uint8_t *iv, size_t iv_len,
                                const uint8_t *aad, size_t aad_len,
                                const uint8_t *ct, size_t len,
                                const uint8_t tag[16], uint8_t *pt)
{
    mbedtls_aes_context ctx;
    mbedtls_aes_init(&ctx);
    mbedtls_aes_setkey_enc(&ctx, key, 128);

    uint8_t zero[16] = {0}, H[16], J0[16], S[16], GH[16], expected[16];
    aes_block(&ctx, zero, H);
    gcm_derive_j0(H, iv, iv_len, J0);
    ghash(H, aad, aad_len, ct, len, GH);
    aes_block(&ctx, J0, S);
    for (int i = 0; i < 16; i++) expected[i] = (uint8_t)(S[i] ^ GH[i]);

    if (ct_memcmp(expected, tag, 16) != 0) {
        mbedtls_aes_free(&ctx);
        return -1;
    }

    uint8_t ctr[16];
    memcpy(ctr, J0, 16);
    size_t off = 0; uint8_t stream[16];
    while (off < len) {
        inc_be32(ctr);
        aes_block(&ctx, ctr, stream);
        size_t chunk = (len - off) < 16 ? (len - off) : 16;
        for (size_t i = 0; i < chunk; ++i) pt[off + i] = ct[off + i] ^ stream[i];
        off += chunk;
    }

    mbedtls_aes_free(&ctx);
    return 0;
}
```

## src/aesgcm.h
```c
#ifndef AESCTR_H
#define AESCTR_H
#include <stdint.h>
#include <stddef.h>

extern uint32_t g_aes_enc_calls;
void aes_counters_reset(void);

void aes_encrypt_block(const uint8_t key[16], const uint8_t in[16], uint8_t out[16]);
void aes_ctr_encrypt(const uint8_t key[16], const uint8_t nonce[12], const uint8_t *pt, size_t len, uint8_t *ct);

void aes_gcm_encrypt(const uint8_t key[16], const uint8_t nonce[12],
					   const uint8_t *aad, size_t aad_len,
					   const uint8_t *pt, size_t len,
					   uint8_t *ct, uint8_t tag[16]);

int aes_gcm_decrypt(const uint8_t key[16], const uint8_t nonce[12],
					  const uint8_t *aad, size_t aad_len,
					  const uint8_t *ct, size_t len,
					  const uint8_t tag[16], uint8_t *pt);

/* Public AES-128 GCM API (wrappers) */
void aes_128_gcm_encrypt(const uint8_t key[16], const uint8_t nonce[12],
						 const uint8_t *pt, size_t len, uint8_t *ct);

void aes_128_gcm_decrypt(const uint8_t key[16], const uint8_t nonce[12],
						 const uint8_t *ct, size_t len, uint8_t *pt);

void aes_128_gcm_auth(const uint8_t key[16],
					  const uint8_t *iv, size_t iv_len,
					  const uint8_t *aad, size_t aad_len,
					  const uint8_t *ct, size_t len,
					  uint8_t tag[16]);

int aes_128_gcm_verify(const uint8_t key[16],
					   const uint8_t *iv, size_t iv_len,
					   const uint8_t *aad, size_t aad_len,
					   const uint8_t *ct, size_t len,
					   const uint8_t tag[16]);

void aes_128_gcm_encrypt_auth(const uint8_t key[16],
							 const uint8_t *iv, size_t iv_len,
							 const uint8_t *aad, size_t aad_len,
							 const uint8_t *pt, size_t len,
							 uint8_t *ct, uint8_t tag[16]);

int aes_128_gcm_decrypt_verify(const uint8_t key[16],
							  const uint8_t *iv, size_t iv_len,
							  const uint8_t *aad, size_t aad_len,
							  const uint8_t *ct, size_t len,
							  const uint8_t tag[16], uint8_t *pt);
#endif
```

## src/bench.c
```c
#include <zephyr/kernel.h>
#include <zephyr/sys/printk.h>
#include <zephyr/timing/timing.h>
#include <string.h>
#include <stdint.h>
#include <psa/crypto.h>
#include "aesgcm.h"
#include "bench.h"
#include "ghash.h"
#include "gf.h"

/* ── configuration ──────────────────────────────────────── */
#define WARMUP_ITERS   10
#define BENCH_ITERS   100
#define MESSAGE_LEN   100
#define AD_LEN         0

/* work buffers */
static uint8_t pt_buf[MESSAGE_LEN];
static uint8_t ct_buf[MESSAGE_LEN];
static uint8_t dec_buf[MESSAGE_LEN];
#if 1
static uint8_t tag_buf[16];
#else
static uint8_t tag_buf[OCB_TAG_LEN];
#endif
#if AD_LEN > 0
static uint8_t ad_buf[AD_LEN];
#else
static uint8_t *ad_buf = NULL;
#endif
/* no ocb key structure for GCM; use raw key */
static const uint8_t bench_key[16] = {
    0x00,0x01,0x02,0x03,0x04,0x05,0x06,0x07,
    0x08,0x09,0x0a,0x0b,0x0c,0x0d,0x0e,0x0f
};
static const uint8_t bench_nonce[12] = {
    0xa0,0xa1,0xa2,0xa3,0xa4,0xa5,0xa6,0xa7,
    0xa8,0xa9,0xaa,0xab
};

static void fill_pattern(uint8_t *buf, size_t len)
{
    for (size_t i = 0; i < len; i++) buf[i] = (uint8_t)(i & 0xff);
}

static void print_hex(const char *label, const uint8_t *buf, size_t len)
{
    printk("%s", label);
    for (size_t i = 0; i < len; i++) printk("%02x", buf[i]);
    printk("\n");
}

/* ── correctness check ─────────────────────────────────── */
void verify_correctness(void)
{
    printk("--- AES-128 GCM Correctness (msg=%d ad=%d) ---\n",
           MESSAGE_LEN, AD_LEN);

    fill_pattern(pt_buf, MESSAGE_LEN);
#if AD_LEN > 0
    fill_pattern(ad_buf, AD_LEN);
#endif

    /* produce ciphertext + tag using GCM API (combined) */
    aes_128_gcm_encrypt_auth(bench_key, bench_nonce, 12,
                       ad_buf, AD_LEN,
                       pt_buf, MESSAGE_LEN,
                       ct_buf, tag_buf);

    print_hex("PT[0..15]: ", pt_buf, 16);
    print_hex("CT[0..15]: ", ct_buf, 16);
    print_hex("TAG:       ", tag_buf, 16);

    int rc = aes_128_gcm_decrypt_verify(bench_key, bench_nonce, 12,
                                ad_buf, AD_LEN,
                                ct_buf, MESSAGE_LEN,
                                tag_buf, dec_buf);

    print_hex("DEC[0..15]:", dec_buf, 16);
    printk("Decrypt+Verify: %s\n", rc == 0 ? "OK" : "FAIL");

    if (memcmp(pt_buf, dec_buf, MESSAGE_LEN) == 0)
        printk("Plaintext match: OK\n");
    else
        printk("Plaintext match: FAIL\n");

    printk("--- End correctness ---\n\n");
}

/* ── individual benchmarks ─────────────────────────────── */

/* keygen benchmark removed */

static void bench_hash(void)
{
    timing_t start, end;
    uint64_t total_c = 0, total_ns = 0;

    fill_pattern(pt_buf, MESSAGE_LEN);
#if AD_LEN > 0
    fill_pattern(ad_buf, AD_LEN);
#endif

    /* probe: one un-timed call to count primitive invocations */
    aes_counters_reset();
    aes_128_gcm_auth(bench_key, bench_nonce, 12, ad_buf, AD_LEN, ct_buf, MESSAGE_LEN, tag_buf);
    uint32_t enc_per_op = g_aes_enc_calls;

    /* measure auth (tag-only) */
    for (int i = 0; i < WARMUP_ITERS; i++)
        aes_128_gcm_auth(bench_key, bench_nonce, 12, ad_buf, AD_LEN, ct_buf, MESSAGE_LEN, tag_buf);

    for (int i = 0; i < BENCH_ITERS; i++) {
        start = timing_counter_get();
        aes_128_gcm_auth(bench_key, bench_nonce, 12, ad_buf, AD_LEN, ct_buf, MESSAGE_LEN, tag_buf);
        end = timing_counter_get();
        uint64_t c = timing_cycles_get(&start, &end);
        total_c  += c;
        total_ns += timing_cycles_to_ns(c);
    }
    printk("  %-14s: %10llu cycles  |  %10llu ns\n", "hash (tag)",
           (unsigned long long)(total_c / BENCH_ITERS),
           (unsigned long long)(total_ns / BENCH_ITERS));
}

static void bench_encrypt(void)
{
    timing_t start, end;
    uint64_t total_c = 0, total_ns = 0;

    fill_pattern(pt_buf, MESSAGE_LEN);
    /* probe: one un-timed call to count primitive invocations */
    aes_counters_reset();
    aes_128_gcm_encrypt(bench_key, bench_nonce, pt_buf, MESSAGE_LEN, ct_buf);
    uint32_t enc_per_op = g_aes_enc_calls;

    /* CTR-mode encryption (no tag) */
    for (int i = 0; i < WARMUP_ITERS; i++)
        aes_128_gcm_encrypt(bench_key, bench_nonce, pt_buf, MESSAGE_LEN, ct_buf);

    for (int i = 0; i < BENCH_ITERS; i++) {
        start = timing_counter_get();
        aes_128_gcm_encrypt(bench_key, bench_nonce, pt_buf, MESSAGE_LEN, ct_buf);
        end = timing_counter_get();
        uint64_t c = timing_cycles_get(&start, &end);
        total_c  += c;
        total_ns += timing_cycles_to_ns(c);
    }
    printk("  %-14s: %10llu cycles  |  %10llu ns\n", "encrypt",
           (unsigned long long)(total_c / BENCH_ITERS),
           (unsigned long long)(total_ns / BENCH_ITERS));
}

static void bench_decrypt(void)
{
    timing_t start, end;
    uint64_t total_c = 0, total_ns = 0;

    fill_pattern(pt_buf, MESSAGE_LEN);
    /* produce ciphertext */
    aes_128_gcm_encrypt(bench_key, bench_nonce, pt_buf, MESSAGE_LEN, ct_buf);

    /* probe: one un-timed call to count primitive invocations */
    aes_counters_reset();
    aes_128_gcm_decrypt(bench_key, bench_nonce, ct_buf, MESSAGE_LEN, dec_buf);
    uint32_t enc_per_op = g_aes_enc_calls;

    for (int i = 0; i < WARMUP_ITERS; i++)
        aes_128_gcm_decrypt(bench_key, bench_nonce, ct_buf, MESSAGE_LEN, dec_buf);

    for (int i = 0; i < BENCH_ITERS; i++) {
        start = timing_counter_get();
        aes_128_gcm_decrypt(bench_key, bench_nonce, ct_buf, MESSAGE_LEN, dec_buf);
        end = timing_counter_get();
        uint64_t c = timing_cycles_get(&start, &end);
        total_c  += c;
        total_ns += timing_cycles_to_ns(c);
    }
    printk("  %-14s: %10llu cycles  |  %10llu ns\n", "decrypt",
           (unsigned long long)(total_c / BENCH_ITERS),
           (unsigned long long)(total_ns / BENCH_ITERS));
}

static void bench_verify(void)
{
    timing_t start, end;
    uint64_t total_c = 0, total_ns = 0;

    fill_pattern(pt_buf, MESSAGE_LEN);
    /* produce valid ciphertext + tag first (combined API) */
    aes_128_gcm_encrypt_auth(bench_key, bench_nonce, 12,
                       ad_buf, AD_LEN,
                       pt_buf, MESSAGE_LEN,
                       ct_buf, tag_buf);

    /* probe: one un-timed call to count primitive invocations */
    aes_counters_reset();
    (void)aes_128_gcm_verify(bench_key, bench_nonce, 12, ad_buf, AD_LEN, ct_buf, MESSAGE_LEN, tag_buf);
    uint32_t enc_per_op = g_aes_enc_calls;

    for (int i = 0; i < WARMUP_ITERS; i++)
        (void)aes_128_gcm_verify(bench_key, bench_nonce, 12, ad_buf, AD_LEN, ct_buf, MESSAGE_LEN, tag_buf);

    for (int i = 0; i < BENCH_ITERS; i++) {
        start = timing_counter_get();
        (void)aes_128_gcm_verify(bench_key, bench_nonce, 12, ad_buf, AD_LEN, ct_buf, MESSAGE_LEN, tag_buf);
        end = timing_counter_get();
        uint64_t c = timing_cycles_get(&start, &end);
        total_c  += c;
        total_ns += timing_cycles_to_ns(c);
    }
    printk("  %-14s: %10llu cycles  |  %10llu ns\n", "verify",
           (unsigned long long)(total_c / BENCH_ITERS),
           (unsigned long long)(total_ns / BENCH_ITERS));
}

/* ── PSA Crypto library benchmarks ─────────────────────────── */

static psa_key_id_t s_lib_key;

static bool lib_key_init(void)
{
    psa_key_attributes_t attr = PSA_KEY_ATTRIBUTES_INIT;
    psa_set_key_type(&attr, PSA_KEY_TYPE_AES);
    psa_set_key_bits(&attr, 128);
    psa_set_key_usage_flags(&attr, PSA_KEY_USAGE_ENCRYPT | PSA_KEY_USAGE_DECRYPT);
    psa_set_key_algorithm(&attr, PSA_ALG_GCM);
    psa_status_t st = psa_import_key(&attr, bench_key, 16, &s_lib_key);
    if (st != PSA_SUCCESS) {
        printk("  lib: psa_import_key failed (%d)\n", (int)st);
        return false;
    }
    return true;
}

/* one-shot: psa_aead_encrypt (CTR encrypt + GHASH + tag) */
static void bench_lib_combined(void)
{
    timing_t start, end;
    uint64_t total_c = 0, total_ns = 0;
    static uint8_t output[MESSAGE_LEN + 16];
    size_t output_len;

    fill_pattern(pt_buf, MESSAGE_LEN);

    for (int i = 0; i < WARMUP_ITERS; i++)
        psa_aead_encrypt(s_lib_key, PSA_ALG_GCM, bench_nonce, 12,
                          ad_buf, AD_LEN, pt_buf, MESSAGE_LEN,
                          output, sizeof(output), &output_len);

    for (int i = 0; i < BENCH_ITERS; i++) {
        start = timing_counter_get();
        psa_aead_encrypt(s_lib_key, PSA_ALG_GCM, bench_nonce, 12,
                          ad_buf, AD_LEN, pt_buf, MESSAGE_LEN,
                          output, sizeof(output), &output_len);
        end = timing_counter_get();
        uint64_t c = timing_cycles_get(&start, &end);
        total_c  += c;
        total_ns += timing_cycles_to_ns(c);
    }
    printk("  %-14s: %10llu cycles  |  %10llu ns\n", "lib combined",
           (unsigned long long)(total_c / BENCH_ITERS),
           (unsigned long long)(total_ns / BENCH_ITERS));
}

/* one-shot decrypt to pair with encrypt */
static void bench_lib_decrypt(void)
{
    timing_t start, end;
    uint64_t total_c = 0, total_ns = 0;
    static uint8_t enc_output[MESSAGE_LEN + 16];
    static uint8_t dec_output[MESSAGE_LEN];
    size_t out_len;

    fill_pattern(pt_buf, MESSAGE_LEN);
    /* produce valid ciphertext+tag first */
    size_t enc_len;
    psa_aead_encrypt(s_lib_key, PSA_ALG_GCM, bench_nonce, 12,
                      ad_buf, AD_LEN, pt_buf, MESSAGE_LEN,
                      enc_output, sizeof(enc_output), &enc_len);

    for (int i = 0; i < WARMUP_ITERS; i++)
        psa_aead_decrypt(s_lib_key, PSA_ALG_GCM, bench_nonce, 12,
                          ad_buf, AD_LEN, enc_output, enc_len,
                          dec_output, sizeof(dec_output), &out_len);

    for (int i = 0; i < BENCH_ITERS; i++) {
        start = timing_counter_get();
        psa_aead_decrypt(s_lib_key, PSA_ALG_GCM, bench_nonce, 12,
                          ad_buf, AD_LEN, enc_output, enc_len,
                          dec_output, sizeof(dec_output), &out_len);
        end = timing_counter_get();
        uint64_t c = timing_cycles_get(&start, &end);
        total_c  += c;
        total_ns += timing_cycles_to_ns(c);
    }
    printk("  %-14s: %10llu cycles  |  %10llu ns\n", "lib decrypt",
           (unsigned long long)(total_c / BENCH_ITERS),
           (unsigned long long)(total_ns / BENCH_ITERS));
}

/* ── top-level entry ───────────────────────────────────── */
void bench_gcm_all(void)
{
    printk("[AES-128 GCM] Benchmark  msg=%d ad=%d iters=%d\n",
           MESSAGE_LEN, AD_LEN, BENCH_ITERS);
    printk("  sizes:  key=%d  nonce=%d  tag=%d  pt=%d  ct=%d  ad=%d  (bytes)\n",
           (int)sizeof(bench_key), (int)sizeof(bench_nonce), 16,
           MESSAGE_LEN, MESSAGE_LEN, AD_LEN);
    printk("  %-14s  %10s  %12s\n", "operation", "cycles", "ns");

    printk("\n[Our implementation]\n");
    bench_hash();
    bench_encrypt();
    bench_decrypt();
    bench_verify();

    printk("\n[PSA Crypto library (AES-128-GCM)]\n");
    if (lib_key_init()) {
        bench_lib_combined();
        bench_lib_decrypt();
        psa_destroy_key(s_lib_key);
    }

    printk("\n--- Benchmark complete ---\n\n");
}
```

## src/ghash.c
```c
#include "ghash.h"
#include "gf.h"
#include "utils.h"
#include <string.h>

/* GHASH(H, A, C) -> out
   Processes AAD (A) and ciphertext (C) and returns 16-byte tag accumulator S.
   Uses gf_mul(X, H, product) where product = X * H in GF(2^128).
*/
void ghash(const uint8_t H[16], const uint8_t *aad, size_t aad_len,
                  const uint8_t *ct, size_t ct_len, uint8_t out[16])
{
        uint8_t Y[16] = {0};
        uint8_t block[16];

        // proccess 16-byte blocks of aad
        size_t off = 0;
        while (off + 16 <= aad_len) {
                memcpy(block, aad + off, 16);
                xor_block(Y, block);
                uint8_t tmp[16];
                gf_mul(Y, H, tmp); 
                memcpy(Y, tmp, 16);
                off += 16;
        }
        // last part of aad block (zero-padded)
        if (off < aad_len) {
                size_t rem = aad_len - off;
                memset(block, 0, 16);
                memcpy(block, aad + off, rem);
                xor_block(Y, block);
                uint8_t tmp[16];
                gf_mul(Y, H, tmp);
                memcpy(Y, tmp, 16);
        }

        // process cipher blocks
        off = 0;
        while (off + 16 <= ct_len){
                memcpy(block, ct + off, 16);
                xor_block(Y, block);
                uint8_t tmp[16];
                gf_mul(Y, H, tmp);
                memcpy(Y, tmp, 16);
                off += 16;
        }
        if (off < ct_len) {
                size_t rem = ct_len - off;
                memset(block, 0, 16);
                memcpy(block, ct + off, rem);
                xor_block(Y, block);
                uint8_t tmp[16];
                gf_mul(Y, H, tmp);
                memcpy(Y, tmp, 16);
        }

        //64 bit of aad and 64 bit of ct
        uint64_t aad_bits = (uint64_t)aad_len * 8;
        uint64_t ct_bits = (uint64_t)ct_len * 8;
        uint8_t lenblk[16];
        store_64(lenblk, aad_bits);
        store_64(lenblk + 8, ct_bits);
        xor_block(Y, lenblk);
        uint8_t tmp[16];
        gf_mul(Y, H, tmp);
        memcpy(Y, tmp, 16);

        memcpy(out, Y, 16);
}
```

## src/main_scratch.c
```c
#include <zephyr/kernel.h>
#include <zephyr/sys/printk.h>
#include <zephyr/timing/timing.h>
#include "bench.h"

int main(void)
{
    timing_init();
    timing_start();

    printk("\n=== AES-128 GCM AEAD Benchmark ===\n\n");

    verify_correctness();
    bench_gcm_all();

    timing_stop();

    return 0;
}
```
