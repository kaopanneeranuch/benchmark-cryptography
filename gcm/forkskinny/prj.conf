## CMakeLists.txt
```
cmake_minimum_required(VERSION 3.20.0)
find_package(Zephyr REQUIRED HINTS $ENV{ZEPHYR_BASE})

project(forkskinny)

target_include_directories(app PRIVATE ../../forkskinny-opt32 ../../)

target_sources(app PRIVATE
	src/main.c
	src/forkskinny_gcm.c
	src/ghash.c
	src/gf.c
	src/utils.c
	src/bench.c
	../../forkskinny-opt32/internal-forkskinny.c
)
```

## prj.conf
```kconfig
# Timing
CONFIG_TIMING_FUNCTIONS=y

# UART console
CONFIG_UART_CONSOLE=y
CONFIG_CONSOLE=y

# Increase stack size for benchmarking
CONFIG_MAIN_STACK_SIZE=8192
```

## src/main.c
```c
#include <zephyr/kernel.h>
#include <zephyr/sys/printk.h>
#include <zephyr/timing/timing.h>
#include "bench.h"

void main(void)
{
    timing_init();
    timing_start();

    printk("\n=== ForkSkinny-GCM AEAD Benchmark ===\n\n");

    bench_gcm_all();

    timing_stop();
}
```

## src/bench.c
```c
#include <zephyr/kernel.h>
#include <zephyr/sys/printk.h>
#include <zephyr/timing/timing.h>
#include <string.h>
#include <stdint.h>
#include "forkskinny_gcm.h"
#include "bench.h"
#include "ghash.h"
#include "gf.h"
#include "internal-forkskinny.h"

#define WARMUP_ITERS   10
#define BENCH_ITERS   100
#define MESSAGE_LEN   100
#define AD_LEN         0

static uint8_t pt_buf[MESSAGE_LEN];
static uint8_t ct_buf[MESSAGE_LEN];
static uint8_t dec_buf[MESSAGE_LEN];
#if 1
static uint8_t tag_buf[16];
#else
static uint8_t tag_buf[OCB_TAG_LEN];
#endif
#if AD_LEN > 0
static uint8_t ad_buf[AD_LEN];
#else
static uint8_t *ad_buf = NULL;
#endif

static const uint8_t bench_key[16] = {
    0x00,0x01,0x02,0x03,0x04,0x05,0x06,0x07,
    0x08,0x09,0x0a,0x0b,0x0c,0x0d,0x0e,0x0f
};
static const uint8_t bench_nonce[12] = {
    0xa0,0xa1,0xa2,0xa3,0xa4,0xa5,0xa6,0xa7,
    0xa8,0xa9,0xaa,0xab
};

static void fill_pattern(uint8_t *buf, size_t len)
{
    for (size_t i = 0; i < len; i++) buf[i] = (uint8_t)(i & 0xff);
}

static void print_hex(const char *label, const uint8_t *buf, size_t len)
{
    printk("%s", label);
    for (size_t i = 0; i < len; i++) printk("%02x", buf[i]);
    printk("\n");
}

void verify_correctness(void)
{
    printk("--- FORKSKINNY GCM Correctness (msg=%d ad=%d) ---\n",
           MESSAGE_LEN, AD_LEN);

    fill_pattern(pt_buf, MESSAGE_LEN);
#if AD_LEN > 0
    fill_pattern(ad_buf, AD_LEN);
#endif

    forkskinny_gcm_encrypt_auth(bench_key, bench_nonce, 12,
                           ad_buf, AD_LEN,
                           pt_buf, MESSAGE_LEN,
                           ct_buf, tag_buf);

    print_hex("PT[0..15]: ", pt_buf, 16);
    print_hex("CT[0..15]: ", ct_buf, 16);
    print_hex("TAG:       ", tag_buf, 16);

    int rc = forkskinny_gcm_decrypt_verify(bench_key, bench_nonce, 12,
                                    ad_buf, AD_LEN,
                                    ct_buf, MESSAGE_LEN,
                                    tag_buf, dec_buf);

    print_hex("DEC[0..15]:", dec_buf, 16);
    printk("Decrypt+Verify: %s\n", rc == 0 ? "OK" : "FAIL");

    if (memcmp(pt_buf, dec_buf, MESSAGE_LEN) == 0)
        printk("Plaintext match: OK\n");
    else
        printk("Plaintext match: FAIL\n");

    printk("--- End correctness ---\n\n");
}

static void bench_hash(void)
{
    timing_t start, end;
    uint64_t total_c = 0, total_ns = 0;

    fill_pattern(pt_buf, MESSAGE_LEN);
#if AD_LEN > 0
    fill_pattern(ad_buf, AD_LEN);
#endif

    forkskinny_counters_reset();
    forkskinny_gcm_auth(bench_key, bench_nonce, 12, ad_buf, AD_LEN, ct_buf, MESSAGE_LEN, tag_buf);
    uint32_t enc_per_op = g_fs128_256_enc_calls;
    uint32_t dec_per_op = g_fs128_256_dec_calls;

    for (int i = 0; i < WARMUP_ITERS; i++)
        forkskinny_gcm_auth(bench_key, bench_nonce, 12, ad_buf, AD_LEN, ct_buf, MESSAGE_LEN, tag_buf);

    for (int i = 0; i < BENCH_ITERS; i++) {
        start = timing_counter_get();
        forkskinny_gcm_auth(bench_key, bench_nonce, 12, ad_buf, AD_LEN, ct_buf, MESSAGE_LEN, tag_buf);
        end = timing_counter_get();
        uint64_t c = timing_cycles_get(&start, &end);
        total_c  += c;
        total_ns += timing_cycles_to_ns(c);
    }
    printk("  %-14s: %10llu cycles  |  %10llu ns\n", "hash (tag)",
           (unsigned long long)(total_c / BENCH_ITERS),
           (unsigned long long)(total_ns / BENCH_ITERS));
    printk("    [prim/op] FS-128-256: enc=%lu dec=%lu\n",
           (unsigned long)enc_per_op, (unsigned long)dec_per_op);
}

static void bench_encrypt(void)
{
    timing_t start, end;
    uint64_t total_c = 0, total_ns = 0;

    fill_pattern(pt_buf, MESSAGE_LEN);
    forkskinny_counters_reset();
    forkskinny_gcm_encrypt(bench_key, bench_nonce, pt_buf, MESSAGE_LEN, ct_buf);
    uint32_t enc_per_op = g_fs128_256_enc_calls;
    uint32_t dec_per_op = g_fs128_256_dec_calls;

    for (int i = 0; i < WARMUP_ITERS; i++)
        forkskinny_gcm_encrypt(bench_key, bench_nonce, pt_buf, MESSAGE_LEN, ct_buf);

    for (int i = 0; i < BENCH_ITERS; i++) {
        start = timing_counter_get();
        forkskinny_gcm_encrypt(bench_key, bench_nonce, pt_buf, MESSAGE_LEN, ct_buf);
        end = timing_counter_get();
        uint64_t c = timing_cycles_get(&start, &end);
        total_c  += c;
        total_ns += timing_cycles_to_ns(c);
    }
    printk("  %-14s: %10llu cycles  |  %10llu ns\n", "encrypt",
           (unsigned long long)(total_c / BENCH_ITERS),
           (unsigned long long)(total_ns / BENCH_ITERS));
    printk("    [prim/op] FS-128-256: enc=%lu dec=%lu\n",
           (unsigned long)enc_per_op, (unsigned long)dec_per_op);
}

static void bench_decrypt(void)
{
    timing_t start, end;
    uint64_t total_c = 0, total_ns = 0;

    fill_pattern(pt_buf, MESSAGE_LEN);
    forkskinny_gcm_encrypt(bench_key, bench_nonce, pt_buf, MESSAGE_LEN, ct_buf);

    forkskinny_counters_reset();
    forkskinny_gcm_decrypt(bench_key, bench_nonce, ct_buf, MESSAGE_LEN, dec_buf);
    uint32_t enc_per_op = g_fs128_256_enc_calls;
    uint32_t dec_per_op = g_fs128_256_dec_calls;

    for (int i = 0; i < WARMUP_ITERS; i++)
        forkskinny_gcm_decrypt(bench_key, bench_nonce, ct_buf, MESSAGE_LEN, dec_buf);

    for (int i = 0; i < BENCH_ITERS; i++) {
        start = timing_counter_get();
        forkskinny_gcm_decrypt(bench_key, bench_nonce, ct_buf, MESSAGE_LEN, dec_buf);
        end = timing_counter_get();
        uint64_t c = timing_cycles_get(&start, &end);
        total_c  += c;
        total_ns += timing_cycles_to_ns(c);
    }
    printk("  %-14s: %10llu cycles  |  %10llu ns\n", "decrypt",
           (unsigned long long)(total_c / BENCH_ITERS),
           (unsigned long long)(total_ns / BENCH_ITERS));
    printk("    [prim/op] FS-128-256: enc=%lu dec=%lu\n",
           (unsigned long)enc_per_op, (unsigned long)dec_per_op);
}

static void bench_verify(void)
{
    timing_t start, end;
    uint64_t total_c = 0, total_ns = 0;

    fill_pattern(pt_buf, MESSAGE_LEN);
    forkskinny_gcm_encrypt_auth(bench_key, bench_nonce, 12,
                           ad_buf, AD_LEN,
                           pt_buf, MESSAGE_LEN,
                           ct_buf, tag_buf);

    forkskinny_counters_reset();
    (void)forkskinny_gcm_verify(bench_key, bench_nonce, 12, ad_buf, AD_LEN, ct_buf, MESSAGE_LEN, tag_buf);
    uint32_t enc_per_op = g_fs128_256_enc_calls;
    uint32_t dec_per_op = g_fs128_256_dec_calls;

    for (int i = 0; i < WARMUP_ITERS; i++)
        (void)forkskinny_gcm_verify(bench_key, bench_nonce, 12, ad_buf, AD_LEN, ct_buf, MESSAGE_LEN, tag_buf);

    for (int i = 0; i < BENCH_ITERS; i++) {
        start = timing_counter_get();
        (void)forkskinny_gcm_verify(bench_key, bench_nonce, 12, ad_buf, AD_LEN, ct_buf, MESSAGE_LEN, tag_buf);
        end = timing_counter_get();
        uint64_t c = timing_cycles_get(&start, &end);
        total_c  += c;
        total_ns += timing_cycles_to_ns(c);
    }
    printk("  %-14s: %10llu cycles  |  %10llu ns\n", "verify",
           (unsigned long long)(total_c / BENCH_ITERS),
           (unsigned long long)(total_ns / BENCH_ITERS));
    printk("    [prim/op] FS-128-256: enc=%lu dec=%lu\n",
           (unsigned long)enc_per_op, (unsigned long)dec_per_op);
}

void bench_gcm_all(void)
{
    printk("[FORKSKINNY GCM] Benchmark  msg=%d ad=%d iters=%d\n",
           MESSAGE_LEN, AD_LEN, BENCH_ITERS);
    printk("  sizes:  key=%d  nonce=%d  tag=%d  pt=%d  ct=%d  ad=%d  (bytes)\n",
           (int)sizeof(bench_key), (int)sizeof(bench_nonce), 16,
           MESSAGE_LEN, MESSAGE_LEN, AD_LEN);
    printk("  %-14s  %10s  %12s\n", "operation", "cycles", "ns");

    verify_correctness();

    bench_hash();
    bench_encrypt();
    bench_decrypt();
    bench_verify();

    printk("--- Benchmark complete ---\n\n");
}
```

## src/forkskinny_gcm.c
```c
#include "forkskinny_gcm.h"
#include "ghash.h"
#include "internal-forkskinny.h"
#include <string.h>

static void inc_be32(uint8_t ctr[16]) { for (int i = 15; i >= 12; i--) if (++ctr[i]) break; }

static int ct_memcmp(const uint8_t *a, const uint8_t *b, size_t n)
{
    uint8_t diff = 0;
    for (size_t i = 0; i < n; i++) {
        diff |= (uint8_t)(a[i] ^ b[i]);
    }
    return diff;
}

static void build_tweakey(uint8_t tk[32], const uint8_t key[16])
{
    memset(tk, 0, 16);
    memcpy(tk + 16, key, 16);
}

static void gcm_derive_j0(const uint8_t H[16], const uint8_t *iv, size_t iv_len, uint8_t J0[16])
{
    if (iv_len == 12) {
        memset(J0, 0, 16);
        memcpy(J0, iv, 12);
        J0[15] = 1;
    } else {
        ghash(H, NULL, 0, iv, iv_len, J0);
    }
}

/*
 * Encrypt a single 16-byte block with ForkSkinny-128-256.
 * Uses both forks combined as F_k(X) = LEFT(X) XOR RIGHT(X).
 */
void forkskinny_encrypt_block(const uint8_t key[16],
                              const uint8_t in[16], uint8_t out[16])
{
    uint8_t tk[32];
    build_tweakey(tk, key);
    uint8_t c0[16], c1[16];
    forkskinny_128_256_encrypt(tk, c0, c1, in);
    for (int i = 0; i < 16; ++i)
        out[i] = c0[i] ^ c1[i];
}


void forkskinny_ctr_encrypt(const uint8_t key[16], const uint8_t nonce[12],
                            const uint8_t *pt, size_t len, uint8_t *ct)
{
    uint8_t tk[32];
    build_tweakey(tk, key);

    uint8_t ctr[16];
    memset(ctr, 0, 16);
    memcpy(ctr, nonce, 12);
    ctr[15] = 1;

    uint8_t keystream[16];
    uint8_t c0[16], c1[16];
    size_t off = 0;
    while (off < len) {
        inc_be32(ctr);
        forkskinny_128_256_encrypt(tk, c0, c1, ctr);
        for (int i = 0; i < 16; ++i)
            keystream[i] = c0[i] ^ c1[i];
        size_t chunk = (len - off) < 16 ? (len - off) : 16;
        for (size_t i = 0; i < chunk; ++i)
            ct[off + i] = pt[off + i] ^ keystream[i];
        off += chunk;
    }
}

void forkskinny_gcm_encrypt_auth(const uint8_t key[16],
                            const uint8_t *iv, size_t iv_len,
                            const uint8_t *aad, size_t aad_len,
                            const uint8_t *pt, size_t len,
                            uint8_t *ct, uint8_t tag[16])
{
    uint8_t tk[32];
    build_tweakey(tk, key);

    uint8_t zero[16] = {0};
    uint8_t H[16];
    uint8_t h0[16], h1[16];
    forkskinny_128_256_encrypt(tk, h0, h1, zero);
    for (int i = 0; i < 16; ++i) H[i] = h0[i] ^ h1[i];

    uint8_t J0[16];
    gcm_derive_j0(H, iv, iv_len, J0);

    uint8_t ctr[16];
    memcpy(ctr, J0, 16);
    size_t off = 0;
    uint8_t keystream[16];
    uint8_t c0[16], c1[16];
    while (off < len) {
        inc_be32(ctr);
        forkskinny_128_256_encrypt(tk, c0, c1, ctr);
        for (int i = 0; i < 16; ++i)
            keystream[i] = c0[i] ^ c1[i];
        size_t chunk = (len - off) < 16 ? (len - off) : 16;
        for (size_t i = 0; i < chunk; ++i)
            ct[off + i] = pt[off + i] ^ keystream[i];
        off += chunk;
    }

    uint8_t S[16];
    ghash(H, aad, aad_len, ct, len, S);

    uint8_t EkJ0[16];
    uint8_t e0[16], e1[16];
    forkskinny_128_256_encrypt(tk, e0, e1, J0);
    for (int i = 0; i < 16; ++i) {
        EkJ0[i] = e0[i] ^ e1[i];
        tag[i] = EkJ0[i] ^ S[i];
    }
}

int forkskinny_gcm_decrypt_verify(const uint8_t key[16],
                           const uint8_t *iv, size_t iv_len,
                           const uint8_t *aad, size_t aad_len,
                           const uint8_t *ct, size_t len,
                           const uint8_t tag[16], uint8_t *pt)
{
    uint8_t tk[32];
    build_tweakey(tk, key);

    uint8_t zero[16] = {0};
    uint8_t H[16];
    uint8_t h0[16], h1[16];
    forkskinny_128_256_encrypt(tk, h0, h1, zero);
    for (int i = 0; i < 16; ++i) H[i] = h0[i] ^ h1[i];

    uint8_t J0[16];
    gcm_derive_j0(H, iv, iv_len, J0);

    uint8_t S[16];
    ghash(H, aad, aad_len, ct, len, S);

    uint8_t EkJ0[16];
    uint8_t e0[16], e1[16];
    forkskinny_128_256_encrypt(tk, e0, e1, J0);
    uint8_t expected[16];
    for (int i = 0; i < 16; ++i) expected[i] = (e0[i] ^ e1[i]) ^ S[i];

    if (ct_memcmp(expected, tag, 16) != 0)
        return -1;

    uint8_t ctr[16];
    memcpy(ctr, J0, 16);
    size_t off = 0;
    uint8_t keystream[16];
    uint8_t c0[16], c1[16];
    while (off < len) {
        inc_be32(ctr);
        forkskinny_128_256_encrypt(tk, c0, c1, ctr);
        for (int i = 0; i < 16; ++i)
            keystream[i] = c0[i] ^ c1[i];
        size_t chunk = (len - off) < 16 ? (len - off) : 16;
        for (size_t i = 0; i < chunk; ++i)
            pt[off + i] = ct[off + i] ^ keystream[i];
        off += chunk;
    }

    return 0;
}

void forkskinny_gcm_encrypt(const uint8_t key[16], const uint8_t nonce[12],
                           const uint8_t *pt, size_t len, uint8_t *ct)
{
    forkskinny_ctr_encrypt(key, nonce, pt, len, ct);
}

void forkskinny_gcm_decrypt(const uint8_t key[16], const uint8_t nonce[12],
                           const uint8_t *ct, size_t len, uint8_t *pt)
{
    forkskinny_ctr_encrypt(key, nonce, ct, len, pt);
}

void forkskinny_gcm_auth(const uint8_t key[16],
                        const uint8_t *iv, size_t iv_len,
                        const uint8_t *aad, size_t aad_len,
                        const uint8_t *ct, size_t len,
                        uint8_t tag[16])
{
    uint8_t tk[32];
    build_tweakey(tk, key);
    uint8_t zero[16] = {0};
    uint8_t H[16];
    uint8_t h0[16], h1[16];
    forkskinny_128_256_encrypt(tk, h0, h1, zero);
    for (int i = 0; i < 16; ++i) H[i] = h0[i] ^ h1[i];

    uint8_t J0[16];
    gcm_derive_j0(H, iv, iv_len, J0);

    uint8_t S[16];
    ghash(H, aad, aad_len, ct, len, S);

    uint8_t EkJ0[16];
    uint8_t e0[16], e1[16];
    forkskinny_128_256_encrypt(tk, e0, e1, J0);
    for (int i = 0; i < 16; ++i) tag[i] = (e0[i] ^ e1[i]) ^ S[i];
}

int forkskinny_gcm_verify(const uint8_t key[16],
                        const uint8_t *iv, size_t iv_len,
                        const uint8_t *aad, size_t aad_len,
                        const uint8_t *ct, size_t len,
                        const uint8_t tag[16])
{
    uint8_t tk[32];
    build_tweakey(tk, key);
    uint8_t zero[16] = {0};
    uint8_t H[16];
    uint8_t h0[16], h1[16];
    forkskinny_128_256_encrypt(tk, h0, h1, zero);
    for (int i = 0; i < 16; ++i) H[i] = h0[i] ^ h1[i];

    uint8_t J0[16];
    gcm_derive_j0(H, iv, iv_len, J0);

    uint8_t S[16];
    ghash(H, aad, aad_len, ct, len, S);

    uint8_t EkJ0[16];
    uint8_t e0[16], e1[16];
    forkskinny_128_256_encrypt(tk, e0, e1, J0);
    uint8_t expected[16];
    for (int i = 0; i < 16; ++i) expected[i] = (e0[i] ^ e1[i]) ^ S[i];

    return ct_memcmp(expected, tag, 16) == 0 ? 0 : -1;
}

void forkskinny_gcm_compute_H(const uint8_t key[16], uint8_t H[16])
{
    uint8_t tk[32];
    build_tweakey(tk, key);
    uint8_t zero[16] = {0};
    uint8_t h0[16], h1[16];
    forkskinny_128_256_encrypt(tk, h0, h1, zero);
    for (int i = 0; i < 16; ++i) H[i] = h0[i] ^ h1[i];
}

void forkskinny_gcm_compute_EkJ0(const uint8_t key[16], const uint8_t nonce[12], uint8_t EkJ0[16])
{
    uint8_t tk[32];
    build_tweakey(tk, key);
    uint8_t J0[16];
    memset(J0, 0, 16);
    memcpy(J0, nonce, 12);
    J0[15] = 1;
    uint8_t e0[16], e1[16];
    forkskinny_128_256_encrypt(tk, e0, e1, J0);
    for (int i = 0; i < 16; ++i) EkJ0[i] = e0[i] ^ e1[i];
}
```

## src/forkskinny_gcm.h
```c
#ifndef FORKSKINNY_H
#define FORKSKINNY_H
#include <stdint.h>
#include <stddef.h>

void forkskinny_gcm_encrypt(const uint8_t key[16], const uint8_t nonce[12],
						   const uint8_t *pt, size_t len, uint8_t *ct);

void forkskinny_gcm_decrypt(const uint8_t key[16], const uint8_t nonce[12],
						   const uint8_t *ct, size_t len, uint8_t *pt);

void forkskinny_gcm_auth(const uint8_t key[16],
						const uint8_t *iv, size_t iv_len,
						const uint8_t *aad, size_t aad_len,
						const uint8_t *ct, size_t len,
						uint8_t tag[16]);

int forkskinny_gcm_verify(const uint8_t key[16],
						 const uint8_t *iv, size_t iv_len,
						 const uint8_t *aad, size_t aad_len,
						 const uint8_t *ct, size_t len,
						 const uint8_t tag[16]);

void forkskinny_gcm_encrypt_auth(const uint8_t key[16],
								const uint8_t *iv, size_t iv_len,
								const uint8_t *aad, size_t aad_len,
								const uint8_t *pt, size_t len,
								uint8_t *ct, uint8_t tag[16]);

int forkskinny_gcm_decrypt_verify(const uint8_t key[16],
								 const uint8_t *iv, size_t iv_len,
								 const uint8_t *aad, size_t aad_len,
								 const uint8_t *ct, size_t len,
								 const uint8_t tag[16], uint8_t *pt);

#endif
```

## src/gf.h
```c
#ifndef GF_H
#define GF_H
#include <stdint.h>
void gf_mul(const uint8_t X[16], const uint8_t Y[16], uint8_t out[16]);
#endif
```
