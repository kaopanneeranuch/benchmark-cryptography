## CMakeLists.txt
```
cmake_minimum_required(VERSION 3.20.0)
find_package(Zephyr REQUIRED HINTS $ENV{ZEPHYR_BASE})

project(aes)

target_sources(app PRIVATE
	src/main.c
	src/aes_gcm.c
	src/rijndael_256_gcm.c
	${CMAKE_CURRENT_LIST_DIR}/../../block/src/rijndael256.c
	src/bench.c
)

target_include_directories(app PRIVATE
	${CMAKE_CURRENT_LIST_DIR}/../../block/src
)
```

## prj.conf
```kconfig
# Enable timing helpers used by the benchmark
CONFIG_TIMING_FUNCTIONS=y

# Enable mbedTLS software AES
CONFIG_NRF_SECURITY=y
CONFIG_MBEDTLS_LEGACY_CRYPTO_C=y

CONFIG_MBEDTLS_AES_C=y
CONFIG_PSA_WANT_ALG_GCM=y
CONFIG_PSA_WANT_ALG_ECB_NO_PADDING=y
CONFIG_PSA_WANT_KEY_TYPE_AES=y

# Heap for PSA volatile key storage (mbedTLS internal heap)
CONFIG_MBEDTLS_ENABLE_HEAP=y
CONFIG_MBEDTLS_HEAP_SIZE=4096

# Increase stack for benchmarking
CONFIG_MAIN_STACK_SIZE=32768

# UART console
CONFIG_UART_CONSOLE=y
CONFIG_CONSOLE=y
```

## src/main.c
```c
#include <psa/crypto.h>
#include <zephyr/kernel.h>
#include <zephyr/sys/printk.h>
#include <zephyr/timing/timing.h>

#include "bench.h"

int main(void)
{
    timing_init();
    timing_start();
    psa_crypto_init();

    printk("\n=== AES-GCM & Rijndael-256-GCM Benchmark (3-cipher version) ===\n\n");
    printk("  AES-128-GCM (128-bit block, 128-bit key)\n");
    printk("  AES-256-GCM (128-bit block, 256-bit key)\n");
    printk("  Rijndael-256-GCM (256-bit block, 256-bit key)\n\n");

    verify_correctness();
    bench_gcm_all();

    timing_stop();
    return 0;
}
```

## src/aes-128_gcm.c
```c
#include "aes-256_gcm.h"

#include <mbedtls/aes.h>
#include <string.h>

uint32_t g_aes128_block_calls = 0;
uint32_t g_aes256_block_calls = 0;

void aes_gcm_counters_reset(void)
{
    g_aes128_block_calls = 0;
    g_aes256_block_calls = 0;
}

uint32_t aes_128_gcm_get_block_calls(void)
{
    return g_aes128_block_calls;
}

uint32_t aes_256_gcm_get_block_calls(void)
{
    return g_aes256_block_calls;
}

static void inc_be32(uint8_t ctr[16])
{
    for (int i = 15; i >= 12; --i) {
        if (++ctr[i] != 0) {
            break;
        }
    }
}

static int ct_memcmp_eq(const uint8_t *a, const uint8_t *b, size_t n)
{
    uint8_t diff = 0;

    for (size_t i = 0; i < n; ++i) {
        diff |= (uint8_t)(a[i] ^ b[i]);
    }

    return diff == 0;
}

static void xor_block(uint8_t out[16], const uint8_t in[16])
{
    for (int i = 0; i < 16; ++i) {
        out[i] ^= in[i];
    }
}

static uint64_t load64_be(const uint8_t *in)
{
    return ((uint64_t)in[0] << 56) |
           ((uint64_t)in[1] << 48) |
           ((uint64_t)in[2] << 40) |
           ((uint64_t)in[3] << 32) |
           ((uint64_t)in[4] << 24) |
           ((uint64_t)in[5] << 16) |
           ((uint64_t)in[6] << 8)  |
           ((uint64_t)in[7]);
}

static void store64_be(uint8_t *out, uint64_t v)
{
    out[0] = (uint8_t)(v >> 56);
    out[1] = (uint8_t)(v >> 48);
    out[2] = (uint8_t)(v >> 40);
    out[3] = (uint8_t)(v >> 32);
    out[4] = (uint8_t)(v >> 24);
    out[5] = (uint8_t)(v >> 16);
    out[6] = (uint8_t)(v >> 8);
    out[7] = (uint8_t)(v);
}

static void gf_mul_128(const uint8_t X[16], const uint8_t Y[16], uint8_t out[16])
{
    uint64_t Xh = load64_be(X);
    uint64_t Xl = load64_be(X + 8);
    uint64_t Vh = load64_be(Y);
    uint64_t Vl = load64_be(Y + 8);
    uint64_t Zh = 0;
    uint64_t Zl = 0;

    for (int i = 0; i < 128; ++i) {
        int bit;

        if (i < 64) {
            bit = (int)((Xh >> (63 - i)) & 1U);
        } else {
            bit = (int)((Xl >> (63 - (i - 64))) & 1U);
        }

        if (bit) {
            Zh ^= Vh;
            Zl ^= Vl;
        }

        {
            int lsb = (int)(Vl & 1U);
            uint64_t new_vl = (Vl >> 1) | ((Vh & 1U) << 63);
            uint64_t new_vh = (Vh >> 1);

            Vh = new_vh;
            Vl = new_vl;

            if (lsb) {
                Vh ^= 0xE100000000000000ULL;
            }
        }
    }

    store64_be(out, Zh);
    store64_be(out + 8, Zl);
}

static void ghash(const uint8_t H[16],
                  const uint8_t *aad, size_t aad_len,
                  const uint8_t *ct, size_t ct_len,
                  uint8_t out[16])
{
    uint8_t Y[16] = {0};
    uint8_t block[16];
    uint8_t tmp[16];
    size_t off = 0;

    while (off + 16 <= aad_len) {
        memcpy(block, aad + off, 16);
        xor_block(Y, block);
        gf_mul_128(Y, H, tmp);
        memcpy(Y, tmp, 16);
        off += 16;
    }

    if (off < aad_len) {
        size_t rem = aad_len - off;
        memset(block, 0, sizeof(block));
        memcpy(block, aad + off, rem);
        xor_block(Y, block);
        gf_mul_128(Y, H, tmp);
        memcpy(Y, tmp, 16);
    }

    off = 0;
    while (off + 16 <= ct_len) {
        memcpy(block, ct + off, 16);
        xor_block(Y, block);
        gf_mul_128(Y, H, tmp);
        memcpy(Y, tmp, 16);
        off += 16;
    }

    if (off < ct_len) {
        size_t rem = ct_len - off;
        memset(block, 0, sizeof(block));
        memcpy(block, ct + off, rem);
        xor_block(Y, block);
        gf_mul_128(Y, H, tmp);
        memcpy(Y, tmp, 16);
    }

    {
        uint8_t len_block[16];
        uint64_t aad_bits = (uint64_t)aad_len * 8U;
        uint64_t ct_bits = (uint64_t)ct_len * 8U;

        store64_be(len_block, aad_bits);
        store64_be(len_block + 8, ct_bits);
        xor_block(Y, len_block);
        gf_mul_128(Y, H, tmp);
        memcpy(Y, tmp, 16);
    }

    memcpy(out, Y, 16);
}

static void aes_block(mbedtls_aes_context *ctx,
                      unsigned int key_bits,
                      const uint8_t in[16],
                      uint8_t out[16])
{
    if (key_bits == 128U) {
        ++g_aes128_block_calls;
    } else {
        ++g_aes256_block_calls;
    }

    mbedtls_aes_crypt_ecb(ctx, MBEDTLS_AES_ENCRYPT, in, out);
}

static void derive_j0(mbedtls_aes_context *ctx,
                      unsigned int key_bits,
                      const uint8_t *iv, size_t iv_len,
                      const uint8_t H[16],
                      uint8_t J0[16])
{
    (void)ctx;
    (void)key_bits;

    if (iv_len == AES_GCM_NONCE_LEN) {
        memset(J0, 0, 16);
        memcpy(J0, iv, AES_GCM_NONCE_LEN);
        J0[15] = 1;
        return;
    }

    ghash(H, NULL, 0, iv, iv_len, J0);
}

static void ctr_crypt(mbedtls_aes_context *ctx,
                      unsigned int key_bits,
                      const uint8_t J0[16],
                      const uint8_t *in, size_t len,
                      uint8_t *out)
{
    uint8_t ctr[16];
    uint8_t stream[16];
    size_t off = 0;

    memcpy(ctr, J0, 16);

    while (off < len) {
        size_t chunk;

        inc_be32(ctr);
        aes_block(ctx, key_bits, ctr, stream);

        chunk = (len - off < 16U) ? (len - off) : 16U;
        for (size_t i = 0; i < chunk; ++i) {
            out[off + i] = (uint8_t)(in[off + i] ^ stream[i]);
        }
        off += chunk;
    }
}

static void gcm_auth_only(const uint8_t *key, unsigned int key_bits,
                          const uint8_t *iv, size_t iv_len,
                          const uint8_t *aad, size_t aad_len,
                          const uint8_t *ct, size_t ct_len,
                          uint8_t tag[16])
{
    mbedtls_aes_context ctx;
    uint8_t zero[16] = {0};
    uint8_t H[16];
    uint8_t J0[16];
    uint8_t S[16];
    uint8_t GH[16];

    mbedtls_aes_init(&ctx);
    mbedtls_aes_setkey_enc(&ctx, key, key_bits);

    aes_block(&ctx, key_bits, zero, H);
    derive_j0(&ctx, key_bits, iv, iv_len, H, J0);
    ghash(H, aad, aad_len, ct, ct_len, GH);
    aes_block(&ctx, key_bits, J0, S);

    for (int i = 0; i < 16; ++i) {
        tag[i] = (uint8_t)(S[i] ^ GH[i]);
    }

    mbedtls_aes_free(&ctx);
}

static int gcm_verify_only(const uint8_t *key, unsigned int key_bits,
                           const uint8_t *iv, size_t iv_len,
                           const uint8_t *aad, size_t aad_len,
                           const uint8_t *ct, size_t ct_len,
                           const uint8_t tag[16])
{
    uint8_t expected[16];

    gcm_auth_only(key, key_bits, iv, iv_len, aad, aad_len, ct, ct_len, expected);
    return ct_memcmp_eq(expected, tag, 16) ? 0 : -1;
}

static void gcm_encrypt_auth(const uint8_t *key, unsigned int key_bits,
                             const uint8_t *iv, size_t iv_len,
                             const uint8_t *aad, size_t aad_len,
                             const uint8_t *pt, size_t pt_len,
                             uint8_t *ct,
                             uint8_t tag[16])
{
    mbedtls_aes_context ctx;
    uint8_t zero[16] = {0};
    uint8_t H[16];
    uint8_t J0[16];
    uint8_t S[16];
    uint8_t GH[16];

    mbedtls_aes_init(&ctx);
    mbedtls_aes_setkey_enc(&ctx, key, key_bits);

    aes_block(&ctx, key_bits, zero, H);
    derive_j0(&ctx, key_bits, iv, iv_len, H, J0);
    ctr_crypt(&ctx, key_bits, J0, pt, pt_len, ct);
    ghash(H, aad, aad_len, ct, pt_len, GH);
    aes_block(&ctx, key_bits, J0, S);

    for (int i = 0; i < 16; ++i) {
        tag[i] = (uint8_t)(S[i] ^ GH[i]);
    }

    mbedtls_aes_free(&ctx);
}

static int gcm_decrypt_verify(const uint8_t *key, unsigned int key_bits,
                              const uint8_t *iv, size_t iv_len,
                              const uint8_t *aad, size_t aad_len,
                              const uint8_t *ct, size_t ct_len,
                              const uint8_t tag[16],
                              uint8_t *pt)
{
    mbedtls_aes_context ctx;
    uint8_t zero[16] = {0};
    uint8_t H[16];
    uint8_t J0[16];
    uint8_t S[16];
    uint8_t GH[16];
    uint8_t expected[16];

    mbedtls_aes_init(&ctx);
    mbedtls_aes_setkey_enc(&ctx, key, key_bits);

    aes_block(&ctx, key_bits, zero, H);
    derive_j0(&ctx, key_bits, iv, iv_len, H, J0);
    ghash(H, aad, aad_len, ct, ct_len, GH);
    aes_block(&ctx, key_bits, J0, S);

    for (int i = 0; i < 16; ++i) {
        expected[i] = (uint8_t)(S[i] ^ GH[i]);
    }

    if (!ct_memcmp_eq(expected, tag, 16)) {
        mbedtls_aes_free(&ctx);
        return -1;
    }

    ctr_crypt(&ctx, key_bits, J0, ct, ct_len, pt);
    mbedtls_aes_free(&ctx);
    return 0;
}

static void gcm_ctr_only(const uint8_t *key, unsigned int key_bits,
                         const uint8_t iv[AES_GCM_NONCE_LEN],
                         const uint8_t *in, size_t len,
                         uint8_t *out)
{
    mbedtls_aes_context ctx;
    uint8_t J0[16] = {0};

    mbedtls_aes_init(&ctx);
    mbedtls_aes_setkey_enc(&ctx, key, key_bits);

    memcpy(J0, iv, AES_GCM_NONCE_LEN);
    J0[15] = 1;
    ctr_crypt(&ctx, key_bits, J0, in, len, out);

    mbedtls_aes_free(&ctx);
}

void aes_128_gcm_ctr_crypt(const uint8_t key[AES128_KEY_LEN],
                           const uint8_t iv[AES_GCM_NONCE_LEN],
                           const uint8_t *in, size_t len,
                           uint8_t *out)
{
    gcm_ctr_only(key, 128U, iv, in, len, out);
}

void aes_128_gcm_auth(const uint8_t key[AES128_KEY_LEN],
                      const uint8_t *iv, size_t iv_len,
                      const uint8_t *aad, size_t aad_len,
                      const uint8_t *ct, size_t ct_len,
                      uint8_t tag[AES_GCM_TAG_LEN])
{
    gcm_auth_only(key, 128U, iv, iv_len, aad, aad_len, ct, ct_len, tag);
}

int aes_128_gcm_verify(const uint8_t key[AES128_KEY_LEN],
                       const uint8_t *iv, size_t iv_len,
                       const uint8_t *aad, size_t aad_len,
                       const uint8_t *ct, size_t ct_len,
                       const uint8_t tag[AES_GCM_TAG_LEN])
{
    return gcm_verify_only(key, 128U, iv, iv_len, aad, aad_len, ct, ct_len, tag);
}

void aes_128_gcm_encrypt_auth(const uint8_t key[AES128_KEY_LEN],
                              const uint8_t *iv, size_t iv_len,
                              const uint8_t *aad, size_t aad_len,
                              const uint8_t *pt, size_t pt_len,
                              uint8_t *ct,
                              uint8_t tag[AES_GCM_TAG_LEN])
{
    gcm_encrypt_auth(key, 128U, iv, iv_len, aad, aad_len, pt, pt_len, ct, tag);
}

int aes_128_gcm_decrypt_verify(const uint8_t key[AES128_KEY_LEN],
                               const uint8_t *iv, size_t iv_len,
                               const uint8_t *aad, size_t aad_len,
                               const uint8_t *ct, size_t ct_len,
                               const uint8_t tag[AES_GCM_TAG_LEN],
                               uint8_t *pt)
{
    return gcm_decrypt_verify(key, 128U, iv, iv_len, aad, aad_len, ct, ct_len, tag, pt);
}

void aes_256_gcm_ctr_crypt(const uint8_t key[AES256_KEY_LEN],
                           const uint8_t iv[AES_GCM_NONCE_LEN],
                           const uint8_t *in, size_t len,
                           uint8_t *out)
{
    gcm_ctr_only(key, 256U, iv, in, len, out);
}

void aes_256_gcm_auth(const uint8_t key[AES256_KEY_LEN],
                      const uint8_t *iv, size_t iv_len,
                      const uint8_t *aad, size_t aad_len,
                      const uint8_t *ct, size_t ct_len,
                      uint8_t tag[AES_GCM_TAG_LEN])
{
    gcm_auth_only(key, 256U, iv, iv_len, aad, aad_len, ct, ct_len, tag);
}

int aes_256_gcm_verify(const uint8_t key[AES256_KEY_LEN],
                       const uint8_t *iv, size_t iv_len,
                       const uint8_t *aad, size_t aad_len,
                       const uint8_t *ct, size_t ct_len,
                       const uint8_t tag[AES_GCM_TAG_LEN])
{
    return gcm_verify_only(key, 256U, iv, iv_len, aad, aad_len, ct, ct_len, tag);
}

void aes_256_gcm_encrypt_auth(const uint8_t key[AES256_KEY_LEN],
                              const uint8_t *iv, size_t iv_len,
                              const uint8_t *aad, size_t aad_len,
                              const uint8_t *pt, size_t pt_len,
                              uint8_t *ct,
                              uint8_t tag[AES_GCM_TAG_LEN])
{
    gcm_encrypt_auth(key, 256U, iv, iv_len, aad, aad_len, pt, pt_len, ct, tag);
}

int aes_256_gcm_decrypt_verify(const uint8_t key[AES256_KEY_LEN],
                               const uint8_t *iv, size_t iv_len,
                               const uint8_t *aad, size_t aad_len,
                               const uint8_t *ct, size_t ct_len,
                               const uint8_t tag[AES_GCM_TAG_LEN],
                               uint8_t *pt)
{
    return gcm_decrypt_verify(key, 256U, iv, iv_len, aad, aad_len, ct, ct_len, tag, pt);
}
```

## src/aes-256_gcm.h
```c
#ifndef AES_256_GCM_H
#define AES_256_GCM_H

#include <stddef.h>
#include <stdint.h>

#define AES_GCM_NONCE_LEN 12
#define AES_GCM_TAG_LEN   16
#define AES128_KEY_LEN    16
#define AES256_KEY_LEN    32

extern uint32_t g_aes128_block_calls;
extern uint32_t g_aes256_block_calls;

void aes_gcm_counters_reset(void);
uint32_t aes_128_gcm_get_block_calls(void);
uint32_t aes_256_gcm_get_block_calls(void);

/* AES-128-GCM */
void aes_128_gcm_ctr_crypt(const uint8_t key[AES128_KEY_LEN],
                           const uint8_t iv[AES_GCM_NONCE_LEN],
                           const uint8_t *in, size_t len,
                           uint8_t *out);

void aes_128_gcm_auth(const uint8_t key[AES128_KEY_LEN],
                      const uint8_t *iv, size_t iv_len,
                      const uint8_t *aad, size_t aad_len,
                      const uint8_t *ct, size_t ct_len,
                      uint8_t tag[AES_GCM_TAG_LEN]);

int aes_128_gcm_verify(const uint8_t key[AES128_KEY_LEN],
                       const uint8_t *iv, size_t iv_len,
                       const uint8_t *aad, size_t aad_len,
                       const uint8_t *ct, size_t ct_len,
                       const uint8_t tag[AES_GCM_TAG_LEN]);

void aes_128_gcm_encrypt_auth(const uint8_t key[AES128_KEY_LEN],
                              const uint8_t *iv, size_t iv_len,
                              const uint8_t *aad, size_t aad_len,
                              const uint8_t *pt, size_t pt_len,
                              uint8_t *ct,
                              uint8_t tag[AES_GCM_TAG_LEN]);

int aes_128_gcm_decrypt_verify(const uint8_t key[AES128_KEY_LEN],
                               const uint8_t *iv, size_t iv_len,
                               const uint8_t *aad, size_t aad_len,
                               const uint8_t *ct, size_t ct_len,
                               const uint8_t tag[AES_GCM_TAG_LEN],
                               uint8_t *pt);

/* AES-256-GCM */
void aes_256_gcm_ctr_crypt(const uint8_t key[AES256_KEY_LEN],
                           const uint8_t iv[AES_GCM_NONCE_LEN],
                           const uint8_t *in, size_t len,
                           uint8_t *out);

void aes_256_gcm_auth(const uint8_t key[AES256_KEY_LEN],
                      const uint8_t *iv, size_t iv_len,
                      const uint8_t *aad, size_t aad_len,
                      const uint8_t *ct, size_t ct_len,
                      uint8_t tag[AES_GCM_TAG_LEN]);

int aes_256_gcm_verify(const uint8_t key[AES256_KEY_LEN],
                       const uint8_t *iv, size_t iv_len,
                       const uint8_t *aad, size_t aad_len,
                       const uint8_t *ct, size_t ct_len,
                       const uint8_t tag[AES_GCM_TAG_LEN]);

void aes_256_gcm_encrypt_auth(const uint8_t key[AES256_KEY_LEN],
                              const uint8_t *iv, size_t iv_len,
                              const uint8_t *aad, size_t aad_len,
                              const uint8_t *pt, size_t pt_len,
                              uint8_t *ct,
                              uint8_t tag[AES_GCM_TAG_LEN]);

int aes_256_gcm_decrypt_verify(const uint8_t key[AES256_KEY_LEN],
                               const uint8_t *iv, size_t iv_len,
                               const uint8_t *aad, size_t aad_len,
                               const uint8_t *ct, size_t ct_len,
                               const uint8_t tag[AES_GCM_TAG_LEN],
                               uint8_t *pt);

#endif /* AES_256_GCM_H */
```

## src/aes_gcm.c
```c
#include "aes_gcm.h"

#include <mbedtls/aes.h>
#include <string.h>

uint32_t g_aes128_block_calls = 0;
uint32_t g_aes256_block_calls = 0;

void aes_gcm_counters_reset(void)
{
    g_aes128_block_calls = 0;
    g_aes256_block_calls = 0;
}

uint32_t aes_128_gcm_get_block_calls(void)
{
    return g_aes128_block_calls;
}

uint32_t aes_256_gcm_get_block_calls(void)
{
    return g_aes256_block_calls;
}

static void inc_be32(uint8_t ctr[16])
{
    for (int i = 15; i >= 12; --i) {
        if (++ctr[i] != 0) {
            break;
        }
    }
}

static int ct_memcmp_eq(const uint8_t *a, const uint8_t *b, size_t n)
{
    uint8_t diff = 0;

    for (size_t i = 0; i < n; ++i) {
        diff |= (uint8_t)(a[i] ^ b[i]);
    }

    return diff == 0;
}

static void xor_block(uint8_t out[16], const uint8_t in[16])
{
    for (int i = 0; i < 16; ++i) {
        out[i] ^= in[i];
    }
}

static uint64_t load64_be(const uint8_t *in)
{
    return ((uint64_t)in[0] << 56) |
           ((uint64_t)in[1] << 48) |
           ((uint64_t)in[2] << 40) |
           ((uint64_t)in[3] << 32) |
           ((uint64_t)in[4] << 24) |
           ((uint64_t)in[5] << 16) |
           ((uint64_t)in[6] << 8)  |
           ((uint64_t)in[7]);
}

static void store64_be(uint8_t *out, uint64_t v)
{
    out[0] = (uint8_t)(v >> 56);
    out[1] = (uint8_t)(v >> 48);
    out[2] = (uint8_t)(v >> 40);
    out[3] = (uint8_t)(v >> 32);
    out[4] = (uint8_t)(v >> 24);
    out[5] = (uint8_t)(v >> 16);
    out[6] = (uint8_t)(v >> 8);
    out[7] = (uint8_t)(v);
}

static void gf_mul_128(const uint8_t X[16], const uint8_t Y[16], uint8_t out[16])
{
    uint64_t Xh = load64_be(X);
    uint64_t Xl = load64_be(X + 8);
    uint64_t Vh = load64_be(Y);
    uint64_t Vl = load64_be(Y + 8);
    uint64_t Zh = 0;
    uint64_t Zl = 0;

    for (int i = 0; i < 128; ++i) {
        int bit;

        if (i < 64) {
            bit = (int)((Xh >> (63 - i)) & 1U);
        } else {
            bit = (int)((Xl >> (63 - (i - 64))) & 1U);
        }

        if (bit) {
            Zh ^= Vh;
            Zl ^= Vl;
        }

        {
            int lsb = (int)(Vl & 1U);
            uint64_t new_vl = (Vl >> 1) | ((Vh & 1U) << 63);
            uint64_t new_vh = (Vh >> 1);

            Vh = new_vh;
            Vl = new_vl;

            if (lsb) {
                Vh ^= 0xE100000000000000ULL;
            }
        }
    }

    store64_be(out, Zh);
    store64_be(out + 8, Zl);
}

static void ghash(const uint8_t H[16],
                  const uint8_t *aad, size_t aad_len,
                  const uint8_t *ct, size_t ct_len,
                  uint8_t out[16])
{
    uint8_t Y[16] = {0};
    uint8_t block[16];
    uint8_t tmp[16];
    size_t off = 0;

    while (off + 16 <= aad_len) {
        memcpy(block, aad + off, 16);
        xor_block(Y, block);
        gf_mul_128(Y, H, tmp);
        memcpy(Y, tmp, 16);
        off += 16;
    }

    if (off < aad_len) {
        size_t rem = aad_len - off;
        memset(block, 0, sizeof(block));
        memcpy(block, aad + off, rem);
        xor_block(Y, block);
        gf_mul_128(Y, H, tmp);
        memcpy(Y, tmp, 16);
    }

    off = 0;
    while (off + 16 <= ct_len) {
        memcpy(block, ct + off, 16);
        xor_block(Y, block);
        gf_mul_128(Y, H, tmp);
        memcpy(Y, tmp, 16);
        off += 16;
    }

    if (off < ct_len) {
        size_t rem = ct_len - off;
        memset(block, 0, sizeof(block));
        memcpy(block, ct + off, rem);
        xor_block(Y, block);
        gf_mul_128(Y, H, tmp);
        memcpy(Y, tmp, 16);
    }

    {
        uint8_t len_block[16];
        uint64_t aad_bits = (uint64_t)aad_len * 8U;
        uint64_t ct_bits = (uint64_t)ct_len * 8U;

        store64_be(len_block, aad_bits);
        store64_be(len_block + 8, ct_bits);
        xor_block(Y, len_block);
        gf_mul_128(Y, H, tmp);
        memcpy(Y, tmp, 16);
    }

    memcpy(out, Y, 16);
}

static void aes_block(mbedtls_aes_context *ctx,
                      unsigned int key_bits,
                      const uint8_t in[16],
                      uint8_t out[16])
{
    if (key_bits == 128U) {
        ++g_aes128_block_calls;
    } else {
        ++g_aes256_block_calls;
    }

    mbedtls_aes_crypt_ecb(ctx, MBEDTLS_AES_ENCRYPT, in, out);
}

static void derive_j0(mbedtls_aes_context *ctx,
                      unsigned int key_bits,
                      const uint8_t *iv, size_t iv_len,
                      const uint8_t H[16],
                      uint8_t J0[16])
{
    (void)ctx;
    (void)key_bits;

    if (iv_len == AES_GCM_NONCE_LEN) {
        memset(J0, 0, 16);
        memcpy(J0, iv, AES_GCM_NONCE_LEN);
        J0[15] = 1;
        return;
    }

    ghash(H, NULL, 0, iv, iv_len, J0);
}

static void ctr_crypt(mbedtls_aes_context *ctx,
                      unsigned int key_bits,
                      const uint8_t J0[16],
                      const uint8_t *in, size_t len,
                      uint8_t *out)
{
    uint8_t ctr[16];
    uint8_t stream[16];
    size_t off = 0;

    memcpy(ctr, J0, 16);

    while (off < len) {
        size_t chunk;

        inc_be32(ctr);
        aes_block(ctx, key_bits, ctr, stream);

        chunk = (len - off < 16U) ? (len - off) : 16U;
        for (size_t i = 0; i < chunk; ++i) {
            out[off + i] = (uint8_t)(in[off + i] ^ stream[i]);
        }
        off += chunk;
    }
}

static void gcm_auth_only(const uint8_t *key, unsigned int key_bits,
                          const uint8_t *iv, size_t iv_len,
                          const uint8_t *aad, size_t aad_len,
                          const uint8_t *ct, size_t ct_len,
                          uint8_t tag[16])
{
    mbedtls_aes_context ctx;
    uint8_t zero[16] = {0};
    uint8_t H[16];
    uint8_t J0[16];
    uint8_t S[16];
    uint8_t GH[16];

    mbedtls_aes_init(&ctx);
    mbedtls_aes_setkey_enc(&ctx, key, key_bits);

    aes_block(&ctx, key_bits, zero, H);
    derive_j0(&ctx, key_bits, iv, iv_len, H, J0);
    ghash(H, aad, aad_len, ct, ct_len, GH);
    aes_block(&ctx, key_bits, J0, S);

    for (int i = 0; i < 16; ++i) {
        tag[i] = (uint8_t)(S[i] ^ GH[i]);
    }

    mbedtls_aes_free(&ctx);
}

static int gcm_verify_only(const uint8_t *key, unsigned int key_bits,
                           const uint8_t *iv, size_t iv_len,
                           const uint8_t *aad, size_t aad_len,
                           const uint8_t *ct, size_t ct_len,
                           const uint8_t tag[16])
{
    uint8_t expected[16];

    gcm_auth_only(key, key_bits, iv, iv_len, aad, aad_len, ct, ct_len, expected);
    return ct_memcmp_eq(expected, tag, 16) ? 0 : -1;
}

static void gcm_encrypt_auth(const uint8_t *key, unsigned int key_bits,
                             const uint8_t *iv, size_t iv_len,
                             const uint8_t *aad, size_t aad_len,
                             const uint8_t *pt, size_t pt_len,
                             uint8_t *ct,
                             uint8_t tag[16])
{
    mbedtls_aes_context ctx;
    uint8_t zero[16] = {0};
    uint8_t H[16];
    uint8_t J0[16];
    uint8_t S[16];
    uint8_t GH[16];

    mbedtls_aes_init(&ctx);
    mbedtls_aes_setkey_enc(&ctx, key, key_bits);

    aes_block(&ctx, key_bits, zero, H);
    derive_j0(&ctx, key_bits, iv, iv_len, H, J0);
    ctr_crypt(&ctx, key_bits, J0, pt, pt_len, ct);
    ghash(H, aad, aad_len, ct, pt_len, GH);
    aes_block(&ctx, key_bits, J0, S);

    for (int i = 0; i < 16; ++i) {
        tag[i] = (uint8_t)(S[i] ^ GH[i]);
    }

    mbedtls_aes_free(&ctx);
}

static int gcm_decrypt_verify(const uint8_t *key, unsigned int key_bits,
                              const uint8_t *iv, size_t iv_len,
                              const uint8_t *aad, size_t aad_len,
                              const uint8_t *ct, size_t ct_len,
                              const uint8_t tag[16],
                              uint8_t *pt)
{
    mbedtls_aes_context ctx;
    uint8_t zero[16] = {0};
    uint8_t H[16];
    uint8_t J0[16];
    uint8_t S[16];
    uint8_t GH[16];
    uint8_t expected[16];

    mbedtls_aes_init(&ctx);
    mbedtls_aes_setkey_enc(&ctx, key, key_bits);

    aes_block(&ctx, key_bits, zero, H);
    derive_j0(&ctx, key_bits, iv, iv_len, H, J0);
    ghash(H, aad, aad_len, ct, ct_len, GH);
    aes_block(&ctx, key_bits, J0, S);

    for (int i = 0; i < 16; ++i) {
        expected[i] = (uint8_t)(S[i] ^ GH[i]);
    }

    if (!ct_memcmp_eq(expected, tag, 16)) {
        mbedtls_aes_free(&ctx);
        return -1;
    }

    ctr_crypt(&ctx, key_bits, J0, ct, ct_len, pt);
    mbedtls_aes_free(&ctx);
    return 0;
}

static void gcm_ctr_only(const uint8_t *key, unsigned int key_bits,
                         const uint8_t iv[AES_GCM_NONCE_LEN],
                         const uint8_t *in, size_t len,
                         uint8_t *out)
{
    mbedtls_aes_context ctx;
    uint8_t J0[16] = {0};

    mbedtls_aes_init(&ctx);
    mbedtls_aes_setkey_enc(&ctx, key, key_bits);

    memcpy(J0, iv, AES_GCM_NONCE_LEN);
    J0[15] = 1;
    ctr_crypt(&ctx, key_bits, J0, in, len, out);

    mbedtls_aes_free(&ctx);
}

void aes_128_gcm_ctr_crypt(const uint8_t key[AES128_KEY_LEN],
                           const uint8_t iv[AES_GCM_NONCE_LEN],
                           const uint8_t *in, size_t len,
                           uint8_t *out)
{
    gcm_ctr_only(key, 128U, iv, in, len, out);
}

void aes_128_gcm_auth(const uint8_t key[AES128_KEY_LEN],
                      const uint8_t *iv, size_t iv_len,
                      const uint8_t *aad, size_t aad_len,
                      const uint8_t *ct, size_t ct_len,
                      uint8_t tag[AES_GCM_TAG_LEN])
{
    gcm_auth_only(key, 128U, iv, iv_len, aad, aad_len, ct, ct_len, tag);
}

int aes_128_gcm_verify(const uint8_t key[AES128_KEY_LEN],
                       const uint8_t *iv, size_t iv_len,
                       const uint8_t *aad, size_t aad_len,
                       const uint8_t *ct, size_t ct_len,
                       const uint8_t tag[AES_GCM_TAG_LEN])
{
    return gcm_verify_only(key, 128U, iv, iv_len, aad, aad_len, ct, ct_len, tag);
}

void aes_128_gcm_encrypt_auth(const uint8_t key[AES128_KEY_LEN],
                              const uint8_t *iv, size_t iv_len,
                              const uint8_t *aad, size_t aad_len,
                              const uint8_t *pt, size_t pt_len,
                              uint8_t *ct,
                              uint8_t tag[AES_GCM_TAG_LEN])
{
    gcm_encrypt_auth(key, 128U, iv, iv_len, aad, aad_len, pt, pt_len, ct, tag);
}

int aes_128_gcm_decrypt_verify(const uint8_t key[AES128_KEY_LEN],
                               const uint8_t *iv, size_t iv_len,
                               const uint8_t *aad, size_t aad_len,
                               const uint8_t *ct, size_t ct_len,
                               const uint8_t tag[AES_GCM_TAG_LEN],
                               uint8_t *pt)
{
    return gcm_decrypt_verify(key, 128U, iv, iv_len, aad, aad_len, ct, ct_len, tag, pt);
}

void aes_256_gcm_ctr_crypt(const uint8_t key[AES256_KEY_LEN],
                           const uint8_t iv[AES_GCM_NONCE_LEN],
                           const uint8_t *in, size_t len,
                           uint8_t *out)
{
    gcm_ctr_only(key, 256U, iv, in, len, out);
}

void aes_256_gcm_auth(const uint8_t key[AES256_KEY_LEN],
                      const uint8_t *iv, size_t iv_len,
                      const uint8_t *aad, size_t aad_len,
                      const uint8_t *ct, size_t ct_len,
                      uint8_t tag[AES_GCM_TAG_LEN])
{
    gcm_auth_only(key, 256U, iv, iv_len, aad, aad_len, ct, ct_len, tag);
}

int aes_256_gcm_verify(const uint8_t key[AES256_KEY_LEN],
                       const uint8_t *iv, size_t iv_len,
                       const uint8_t *aad, size_t aad_len,
                       const uint8_t *ct, size_t ct_len,
                       const uint8_t tag[AES_GCM_TAG_LEN])
{
    return gcm_verify_only(key, 256U, iv, iv_len, aad, aad_len, ct, ct_len, tag);
}

void aes_256_gcm_encrypt_auth(const uint8_t key[AES256_KEY_LEN],
                              const uint8_t *iv, size_t iv_len,
                              const uint8_t *aad, size_t aad_len,
                              const uint8_t *pt, size_t pt_len,
                              uint8_t *ct,
                              uint8_t tag[AES_GCM_TAG_LEN])
{
    gcm_encrypt_auth(key, 256U, iv, iv_len, aad, aad_len, pt, pt_len, ct, tag);
}

int aes_256_gcm_decrypt_verify(const uint8_t key[AES256_KEY_LEN],
                               const uint8_t *iv, size_t iv_len,
                               const uint8_t *aad, size_t aad_len,
                               const uint8_t *ct, size_t ct_len,
                               const uint8_t tag[AES_GCM_TAG_LEN],
                               uint8_t *pt)
{
    return gcm_decrypt_verify(key, 256U, iv, iv_len, aad, aad_len, ct, ct_len, tag, pt);
}
```

## src/aes_gcm.h
```c
#ifndef AES_256_GCM_H
#define AES_256_GCM_H

#include <stddef.h>
#include <stdint.h>

#define AES_GCM_NONCE_LEN 12
#define AES_GCM_TAG_LEN   16
#define AES128_KEY_LEN    16
#define AES256_KEY_LEN    32

extern uint32_t g_aes128_block_calls;
extern uint32_t g_aes256_block_calls;

void aes_gcm_counters_reset(void);
uint32_t aes_128_gcm_get_block_calls(void);
uint32_t aes_256_gcm_get_block_calls(void);

/* AES-128-GCM */
void aes_128_gcm_ctr_crypt(const uint8_t key[AES128_KEY_LEN],
                           const uint8_t iv[AES_GCM_NONCE_LEN],
                           const uint8_t *in, size_t len,
                           uint8_t *out);

void aes_128_gcm_auth(const uint8_t key[AES128_KEY_LEN],
                      const uint8_t *iv, size_t iv_len,
                      const uint8_t *aad, size_t aad_len,
                      const uint8_t *ct, size_t ct_len,
                      uint8_t tag[AES_GCM_TAG_LEN]);

int aes_128_gcm_verify(const uint8_t key[AES128_KEY_LEN],
                       const uint8_t *iv, size_t iv_len,
                       const uint8_t *aad, size_t aad_len,
                       const uint8_t *ct, size_t ct_len,
                       const uint8_t tag[AES_GCM_TAG_LEN]);

void aes_128_gcm_encrypt_auth(const uint8_t key[AES128_KEY_LEN],
                              const uint8_t *iv, size_t iv_len,
                              const uint8_t *aad, size_t aad_len,
                              const uint8_t *pt, size_t pt_len,
                              uint8_t *ct,
                              uint8_t tag[AES_GCM_TAG_LEN]);

int aes_128_gcm_decrypt_verify(const uint8_t key[AES128_KEY_LEN],
                               const uint8_t *iv, size_t iv_len,
                               const uint8_t *aad, size_t aad_len,
                               const uint8_t *ct, size_t ct_len,
                               const uint8_t tag[AES_GCM_TAG_LEN],
                               uint8_t *pt);

/* AES-256-GCM */
void aes_256_gcm_ctr_crypt(const uint8_t key[AES256_KEY_LEN],
                           const uint8_t iv[AES_GCM_NONCE_LEN],
                           const uint8_t *in, size_t len,
                           uint8_t *out);

void aes_256_gcm_auth(const uint8_t key[AES256_KEY_LEN],
                      const uint8_t *iv, size_t iv_len,
                      const uint8_t *aad, size_t aad_len,
                      const uint8_t *ct, size_t ct_len,
                      uint8_t tag[AES_GCM_TAG_LEN]);

int aes_256_gcm_verify(const uint8_t key[AES256_KEY_LEN],
                       const uint8_t *iv, size_t iv_len,
                       const uint8_t *aad, size_t aad_len,
                       const uint8_t *ct, size_t ct_len,
                       const uint8_t tag[AES_GCM_TAG_LEN]);

void aes_256_gcm_encrypt_auth(const uint8_t key[AES256_KEY_LEN],
                              const uint8_t *iv, size_t iv_len,
                              const uint8_t *aad, size_t aad_len,
                              const uint8_t *pt, size_t pt_len,
                              uint8_t *ct,
                              uint8_t tag[AES_GCM_TAG_LEN]);

int aes_256_gcm_decrypt_verify(const uint8_t key[AES256_KEY_LEN],
                               const uint8_t *iv, size_t iv_len,
                               const uint8_t *aad, size_t aad_len,
                               const uint8_t *ct, size_t ct_len,
                               const uint8_t tag[AES_GCM_TAG_LEN],
                               uint8_t *pt);

#endif
```

## src/bench.h
```c
#ifndef BENCH_H
#define BENCH_H

void verify_correctness(void);
void bench_gcm_all(void);

#endif
```

## src/gf.c
```c
#include "gf.h"
#include "utils.h"

/* GF (Galois Field) multiply 
Z=X⋅Y(modx128+x7+x2+x+1)
*/
void gf_mul(const uint8_t X[16], const uint8_t Y[16], uint8_t out[16])
{
        uint64_t Xh = load_64(X);
        uint64_t Xl = load_64(X + 8);
        uint64_t Vh = load_64(Y);
        uint64_t Vl = load_64(Y + 8);
        uint64_t Zh = 0;
        uint64_t Zl = 0;

        for (int i = 0; i < 128; i++) {
                int bit;
                if (i < 64)
                        bit = (int)((Xh >> (63 - i)) & 1);
                else
                        bit = (int)((Xl >> (63 - (i - 64))) & 1);

                if (bit) {
                        Zh ^= Vh;
                        Zl ^= Vl;
                }

                int lsb = (int)(Vl & 1);

                uint64_t newVl = (Vl >> 1) | ((Vh & 1) << 63);
                uint64_t newVh = (Vh >> 1);
                Vh = newVh;
                Vl = newVl;

                if (lsb) {
                        Vh ^= 0xE100000000000000ULL;
                }       
        }

        store_64(out, Zh);
        store_64(out + 8, Zl);
}
```

## src/rijndael_256_gcm.c
```c
#include "rijndael_256_gcm.h"

#include "rijndael256.h"
#include <string.h>

uint32_t g_rijndael256_block_calls = 0;

void rijndael256_gcm_counters_reset(void)
{
    g_rijndael256_block_calls = 0;
}

uint32_t rijndael256_gcm_get_block_calls(void)
{
    return g_rijndael256_block_calls;
}

static void inc_be32(uint8_t ctr[32])
{
    for (int i = 31; i >= 28; --i) {
        if (++ctr[i] != 0) {
            break;
        }
    }
}

static int ct_memcmp_eq(const uint8_t *a, const uint8_t *b, size_t n)
{
    uint8_t diff = 0;

    for (size_t i = 0; i < n; ++i) {
        diff |= (uint8_t)(a[i] ^ b[i]);
    }

    return diff == 0;
}

static void xor_block(uint8_t out[32], const uint8_t in[32])
{
    for (int i = 0; i < 32; ++i) {
        out[i] ^= in[i];
    }
}

static uint64_t load64_be(const uint8_t *in)
{
    return ((uint64_t)in[0] << 56) |
           ((uint64_t)in[1] << 48) |
           ((uint64_t)in[2] << 40) |
           ((uint64_t)in[3] << 32) |
           ((uint64_t)in[4] << 24) |
           ((uint64_t)in[5] << 16) |
           ((uint64_t)in[6] << 8)  |
           ((uint64_t)in[7]);
}

static void store64_be(uint8_t *out, uint64_t v)
{
    out[0] = (uint8_t)(v >> 56);
    out[1] = (uint8_t)(v >> 48);
    out[2] = (uint8_t)(v >> 40);
    out[3] = (uint8_t)(v >> 32);
    out[4] = (uint8_t)(v >> 24);
    out[5] = (uint8_t)(v >> 16);
    out[6] = (uint8_t)(v >> 8);
    out[7] = (uint8_t)(v);
}

/* GF(2^256) multiplication for GHASH with 256-bit blocks */
static void gf_mul_256(const uint8_t X[32], const uint8_t Y[32], uint8_t out[32])
{
    /* Load values from 4 x 64-bit chunks */
    uint64_t Xvals[4], Yvals[4];
    
    for (int i = 0; i < 4; i++) {
        Xvals[i] = load64_be(X + (i * 8));
        Yvals[i] = load64_be(Y + (i * 8));
    }

    uint64_t Z[4] = {0, 0, 0, 0};

    /* GF multiplication bit-by-bit */
    for (int bit = 0; bit < 256; ++bit) {
        int chunk = bit / 64;
        int bitpos = 63 - (bit % 64);
        int bit_val = (int)((Xvals[chunk] >> bitpos) & 1U);

        if (bit_val) {
            for (int i = 0; i < 4; i++) {
                Z[i] ^= Yvals[i];
            }
        }

        /* Reduction */
        int lsb = (int)(Yvals[3] & 1U);
        uint64_t new_y3 = (Yvals[3] >> 1) | ((Yvals[2] & 1U) << 63);
        uint64_t new_y2 = (Yvals[2] >> 1) | ((Yvals[1] & 1U) << 63);
        uint64_t new_y1 = (Yvals[1] >> 1) | ((Yvals[0] & 1U) << 63);
        uint64_t new_y0 = (Yvals[0] >> 1);

        Yvals[3] = new_y3;
        Yvals[2] = new_y2;
        Yvals[1] = new_y1;
        Yvals[0] = new_y0;

        if (lsb) {
            /* Rijndael-256 irreducible polynomial x^256+x^7+x^6+x^5+x^4+x+1 */
            Yvals[0] ^= 0xCF00000000000000ULL;
        }
    }

    for (int i = 0; i < 4; i++) {
        store64_be(out + (i * 8), Z[i]);
    }
}

static void ghash_256(const uint8_t H[32],
                      const uint8_t *aad, size_t aad_len,
                      const uint8_t *ct, size_t ct_len,
                      uint8_t out[32])
{
    uint8_t Y[32] = {0};
    uint8_t block[32];
    uint8_t tmp[32];
    size_t off = 0;

    while (off + 32 <= aad_len) {
        memcpy(block, aad + off, 32);
        xor_block(Y, block);
        gf_mul_256(Y, H, tmp);
        memcpy(Y, tmp, 32);
        off += 32;
    }

    if (off < aad_len) {
        size_t rem = aad_len - off;
        memset(block, 0, sizeof(block));
        memcpy(block, aad + off, rem);
        xor_block(Y, block);
        gf_mul_256(Y, H, tmp);
        memcpy(Y, tmp, 32);
    }

    off = 0;
    while (off + 32 <= ct_len) {
        memcpy(block, ct + off, 32);
        xor_block(Y, block);
        gf_mul_256(Y, H, tmp);
        memcpy(Y, tmp, 32);
        off += 32;
    }

    if (off < ct_len) {
        size_t rem = ct_len - off;
        memset(block, 0, sizeof(block));
        memcpy(block, ct + off, rem);
        xor_block(Y, block);
        gf_mul_256(Y, H, tmp);
        memcpy(Y, tmp, 32);
    }

    /* Append length block */
    memset(block, 0, sizeof(block));
    store64_be(block + 16, (uint64_t)aad_len * 8);
    store64_be(block + 24, (uint64_t)ct_len * 8);
    xor_block(Y, block);
    gf_mul_256(Y, H, tmp);
    memcpy(Y, tmp, 32);

    memcpy(out, Y, 32);
}

static int rijndael256_create_cipher(const uint8_t key[RIJNDAEL256_KEY_LEN],
                                     rijndael256_ctx_t *ctx)
{
    rijndael256_set_key(ctx, key);
    return 1;
}

void rijndael256_gcm_ctr_crypt(const uint8_t key[RIJNDAEL256_KEY_LEN],
                               const uint8_t iv[RIJNDAEL256_GCM_NONCE_LEN],
                               const uint8_t *in, size_t len,
                               uint8_t *out)
{
    rijndael256_ctx_t cipher;
    if (!rijndael256_create_cipher(key, &cipher)) {
        return;
    }

    uint8_t ctr[32];
    uint8_t block[32];
    size_t off = 0;

    memset(ctr, 0, sizeof(ctr));
    memcpy(ctr, iv, RIJNDAEL256_GCM_NONCE_LEN);
    ctr[31] = 2;  /* Counter starts at 2 for Rijndael-256 */

    while (off < len) {
        rijndael256_encrypt(&cipher, ctr, block);
        g_rijndael256_block_calls++;

        size_t block_len = (len - off) > 32 ? 32 : (len - off);
        for (size_t i = 0; i < block_len; ++i) {
            out[off + i] = in[off + i] ^ block[i];
        }

        off += block_len;
        inc_be32(ctr);
    }
}

void rijndael256_gcm_auth(const uint8_t key[RIJNDAEL256_KEY_LEN],
                          const uint8_t *iv, size_t iv_len,
                          const uint8_t *aad, size_t aad_len,
                          const uint8_t *ct, size_t ct_len,
                          uint8_t tag[RIJNDAEL256_GCM_TAG_LEN])
{
    rijndael256_ctx_t cipher;
    if (!rijndael256_create_cipher(key, &cipher)) {
        return;
    }

    /* Generate H = E(K, 0) */
    uint8_t H[32];
    uint8_t zero[32] = {0};
    rijndael256_encrypt(&cipher, zero, H);
    g_rijndael256_block_calls++;

    /* GHASH */
    uint8_t ghash_out[32];
    ghash_256(H, aad, aad_len, ct, ct_len, ghash_out);

    /* Generate counter for tag encryption */
    uint8_t ctr[32];
    memset(ctr, 0, sizeof(ctr));
    memcpy(ctr, iv, iv_len);
    ctr[31] = 1;

    /* Encrypt GHASH output */
    uint8_t tag_block[32];
    rijndael256_encrypt(&cipher, ctr, tag_block);
    g_rijndael256_block_calls++;

    /* XOR and truncate to tag length */
    for (size_t i = 0; i < RIJNDAEL256_GCM_TAG_LEN; ++i) {
        tag[i] = ghash_out[i] ^ tag_block[i];
    }
}

int rijndael256_gcm_verify(const uint8_t key[RIJNDAEL256_KEY_LEN],
                           const uint8_t *iv, size_t iv_len,
                           const uint8_t *aad, size_t aad_len,
                           const uint8_t *ct, size_t ct_len,
                           const uint8_t tag[RIJNDAEL256_GCM_TAG_LEN])
{
    uint8_t computed_tag[RIJNDAEL256_GCM_TAG_LEN];
    
    rijndael256_gcm_auth(key, iv, iv_len, aad, aad_len, ct, ct_len, computed_tag);
    
    return ct_memcmp_eq(tag, computed_tag, RIJNDAEL256_GCM_TAG_LEN);
}

void rijndael256_gcm_encrypt_auth(const uint8_t key[RIJNDAEL256_KEY_LEN],
                                  const uint8_t *iv, size_t iv_len,
                                  const uint8_t *aad, size_t aad_len,
                                  const uint8_t *pt, size_t pt_len,
                                  uint8_t *ct,
                                  uint8_t tag[RIJNDAEL256_GCM_TAG_LEN])
{
    rijndael256_gcm_ctr_crypt(key, iv, pt, pt_len, ct);
    rijndael256_gcm_auth(key, iv, iv_len, aad, aad_len, ct, pt_len, tag);
}

int rijndael256_gcm_decrypt_verify(const uint8_t key[RIJNDAEL256_KEY_LEN],
                                   const uint8_t *iv, size_t iv_len,
                                   const uint8_t *aad, size_t aad_len,
                                   const uint8_t *ct, size_t ct_len,
                                   const uint8_t tag[RIJNDAEL256_GCM_TAG_LEN],
                                   uint8_t *pt)
{
    if (!rijndael256_gcm_verify(key, iv, iv_len, aad, aad_len, ct, ct_len, tag)) {
        return 0;
    }

    rijndael256_gcm_ctr_crypt(key, iv, ct, ct_len, pt);
    return 1;
}
```

## src/rijndael_256_gcm.h
```c
#ifndef RIJNDAEL_256_GCM_H
#define RIJNDAEL_256_GCM_H

#include <stddef.h>
#include <stdint.h>

#define RIJNDAEL256_GCM_NONCE_LEN  12
#define RIJNDAEL256_GCM_TAG_LEN    16
#define RIJNDAEL256_KEY_LEN        32  /* 256-bit key */
#define RIJNDAEL256_BLOCK_LEN      32  /* 256-bit block */

extern uint32_t g_rijndael256_block_calls;

void rijndael256_gcm_counters_reset(void);
uint32_t rijndael256_gcm_get_block_calls(void);

void rijndael256_gcm_ctr_crypt(const uint8_t key[RIJNDAEL256_KEY_LEN],
                               const uint8_t iv[RIJNDAEL256_GCM_NONCE_LEN],
                               const uint8_t *in, size_t len,
                               uint8_t *out);

void rijndael256_gcm_auth(const uint8_t key[RIJNDAEL256_KEY_LEN],
                          const uint8_t *iv, size_t iv_len,
                          const uint8_t *aad, size_t aad_len,
                          const uint8_t *ct, size_t ct_len,
                          uint8_t tag[RIJNDAEL256_GCM_TAG_LEN]);

int rijndael256_gcm_verify(const uint8_t key[RIJNDAEL256_KEY_LEN],
                           const uint8_t *iv, size_t iv_len,
                           const uint8_t *aad, size_t aad_len,
                           const uint8_t *ct, size_t ct_len,
                           const uint8_t tag[RIJNDAEL256_GCM_TAG_LEN]);

void rijndael256_gcm_encrypt_auth(const uint8_t key[RIJNDAEL256_KEY_LEN],
                                  const uint8_t *iv, size_t iv_len,
                                  const uint8_t *aad, size_t aad_len,
                                  const uint8_t *pt, size_t pt_len,
                                  uint8_t *ct,
                                  uint8_t tag[RIJNDAEL256_GCM_TAG_LEN]);

int rijndael256_gcm_decrypt_verify(const uint8_t key[RIJNDAEL256_KEY_LEN],
                                   const uint8_t *iv, size_t iv_len,
                                   const uint8_t *aad, size_t aad_len,
                                   const uint8_t *ct, size_t ct_len,
                                   const uint8_t tag[RIJNDAEL256_GCM_TAG_LEN],
                                   uint8_t *pt);

#endif
```
